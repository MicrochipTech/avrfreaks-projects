//==============================================================================
// File:           deskeys.inc
// Compiler:       IAR Atmel AVR C/EC++ Compiler
// Output Size:    288
// Created:        03/25/11
//
// Description:    This file is generated by 'create' tool and is to be included
//                 in the 'bootldr' project. It contains a DES key table for
//                 a proper decryption of the file encrypted using the same
//                 configurations.
//
// Keys used:      KEY1 = CE987F2C688C9162
//                 KEY2 = C1DCD04F3DE67654
//                 KEY3 = 8349F42C3D98DC38
//==============================================================================

#include <avr/pgmspace.h>

PROGMEM unsigned char kTable[48 * 6] = 
{
	0xc3, 0xf0, 0xcd, 0x89, 0xd4, 0x34,
	0x2b, 0xa9, 0xb8, 0xdc, 0x16, 0x38,
	0x7f, 0x48, 0x07, 0xc0, 0xde, 0x0a,
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	0x28, 0xe4, 0x77, 0x89, 0xb5, 0x68
};
