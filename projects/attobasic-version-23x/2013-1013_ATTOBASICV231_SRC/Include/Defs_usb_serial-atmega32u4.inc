.equ __ctors_start = 0x6820/2
.equ usb_init = 0x6830/2
.equ usb_shutdown = 0x6866/2
.equ usb_configured = 0x6882/2
.equ usb_serial_getchar = 0x6888/2
.equ usb_serial_available = 0x68d0/2
.equ usb_serial_flush_input = 0x6904/2
.equ usb_serial_putchar = 0x692a/2
.equ usb_serial_putchar_nowait = 0x69ae/2
.equ usb_serial_flush_output = 0x69f0/2
.equ usb_serial_get_baud = 0x6a10/2
.equ usb_serial_get_stopbits = 0x6a22/2
.equ usb_serial_get_paritytype = 0x6a28/2
.equ usb_serial_get_numbits = 0x6a2e/2
.equ usb_serial_get_control = 0x6a34/2
.equ usb_serial_set_control = 0x6a3a/2
.equ USB_GEN_int = 0x6a90/2
.equ USB_COM_int = 0x6b04/2
.equ cdc_line_coding = 0x0aa0
.equ usb_configuration = 0x0aa8
.equ cdc_line_rtsdtr = 0x0aa9
.equ transmit_flush_timer = 0x0aaa
.equ transmit_previous_timeout = 0x0aab
.equ usb_suspended = 0x0aac
