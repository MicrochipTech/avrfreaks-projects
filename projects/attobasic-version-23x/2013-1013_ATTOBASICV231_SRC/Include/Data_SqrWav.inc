;Lookup table for squarewave output
.cseg	;NOTE: we ALWAYS assume there is a bootloader present!

;#if BTLDR
;always assume there is a bootloader, even if we don't include one
#if defined(__ATmega32U4__) 
	.org	LARGEBOOTSTART-128	; Leave room for LUFA bootloader
#elif defined(__AT90USB1286__)
  #if TEENSY
	  .org	FIRSTBOOTSTART-128	;The TEENSY++ 2.0 bootloader is 4K words
  #else
;	 .org	THIRDBOOTSTART-128	;LUFA DFU is 2K words
	 .org	FOURTHBOOTSTART-128	;LUFA DFU is 4K words
  #endif
#elif defined(__ATmega2560__)
	 .org	FOURTHBOOTSTART-128	;STK500V2 is 4K words
#elif defined(__ATmega168__) || \
  		defined(__ATmega168PA__)
	.org	SECONDBOOTSTART-128	; Leave room for STK500v2 bootloader
#elif defined(__ATmega328__) || \
		defined(__ATmega328PA__)
	.org	FIRSTBOOTSTART-128	; Leave room for STK500v2 bootloader
#else
	.org	FLASHEND-128+1		; word addresses
#endif
;#endif

sqrwave:				; must be page aligned
.db	0x00,0x00,0x00,0x00,0x00,0x00,0x00,0x00
.db	0x00,0x00,0x00,0x00,0x00,0x00,0x00,0x00
.db	0x00,0x00,0x00,0x00,0x00,0x00,0x00,0x00
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.db	0xFF,0xFF,0xFF,0xFF,0xFF,0xFF,0xFF,0xFF
sqrwave_end:
