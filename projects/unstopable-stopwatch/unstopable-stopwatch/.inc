	.DEF _count=R4
	.DEF _indeks=R5
	.DEF _detik=R6
	.DEF _menit=R7
	.DEF _jam=R8
_tbl10_G2:
	.DB  0x10,0x27,0xE8,0x3,0x64,0x0,0xA,0x0
	.DB  0x1,0x0
_tbl16_G2:
	.DB  0x0,0x10,0x0,0x1,0x10,0x0,0x1,0x0
_115:
	.DB  0x80,0xC0
	.DEF __lcd_x=R9
	.DEF __lcd_y=R10
	.DEF __lcd_maxx=R11
_0:
	.DB  0x54,0x69,0x6D,0x65,0x72,0x20,0x25,0x64
	.DB  0x3A,0x25,0x64,0x3A,0x25,0x64,0x3A,0x25
	.DB  0x64,0x0,0x53,0x54,0x41,0x52,0x54,0x0
	.DB  0x53,0x54,0x4F,0x50,0x0,0x53,0x54,0x41
	.DB  0x52,0x54,0x20,0x20,0x20,0x20,0x20,0x20
	.DB  0x52,0x45,0x53,0x45,0x54,0x0

__GLOBAL_INI_TBL:
	.DW  0x02
	.DW  __base_y_G4
	.DW  _115*2

	.DW  0
