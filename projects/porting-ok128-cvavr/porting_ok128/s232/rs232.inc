	.DEF _rx_wr_index0=R4
	.DEF _rx_rd_index0=R5
	.DEF _rx_counter0=R6
	.DEF _tx_wr_index0=R7
	.DEF _tx_rd_index0=R8
	.DEF _tx_counter0=R9
__menu:
	.DW  _menu
	.DW  0x2C
	.DW  _menu+0x02
	.DB  0x31,0x2E,0x20,0x4C,0x69,0x67,0x68,0x74
	.DB  0x20,0x4F,0x6E,0x2F,0x4F,0x66,0x66,0x20
	.DB  0xA,0x20,0x32,0x2E,0x20,0x41,0x6D,0x62
	.DB  0x75,0x6C,0x61,0x6E,0x63,0x65,0x20,0xA
	.DB  0x20,0x33,0x2E,0x20,0x4C,0x43,0x44,0x20
	.DB  0xA,0x0
	.DEF _tmp=R10
	.DEF _position=R11
_75:
	.DB  0x5B,0x31,0x5D,0x20,0x4C,0x69,0x67,0x68
	.DB  0x74,0x20,0x4F,0x6E,0x2F,0x4F,0x66,0x66
	.DB  0x20,0x7,0xA,0x20,0x9,0x9,0x9,0x9
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	.DB  0xA,0x0,0x0
	.DEF _key_flag=R13
_0xC9:
	.DB  0x10,0x18
	.DB  0x1C,0x1E
	.DB  0x1C,0x18
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	.DB  0x1,0x0

;HEAP START MARKER INITIALIZATION
__HEAP_START_MARKER:
	.DW  0xEE00,0x4
	.DW  0,0

__GLOBAL_INI_TBL:
	.DW  __HEAP_START_MARKER*2
	.DW  __menu*2
	.DW  0
