/****************************************************************************************
*	DISCLAIMER:
*	
*	This library was ported from original code written by Duck-Yong Yoon in 2005.
*	The original platform was for AvrEdit and ported to CVAVR.
*	The purpose of this is for educational only, I am not
*	responsible for any damages caused by this library.
*	
*	This file glcd128.h are actually was ported (also added) and written
*	for specific use for OK128 ATMEGA128 toolbox kit from www.ohm.co.kr, and was used in
*	Mechatronics and Experiments in our lab robot.gsnu.ac.kr
*	
*	OK128, CVAVR and AVREDIT are both belong to their respective owner.
*	
*	Bondhan Novandy
*	http://bono02.wordpress.com/ 
*	
*	NOTE: - Copy glcd128.h into drive:\>cvavr\inc  
*	      - Don't forget to set the external memory to 61184 bytes in project settings
*	
*	
****************************************************************************************/

#include <stdlib.h> 
#include <math.h>
#include <ok128.h>

#define pgm_read_byte *

unsigned char screen[8][128];
typedef unsigned char uint8_t;  
typedef unsigned int uint16_t;

uint8_t xcharacter, ycharacter;		// x character(0-3), y character(0-15)
uint8_t cursor_flag, xcursor, ycursor;	// x and y cursor position(0-3, 0-15)

typedef unsigned char prog_uchar;   

prog_uchar font[95][5] = {	                /* 5x7 ASCII character font */
	{0x00, 0x00, 0x00, 0x00, 0x00},		// 0x20 space
	{0x00, 0x00, 0x4f, 0x00, 0x00},		// 0x21 !
	{0x00, 0x07, 0x00, 0x07, 0x00},		// 0x22 "
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	{0x08, 0x04, 0x08, 0x10, 0x08}};	// 0x7e ~

prog_uchar E_font[128][16] = {			/* 8x16 ASCII character font */
  {0x00,0x00,0x00,0x00,0x00,0x00,0x00,0x00,0x00,0x00,0x00,0x00,0x00,0x00,0x00,0x00}, // 0x00
  {0xF8,0x04,0x14,0x04,0x04,0x14,0x04,0xF8,0x07,0x08,0x09,0x0B,0x0B,0x09,0x08,0x07}, // 0x01
  {0xF8,0xFC,0x6C,0x7C,0x7C,0x6C,0xFC,0xF8,0x07,0x0F,0x0F,0x0C,0x0C,0x0F,0x0F,0x07}, // 0x02
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  {0x80,0xC0,0x60,0x30,0x60,0xC0,0x80,0x00,0x07,0x07,0x04,0x04,0x04,0x07,0x07,0x00}}; // 0x7F

/* -------------------------------------------------------------------------- */
/*		Font Processing Table for Korean Character		      */
/* -------------------------------------------------------------------------- */
prog_uchar table_cho[21] =
	{0,0,1,2,3,4,5,6,7,8,9,10,11,12,13,14,15,16,17,18,19};
prog_uchar table_joong[30] =
	{0,0,0,1,2,3,4,5,0,0,6,7,8,9,10,11,0,0,12,13,14,15,16,17,0,0,18,19,20,21};
prog_uchar table_jong[30] =
	{0,0,1,2,3,4,5,6,7,8,9,10,11,12,13,14,15,16,0,17,18,19,20,21,22,23,24,25,26,27};

prog_uchar bul_cho1[22] =
	{0,0,0,0,0,0,0,0,0,1,3,3,3,1,2,4,4,4,2,1,3,0};
prog_uchar bul_cho2[22] =
	{0,5,5,5,5,5,5,5,5,6,7,7,7,6,6,7,7,7,6,6,7,5};
prog_uchar bul_jong[22] =
	{0,0,2,0,2,1,2,1,2,3,0,2,1,3,3,1,2,1,3,3,1,1};

/* -------------------------------------------------------------------------- */
/*		16x16 Dot Korean Character Font				      */
/* -------------------------------------------------------------------------- */
prog_uchar K_font[360][32] = {			/* 16x16 Korean character font */
  {0x00,0x00,0x00,0x00,0x00,0x00,0x00,0x00,0x00,0x00,0x00,0x00,0x00,0x00,0x00,0x00,
   0x00,0x00,0x00,0x00,0x00,0x00,0x00,0x00,0x00,0x00,0x00,0x00,0x00,0x00,0x00,0x00},
  {0x00,0x00,0x08,0x08,0x08,0x88,0xC8,0x78,0x38,0x00,0x00,0x00,0x00,0x00,0x00,0x00,
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   0x00,0x00,0x00,0x08,0x28,0x78,0x5C,0x5C,0x5C,0x5C,0x78,0x28,0x08,0x00,0x00,0x00}};   

void GLCD_command(uint8_t signal,uint8_t command)       /* write a command */
{ LCD_CONTROL = signal & 0xC0;			// D/-I = 0
  #asm(" PUSH  R0 ")                   // delay for 500 ns
  #asm(" POP   R0 ")
  #asm(" PUSH  R0 ")
  #asm(" POP   R0 ")
  LCD_DATABUS = command;                        // write command
  LCD_CONTROL = (signal & 0xC0)|0x20;		// E = 1
  #asm(" PUSH  R0 ")                   // delay for 500 ns
  #asm(" POP   R0 ")
  #asm(" PUSH  R0 ")
  #asm(" POP   R0 ")
  LCD_CONTROL = signal & 0xC0;                  // E = 0
  #asm(" NOP      ")
  LCD_CONTROL = 0x00;				// clear all control signals
  delay_us(10);                                 // wait for GLCD busy
}

void GLCD_data(uint8_t signal,uint8_t character)        /* write a data */
{ LCD_CONTROL = (signal & 0xC0)|0x10;		// D/-I = 1
  #asm(" PUSH  R0 ")                   // delay for 500 ns
  #asm(" POP   R0 ")
  #asm(" PUSH  R0 ")
  #asm(" POP   R0 ")
  LCD_DATABUS = character;                      // write data
  LCD_CONTROL = (signal & 0xC0)|0x30;		// E = 1
  #asm(" PUSH  R0 ")                   // delay for 500 ns
  #asm(" POP   R0 ")
  #asm(" PUSH  R0 ")
  #asm(" POP   R0 ")
  LCD_CONTROL = (signal & 0xC0)|0x10;           // E = 0
  #asm(" NOP      ")
  LCD_CONTROL = 0x00;				// clear all control signals
  delay_us(10);                                 // wait GLCD busy
}

void GLCD_xy(uint8_t x,uint8_t y)		/* set character position */
{ 
  xcharacter = x;
  ycharacter = y;

  GLCD_command(0xC0,0xB8+xcharacter);		// X address

  if(ycharacter <= 9)				// if y <= 9, CS1 Y address
    GLCD_command(0x40,0x40+ycharacter*6+4);
  else						// if y >= 10, CS2 Y address
    GLCD_command(0x80,0x40+(ycharacter-10)*6);
}


void Axis_xy(uint8_t x,uint8_t y)		/* set x, y axis position */
{ GLCD_command(0xC0,0xB8+x);			// X address(0 - 7)

  if(y <= 63)					// if y <= 63, CS1 Y address
    GLCD_command(0x40,0x40 + y);
  else						// if y >= 64, CS2 Y address
    GLCD_command(0x80,0x40 + y - 64);
}

void Draw(void)					/* draw screen with buffer data */
{ uint8_t x, y;

  for(x = 0; x <= 7; x++)
    { Axis_xy(x, 0);				// draw CS1 area
      for(y = 0; y <= 63; y++)
        GLCD_data(0x40, screen[x][y]);
      Axis_xy(x, 64);				// draw CS2 area
      for(y = 64; y <= 127; y++)
        GLCD_data(0x80, screen[x][y]);
    }
}

void Clear_screen(void)				/* clear buffer and GLCD screen */
{ uint8_t x, y;

  LCD_CONTROL = 0x00;				// clear all control signals
  GLCD_command(0xC0,0x3F);			// CS1,CS2 display ON
  GLCD_command(0xC0,0xC0);			// CS1,CS2 display position

  for(x = 0; x <= 7; x++)			// clear screen buffer
    for(y = 0; y <= 127; y++)
      screen[x][y] = 0;

  Draw();					// clear screen
}

void Dot(uint8_t xx,uint8_t y)			/* draw a dot on GLCD */
{ uint8_t x, i;

  if((xx > 63) || (y > 127)) return;

  x = xx / 8;					// calculate x address
  i = xx % 8;
  if(i == 0)      i = 0x01;
  else if(i == 1) i = 0x02;
  else if(i == 2) i = 0x04;
  else if(i == 3) i = 0x08;
  else if(i == 4) i = 0x10;
  else if(i == 5) i = 0x20;
  else if(i == 6) i = 0x40;
  else            i = 0x80;
  screen[x][y] |= i;				// OR old data with new data

  Axis_xy(x, y);				// draw dot on GLCD screen
  if(y <= 63)
    GLCD_data(0x40, screen[x][y]);
  else
    GLCD_data(0x80, screen[x][y]);
}

void Line(uint8_t x1,uint8_t y1,uint8_t x2,uint8_t y2)	/* draw a straight line */
{ int x, y;

  if(y1 != y2)					// if y1 != y2, y is variable
    { if(y1 < y2)				//              x is function
        for(y = y1; y <= y2; y++)
          { x = x1 + (y - y1)*(x2 - x1)/(y2 - y1);
            Dot(x,y);
          }
      else
        for(y = y1; y >= y2; y--)
          { x = x1 + (y - y1)*(x2 - x1)/(y2 - y1);
            Dot(x,y);
          }
    }
  else if(x1 != x2)				// if x1 != x2, x is variable
    { if(x1 < x2)				//              y is function
        for(x = x1; x <= x2; x++)
          { y = y1 + (x - x1)*(y2 - y1)/(x2 - x1);
            Dot(x,y);
          }
      else
        for(x = x1; x >= x2; x--)
          { y = y1 + (x - x1)*(y2 - y1)/(x2 - x1);
            Dot(x,y);
          }
    }
  else						// if x1 == x2 and y1 == y2,
    Dot(x1,y1);					//             it is a dot
}

void Rectangle(uint8_t x1,uint8_t y1,uint8_t x2,uint8_t y2) /* draw a rectangle */
{ Line(x1,y1,x1,y2);				// horizontal line
  Line(x2,y1,x2,y2);
  Line(x1,y1,x2,y1);				// vertical line
  Line(x1,y2,x2,y2);
}

void Circle(uint8_t x1,uint8_t y1,uint8_t r)	/* draw a circle */
{ int x, y;
  float s;

  for(y = y1 - r*3/4; y <= y1 + r*3/4; y++)	// draw with y variable
    { s = sqrt(r*r - (y-y1)*(y-y1)) + 0.5;
      x = x1 + (uint8_t)s;
      Dot(x,y);
      x = x1 - (uint8_t)s;
      Dot(x,y);
    }

  for(x = x1 - r*3/4; x <= x1 + r*3/4; x++)	// draw with x variable
    { s = sqrt(r*r - (x-x1)*(x-x1)) + 0.5;
      y = y1 + (uint8_t)s;
      Dot(x,y);
      y = y1 - (uint8_t)s;
      Dot(x,y);
    }
}

void GLCD_clear(void)				/* clear GLCD screen */
{ uint8_t i, j, x;

  LCD_CONTROL = 0x00;				// clear all control signals
  GLCD_command(0xC0,0x3F);			// CS1,CS2 display ON
  GLCD_command(0xC0,0xC0);			// CS1,CS2 display position

  x = 0xB8;
  for(i = 0; i <= 7; i++)
    { GLCD_command(0xC0,x);                     // X start addtess
      GLCD_command(0xC0,0x40);                  // Y start address
      for(j = 0; j <= 63; j++)
        GLCD_data(0xC0,0x00);			// clear CS1 and CS2 screen
      x++;
    }
}

void GLCD_xy_row(uint8_t x,uint8_t y,uint8_t row) /* set character upper/lower row */
{ if(row == 0)					// if upper row, set Y address
    GLCD_command(0xC0,0xB8 + x*2);
  else						// if lower row, set Y address + 1
    GLCD_command(0xC0,0xB8 + x*2 + 1);

  if(y <= 7)					// if y <= 7, CS1 Y address
    GLCD_command(0x40,0x40 + y*8);
  else						// if y >= 8, CS2 Y address
    GLCD_command(0x80,0x40 + (y-8)*8);
}

uint8_t pgm_read_byteX(uint8_t *Ecode)
{
	return (uint8_t *) Ecode;
}

void GLCD_English(uint8_t Ecode)		/* display a 8x16 Dot English(ASCII) */
{ 
  unsigned char i, signal;

  GLCD_xy_row(xcharacter,ycharacter,0);		// display upper row
  
  if(ycharacter <= 7)				// if y <= 7, CS1
    signal = 0x40;
  else						// if y >= 8, CS2
    signal = 0x80;
  for(i = 0; i <= 7; i++)
    GLCD_data(signal, pgm_read_byte(&E_font[Ecode][i]));

  GLCD_xy_row(xcharacter, ycharacter, 1);		// display lower row
  
  if(ycharacter <= 7)				// if y <= 7, CS1
    signal = 0x40;
  else						// if y >= 8, CS2
    signal = 0x80;
  for(i = 8; i <= 15; i++)
    { if((cursor_flag == 1) && (xcharacter == xcursor) && (ycharacter == ycursor))
        GLCD_data(signal,pgm_read_byte(&E_font[Ecode][i]) | 0x80);
      else
        GLCD_data(signal,pgm_read_byte(&E_font[Ecode][i]));
    }

  ycharacter++;                                 // go next character position
  if(ycharacter == 16)
    { ycharacter = 0;
      xcharacter++;
    }
}

void GLCD_Korean(uint16_t Kcode)		/* display a 16x16 Dot Korean */
{ unsigned char i, signal;
  unsigned char cho_5bit, joong_5bit, jong_5bit;
  unsigned char cho_bul, joong_bul, jong_bul=0, jong_flag;
  unsigned int character;
  unsigned char Korean_buffer[32];		// 32 byte Korean font buffer

  if(ycharacter == 15)				// if can not display, go next line
    GLCD_English(0x20);

						// get cho, joong, jong 5 bit
  cho_5bit = pgm_read_byte(&table_cho[(Kcode >> 10) & 0x001F]);
  joong_5bit = pgm_read_byte(&table_joong[(Kcode >> 5) & 0x001F]);
  jong_5bit = pgm_read_byte(&table_jong[Kcode & 0x001F]);

  if(jong_5bit == 0)				// don't have jongsung 
    { jong_flag = 0;
      cho_bul = pgm_read_byte(&bul_cho1[joong_5bit]);
      if((cho_5bit == 1) || (cho_5bit == 16)) joong_bul = 0;
      else                                    joong_bul = 1;
    }
  else						// have jongsung
    { jong_flag = 1;
      cho_bul = pgm_read_byte(&bul_cho2[joong_5bit]);
      if((cho_5bit == 1) || (cho_5bit == 16)) joong_bul = 2;
      else                                    joong_bul = 3;
      jong_bul = pgm_read_byte(&bul_jong[joong_5bit]);
    }

  character = cho_bul*20 + cho_5bit;		// copy chosung font
  for(i = 0; i <= 31; i++)
    Korean_buffer[i] = pgm_read_byte(&K_font[character][i]);

  character = 8*20 + joong_bul*22 + joong_5bit;	// OR joongsung font
  for(i = 0; i <= 31; i++)
    Korean_buffer[i] |= pgm_read_byte(&K_font[character][i]);

  if(jong_flag == 1)				// if jongsung, OR jongsung font
    { character = 8*20 + 4*22 +jong_bul*28 + jong_5bit;
      for(i = 0; i <= 31; i++)
        Korean_buffer[i] |= pgm_read_byte(&K_font[character][i]);
    }

  GLCD_xy_row(xcharacter,ycharacter,0);		// display upper left row
  if(ycharacter <= 7)				// if y <= 7, CS1
    signal = 0x40;
  else						// if y >= 8, CS2
    signal = 0x80;
  for(i = 0; i <= 7; i++)
    GLCD_data(signal,Korean_buffer[i]);

  GLCD_xy_row(xcharacter,ycharacter,1);		// display lower left row
  if(ycharacter <= 7)				// if y <= 7, CS1
    signal = 0x40;
  else						// if y >= 8, CS2
    signal = 0x80;
  for(i = 16; i <= 23; i++)
    { if((cursor_flag == 1) && (xcharacter == xcursor) && (ycharacter == ycursor))
         GLCD_data(signal,Korean_buffer[i] | 0x80);
      else
         GLCD_data(signal,Korean_buffer[i]);
    }

  ycharacter++;

  GLCD_xy_row(xcharacter,ycharacter,0);		// display upper right row
  if(ycharacter <= 7)				// if y <= 7, CS1
    signal = 0x40;
  else						// if y >= 8, CS2
    signal = 0x80;
  for(i = 8; i <= 15; i++)
    GLCD_data(signal,Korean_buffer[i]);

  GLCD_xy_row(xcharacter,ycharacter,1);		// display lower right row
  if(ycharacter <= 7)				// if y <= 7, CS1
    signal = 0x40;
  else						// if y >= 8, CS2
    signal = 0x80;
  for(i = 24; i <= 31; i++)
    { if((cursor_flag == 1) && (xcharacter == xcursor) && (ycharacter == (ycursor+1)))
         GLCD_data(signal,Korean_buffer[i] | 0x80);
      else
         GLCD_data(signal,Korean_buffer[i]);
    }

  ycharacter++;                                 // go next character position
  if(ycharacter == 16)
    { ycharacter = 0;
      xcharacter++;
    }
}


void GLCD_character(uint8_t character)		/* display a character */
{ uint8_t i, signal, font_data;

  GLCD_xy(xcharacter,ycharacter);
  if(ycharacter <= 9)				// if y <= 9, CS1
    signal = 0x40;
  else						// if y >= 10, CS2
    signal = 0x80;
  for(i = 0; i <= 4; i++)
    //{ font_data = pgm_read_byte(&font[character-0x20][i]);
      { font_data = pgm_read_byte(&font[character-0x20][i]);
      if((cursor_flag == 1) && (xcharacter == xcursor) && (ycharacter == ycursor))
          GLCD_data(signal,font_data | 0x80);
      else
          GLCD_data(signal,font_data);
    }
  GLCD_data(signal,0x00);			// last byte 0x00

  ycharacter++;                                 // go next character position
  if(ycharacter == 20)
    { ycharacter = 0;
      xcharacter++;
    }
}

void GLCD_string(uint8_t x,uint8_t y,char flash *string)	/* display a string normal font weight*/
{ 

  GLCD_xy(x,y);
  
  while(*string != '\0')
     { 
       //LCD_data(*string);
       GLCD_character(*string);			// display a charcater	  
       string++;
     }
}

//void GLCD_string(uint8_t x,uint8_t y,uint8_t *string)	/* display a string */
int GLCD_string_graphic(uint8_t x,uint8_t y, char flash *string)	/* display a string in graphic */
{ 
  unsigned char character1 = NULL;
  unsigned int character2 = NULL;

  GLCD_xy(x,y);					// x = 0 - 3, y = 0 - 15

  while(*string != NULL)
  {               
 	  character1 = *string;
       string++;       
       
       if(character1 < 0x80)
       {     	          
         GLCD_English(character1);		// display English character
       }
       else
       { 
       	character2 = 256*character1 + (*string & 0xFF);
          string++;
          GLCD_Korean(character2);		// display Korean character
       }
  }
  	return 1;
}




void GLCD_demo(void)
{
	unsigned char x, y, i;     

	GLCD_clear();

	for(i = 0,x = 0,y = 0; i <= 7; i++,x += 4,y += 8)	// graphic show 1
        { Rectangle(x,y,63 - x,127 - y);
          delay_ms(300);
        }
      delay_ms(1000);
      for(i = 0; i <= 63; i++)			// (scroll up)
        { GLCD_command(0xC0,0xC0 + i);
          delay_ms(100);
        }
      GLCD_command(0xC0,0xC0);
      delay_ms(3000);
      Clear_screen();

      for(i = 0,x = 0,y = 0; i <= 7; i++,x += 4,y += 4)	// graphic show 2
        { Rectangle(x,y,63-x,63-y);
          Rectangle(x,y+64,63-x,127-y);
          delay_ms(300);
        }
      delay_ms(3000);
      Clear_screen();

      Rectangle(0,0,63,127);			// graphic show 3
      delay_ms(300);
      for(i = 0,x = 7,y = 15; i <= 7; i++,x += 8,y += 16)
        { Line(x,0,0,y);
          Line(0,127-y,x,127);
          delay_ms(300);
        }
      for(i = 0,x = 7,y = 15; i <= 7; i++,x += 8,y += 16)
        { Line(63,y,x,127);
          Line(x,0,63,127-y);
          delay_ms(300);
        }
      for(i = 0,x = 0,y = 0; i <= 7; i++,x += 4,y += 8)
        { Rectangle(x,y,63-x,127-y);
          delay_ms(300);
        }
      delay_ms(3000);
      Clear_screen();

      Rectangle(0,0,63,127);			// graphic show 4
      delay_ms(300);
      for(i = 7; i <= 63; i += 8)
        { Circle(31,63,i);
          delay_ms(300);
        }
      delay_ms(1000);
      for(i = 63; i != 0; i--)			// (scroll down)
        { GLCD_command(0xC0,0xC0 + i);
          delay_ms(100);
        }
      GLCD_command(0xC0,0xC0);
      delay_ms(3000);
      Clear_screen();

      for(i = 3; i <= 31; i += 4)		// graphic show 5
        { Circle(31,31,i);
          Circle(31,95,i);
          delay_ms(300);
        }
      delay_ms(3000);
      Clear_screen();

}      