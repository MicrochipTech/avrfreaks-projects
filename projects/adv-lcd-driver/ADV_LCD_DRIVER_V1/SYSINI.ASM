.CSEG


SYSTEM_INI:

   
   _INIT_STACK	;INITIATING STACK AT THE TOP OF SRAM

; FOR PIN MAPPING REFER TO DOC.INC		
;I/O PORTS CONFIGURATIONS
;PORT A		LCD DATA BUS.ALL OUTPUTS
	LDI		TEMP,$FF
	OUT		DDRA,TEMP
	LDI		TEMP,0
	OUT		PORTA,TEMP
;PORT B		LCD PINS
	LDI		TEMP,0B11100000
	OUT		DDRB,TEMP
	LDI		TEMP,0B00011111
	OUT		PORTB,TEMP
;PORT C
	LDI		TEMP,0B00000000
	OUT		DDRC,TEMP
	LDI		TEMP,0B11111111
	OUT		PORTC,TEMP
;PORT D
    LDI 	TEMP,0B00000000
    OUT 	DDRD,TEMP   
    LDI     TEMP,0B11111111
    OUT 	PORTD,TEMP 


	RCALL	LCD_INIT	  

; CLEARING SRAM	(FIRST 255BYTES)
    LDI     TEMP,$0
    CLR     YH
    CLR     ZH
    LDI     YL,(DATARAM_START)   
    LDI     ZL,(DATARAM_END)
CLEAR_DATARAM:
    ST      Y+,TEMP
    CP      YL,ZL
    BRNE    CLEAR_DATARAM

;CLEAR R0-R25
    CLR     R0
    CLR     R29
    LDI     R28,1
    LDI     R25,24
__CLEAR_REGISTERS:
    ST      Y+,R0
    DEC     R25
    BRNE    __CLEAR_REGISTERS
    CLR     R31
	CLR     R30
    CLR     R29
	CLR		R28
	CLR		R27
	CLR		R26


;**********************************************************
;	THIS PART IS FOR TESTING LCD ROUTINES.
;	TO TEST EACH FUNCTION DISABLE OTHER ROUTINES,
;	ALSO DISABLE THE CHRONOMETER PART PLACED IN SOFT-TIMER#1
;	ROUTINE. 
;	TO UNDERSTAND FUNCTION-TYPE MACROS REFER TO 
;	MACROS MANUAL(README.PDF)
;**********************************************************



;	_LCD_DISPLAY_MSG	str_MESSAGE1,__LCD_LINE1,0,20	
;	_LCD_DISPLAY_MSG	str_MESSAGE3,__LCD_LINE2,0,__NULL
;	_LCD_DISPLAY_MSG	str_MESSAGE4,__LCD_LINE1,0,__ZERO


;	16BIT NUMBER 
;==========================================================
;	LDI		R16,LOW(12345)
;	LDI		R17,HIGH(12345)
;	MOV		R3,R17
;	MOV		R2,R16	
;	_LCD_DISPLAY_NUM		__16BIT,__UNSIGNED,__LCD_LINE1,0,4,R3,R2


;	24BIT NUMBER 
;==========================================================
;	LDI		R16,LOW(12345678)
;	LDI		R17,HIGH(12345678)
;	LDI		R18,BYTE3(12345678)
;	MOV		R4,R18
;	MOV		R3,R17
;	MOV		R2,R16
;	_LCD_DISPLAY_NUM		__24BIT,__UNSIGNED,__LCD_LINE1,0,4,R4,R3,R2

;	32BIT NUMBER 
;==========================================================
;	LDI		R16,LOW(-123456789)
;	LDI		R17,HIGH(-123456789)
;	LDI		R18,BYTE3(-123456789)
;	LDI		R19,BYTE4(-123456789)
;	MOV		R5,R19
;	MOV		R4,R18
;	MOV		R3,R17
;	MOV		R2,R16
;	_LCD_DISPLAY_NUM		__32BIT,__SIGNED,__LCD_LINE1,0,1,R5,R4,R3,R2


;**********************************************************
;
;**********************************************************

;	INITIATING THE 32BIT CHRONOMETER
;***DISABLE THIS PART IF YOU WANT TO TEST OTHER FUNCTIONS***
;==========================================================
;	ACTIVATING SOFT-TIMER#1 TO GENERATE 100mS TICKS FOR 
;	THE CHRONOMETER PART.
	LDI		TEMP,(100-1)
	_8REG2RAM		RAM_STIMER1_PV,TEMP 
 	_SBR	STIMER_FLAGS,_STIMER1_EN
;	STARTING VALUE FOR CHRONOMETER=0
	CLR		R16
	_32REG2RAM		RAM_CHRONOMETER,R16,R16,R16,R16
	_LCD_DISPLAY_MSG	str_CHRONO_MSG,__LCD_LINE1,0,__NULL	
	_LCD_DISPLAY_MSG	str_CHRONO_LINE,__LCD_LINE2,0,__NULL	



; TIMER0 SETTINGS
	LDI 	TEMP,3		
	OUT 	TCCR0,TEMP  ; TIMER0 PRESCALER CLKSRC/64=>1/16000000*64*250=1mS
						; TIMER0 WILL START TO COUNTING FROM WHEN YOU SET 
						; THE VALUE OF TCCR0.
    LDI 	TEMP,(0XFF-250+1)          
    OUT 	TCNT0,TEMP  ;*LOADS TIMER0 FOR 1 ms 
    LDI		TEMP,(1<<TOIE0)
	OUT 	TIMSK,TEMP
	SEI		;GLOBAL INTERRUPT FLAG SETS.

	RJMP	MAIN