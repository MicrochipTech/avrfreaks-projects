
;**********************************************************
;	LCD INITIALIZATION ROUTINE (8BIT MODE)
;	FOR MORE INFORMATION REFER TO LCD DATASHEETS.
;	ALL CONSTANTS & VARIABLES DEFINED IN **LCD.INC** FILE.
;**********************************************************

LCD_INIT:

;	_WAIT_mS	CPU_FREQUENCY,15
;	INSTEAD OF USING A 15mS DELAY ,SET THE STARTUP TIMING (CKSEL=1110,SUT=10)	
;	START-UP TIME:258CK+64mS
	LDI		LCD_REGISTER,__LCD_INIT_CODE
	RCALL	LCD_WRITE_INST

	_WAIT_mS	CPU_FREQUENCY,5

	LDI		LCD_REGISTER,__LCD_INIT_CODE
	RCALL	LCD_WRITE_INST

	_WAIT_mS	CPU_FREQUENCY,1

	LDI		LCD_REGISTER,__LCD_INIT_CODE
	RCALL	LCD_WRITE_INST

	RCALL	LOOP_IF_LCD_BUSY
	LDI		LCD_REGISTER,(__LCD_8BIT_INTERFACE | __LCD_2LINE | __LCD_5x8_MATRIX)
	RCALL	LCD_WRITE_INST

	RCALL	LOOP_IF_LCD_BUSY
	LDI		LCD_REGISTER,__LCD_OFF
	RCALL	LCD_WRITE_INST

	RCALL	LOOP_IF_LCD_BUSY
	LDI		LCD_REGISTER,__LCD_CLEAR
	RCALL	LCD_WRITE_INST

	RCALL	LOOP_IF_LCD_BUSY
	LDI		LCD_REGISTER,__LCD_ON ;| __LCD_SHOW_BLINK
	RCALL	LCD_WRITE_INST
	
	RCALL	CHAR_GENERATOR

	RET	
;**********************************************************
;	FUNCTION: LCD_WRITE_INST
;	USED TO SET THE LCD ADDRESS...
;	REGISTER USED:	R18 AS LCD REGISTER
;	
;**********************************************************
LCD_WRITE_INST:
    CLI
	OUT		PORTA,LCD_REGISTER
	CBI		PORTB,__LCD_RW
	CBI		PORTB,__LCD_DC
	SBI		PORTB,__LCD_STROBE
	NOP
	NOP
	NOP
    CBI		PORTB,__LCD_STROBE
    SEI
    RET
;**********************************************************
;	FUNCTION: LCD_WRITE_DATA
;	USED TO SEND DATA TO LCD.
;	REGISTER USED:	R18 AS LCD REGISTER
;	
;**********************************************************
LCD_WRITE_DATA:
    CLI
    OUT		PORTA,LCD_REGISTER
	CBI		PORTB,__LCD_RW
	SBI		PORTB,__LCD_DC
	SBI		PORTB,__LCD_STROBE
 	NOP
	NOP
	NOP
	CBI		PORTB,__LCD_STROBE
    SEI
    RET
;**********************************************************
;	FUNCTION: LOOP_IF_LCD_BUSY
;	USED TO CHECK THE STATUS OF BUSY FLAG.
;	REGISTER USED:	R16 AS TEMP
;	
;**********************************************************
LOOP_IF_LCD_BUSY:	
	CLR		TEMP
	OUT		PORTA,TEMP	
	OUT		DDRA,TEMP
BUSY_LOOP:
	CLI
	SBI		PORTB,__LCD_RW
	CBI		PORTB,__LCD_DC
	SBI		PORTB,__LCD_STROBE
	NOP
	NOP
	IN		TEMP,PINA
	SEI
	NOP
	ANDI	TEMP,0B10000000 ;BIT No.7 IS FOR BUSY FLAG
	BRNE	BUSY_LOOP
 	CBI		PORTB,__LCD_STROBE
	SER		TEMP
	OUT		DDRA,TEMP
    RET

;**********************************************************
;	FUNCTION: LOAD_TERMINATEDstr_FLASH2LCDBUFFER
;
;	USED TO LOAD NULL_TERMINATED OR ZERO_TERMINATED 
;	STRINGS TO DISPLAY BUFFER.YOU CAN ADD OTHER TERMINATORS 
;	TO YOUR CODE.
;	REGISTER USED:	R16,R17,YH:YL,ZH:ZL
;	CYCLES: FOR A 20CHAR STRING IT TAKES 189CYCLES
;			WITHOUT RET.AT 16MHz IT TAKES~12uS
;	NOTE: THIS FUNCTION USED BY _LCD_DISPLAY_MSG MACRO.
;**********************************************************
LOAD_TERMINATEDstr_FLASH2LCDBUFFER: 
    ADD     YL,R16    ; BUFFER POINTER 
    CLR     R16
    ADC     YH,R16
trmstr_LOAD_char:    
	LPM	    R16,Z+	
	CP		R16,R17
	BREQ	END_OF_trmstr
    ST      Y+,TEMP
    RJMP    trmstr_LOAD_char    
END_OF_trmstr:
    RET
;**********************************************************
;	FUNCTION: LOAD_CHARstr_FLASH2LCDBUFFER
;
;	USED TO LOAD PART OF ARRAY OF CHARS TO DISPLAY
;	BUFFER.YOU HAVE TO SPECIFY THE LENTH OF ARRAY.
;	REGISTER USED:	R16,R17,YH:YL,ZH:ZL
;	CYCLES: FOR A 20CHAR ARRAY IT TAKES 182CYCLES
;			WITHOUT RET.AT 16MHz IT TAKES~12uS
;	NOTE: THIS FUNCTION USED BY _LCD_DISPLAY_MSG MACRO.
;**********************************************************
LOAD_CHARstr_FLASH2LCDBUFFER:
    ADD     YL,R16    ; BUFFER POINTER 
    CLR     R16
    ADC     YH,R16
charstr_LOAD_char:    
	LPM	    R16,Z+	
	DEC		R17
    ST      Y+,TEMP
	BREQ	END_OF_charstr
    RJMP    charstr_LOAD_char    
END_OF_charstr:
    RET
;**********************************************************
;	FUNCTION: BCD2LCDBUFFER
;
;	USED TO FORMAT A PACKED-BCD NUMBER AND THEN LOAD
;	IT TO DISPLAY BUFFER.
;	NUMERICAL FORMATING INCLUDES ADDING NEGETIVE SIGN
;	AND DECIMAL POINT TO THE NUMBER.ALSO IT CONVERTS THE 
;	NUMERIC VALUE TO ASCII VALUE TO DISPLAY IT ON THE LCD.
;
;	REGISTER USED:	R16,R17,R18,R19,YH:YL,ZH:ZL
;	CYCLES: FOR A 10DIGIT SIGNED NUMBER IT TAKES 130CYCLES
;			WITHOUT RET.AT 16MHz IT TAKES~8uS
;	NOTE: THIS FUNCTION USED BY _LCD_DISPLAY_NUM MACRO.
;**********************************************************
BCD2LCDBUFFER:
	ADD     YL,R16    ; BUFFER POINTER 
    CLR     R16
    ADC     YH,R16
  	BLD		R17,7
	LDI		R16,'-'
    _SKIP_IF_BIT_NOTSET		R17,7
	ST		Y+,R16
	CBR		R17,(1<<7)
NUM2BUF_LOOP:
	LD		R18,Z
	ANDI	R18,0XF0
	SWAP	R18
	SUBI	R18,-0X30
	ST		Y+,R18
	DEC		R17
	BRNE	NUM2BUF_HiNIB
	LDI		R16,'.'
	ST		Y+,R16
NUM2BUF_HiNIB:			
	LD		R18,Z
	ANDI	R18,0X0F
	SUBI	R18,-0X30
	ST		Y+,R18
	DEC		R17
	BRNE	NUM2BUF_LowNIB
	LDI		R16,'.'
	ST		Y+,R16
NUM2BUF_LowNIB:
	SBIW	ZH:ZL,1
	DEC		R19
	BRNE	NUM2BUF_LOOP
END_OF_BCD:
	RET

;**********************************************************
;	FUNCTION: LOAD_CHAR_BUFFER2LCD
;
;	USED TO SEND A SINGLE BYTE FROM DISPLAY-BUFFER TO  
;	LCD.THIS FUNCTION CALLS BY EACH LCD-TICK AT 1mS AND 
;	AFTER 40mS IT SCANS THE ENTIRE LCD WINDOW(FOR 2*40 LCD)
;	AND THEN IT STARTS FROM FIRST POSITION OF LCD WINDOW.
;	YOU CAN USE OTHER TICKS BUT 1mS IS GOOD ENOUGH.

;	REGISTER USED:	R16(TEMP),R17,R18,YH:YL
;	CYCLES: IT TAKES 120CYCLES
;			WITHOUT RET.AT 16MHz IT TAKES~8uS
;	NOTE: 
;**********************************************************
LOAD_CHAR_BUFFER2LCD:
    LDI     YH,HIGH(RAM_DISPLAY_BUFFER_LINE1)        
    LDI     YL,LOW(RAM_DISPLAY_BUFFER_LINE1)
    LDS     R17,RAM_LCD_POINTER  
    ADD     YL,R17
    CLR     TEMP
    ADC     YH,TEMP
LCD_POINTER_AT_LINE1:
    CPI     R17,20
    BRSH    LCD_POINTER_AT_LINE2
    LDI     LCD_REGISTER,__LCD_LINE1_ADR
    ADD     LCD_REGISTER,R17
	CALL	LOOP_IF_LCD_BUSY
	CALL	LCD_WRITE_INST
    LD      LCD_REGISTER,Y
    RCALL   LOOP_IF_LCD_BUSY
    RCALL   LCD_WRITE_DATA
    INC     R17
    RJMP    SAVE_DISP_POINTER
LCD_POINTER_AT_LINE2:
    CPI     R17,40
    BREQ    RESET_DISP_POINTER
    LDI     LCD_REGISTER,(__LCD_LINE2_ADR-20)
    ADD     LCD_REGISTER,R17
	CALL	LOOP_IF_LCD_BUSY
	CALL	LCD_WRITE_INST	 
    LD      LCD_REGISTER,Y
    RCALL   LOOP_IF_LCD_BUSY
    RCALL   LCD_WRITE_DATA
    INC     R17
    RJMP    SAVE_DISP_POINTER
RESET_DISP_POINTER:
    LDI     R17,0
SAVE_DISP_POINTER:
    STS     RAM_LCD_POINTER,R17
	_CBR	SYSTEM_FLAGS,__LCD_TICK     
    RET



;**********************************************************
;	FUNCTION: CHAR_GENERATOR
;
;	USED TO GENERATE SPECIAL CHARACTERS (MAXIMUM 8 CHARS)
;	AND LOAD THEM TO CG_RAM OF LCD.

;	REGISTER USED:	R17,R18(LCD_REGISTER),ZH:ZL
;	NOTE: 
;**********************************************************
CHAR_GENERATOR:
    LDI     ZH,HIGH(USER_CHAR*2)        
    LDI     ZL,LOW(USER_CHAR*2)
	LDI		R17,__LCD_CGA
CG_LOOP:
	MOV		LCD_REGISTER,R17
	RCALL	LOOP_IF_LCD_BUSY
	RCALL	LCD_WRITE_INST
	LPM		LCD_REGISTER,Z+		
	RCALL	LOOP_IF_LCD_BUSY
	RCALL	LCD_WRITE_DATA
	INC		R17		
	CPI		R17,128
	BRLO	CG_LOOP
	RET

USER_CHAR:
.DB		0X00,0X00,0X00,0X00,0X00,0X00,0X00,0X00
.DB		0X00,0X18,0X1C,0X1C,0X0E,0X06,0X02,0X01
.DB		0X00,0X03,0X07,0X07,0X0E,0X0C,0X08,0X10
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.DB		0X1C,0X18,0X19,0X1F,0X1F,0X19,0X18,0X1C


str_MESSAGE1:
.DB	"**  HELLO WORLD!! **",0XFF
str_MESSAGE2:
.DB "THIS IS A TEST PROG.",0XFF
str_MESSAGE3:
.DB "*NULL ENDED STRING.*",0XFF
str_MESSAGE4:
.DB "*ZERO ENDED STRING.*",0X00
str_CHRONO_LINE:
.DB	"<<            Sec.>>",0XFF
str_CHRONO_MSG:
.DB	"*32BIT CHRONOMETER!*",0XFF
