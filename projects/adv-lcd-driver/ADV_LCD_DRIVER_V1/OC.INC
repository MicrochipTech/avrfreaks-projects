;**************************************************************************************************
;*                                                                                                *
;*                                      - RELEASE INFO -                                          *                
;*                                                                                                *
;**************************************************************************************************
;==================================================================================================
;					                    - GENERAL INFO -
;==================================================================================================
;
;   PROJECT      :  ADVENCED LCD DRIVER
;	SUB PROJECT	 :	32 BIT CHRONOMETER WITH 100mS RESOLUTION
;   AUTHOR       :  OMID KOMPANI
;   BOARD DESIGN :  OMID KOMPANI
;   LAST UPDATE  :  1386-01-05		2007-03-25
;   VERSION      :  V1.0
;--------------------------------------------------------------------------------------------------
;      
;   MCU          :  AVR ATMEGA16
;   CLOCK SOURCE :  EXTERNAL CRYSTAL 16.000 MHz OSCILATOR  
;   LANGUAGE     :  ASSEMBLY
;   ASSEMBLER    :  AVR ASM 1 
;   IDE          :  AVR STUDIO 4.10
;--------------------------------------------------------------------------------------------------
;==================================================================================================
;				                     - ABOUT THIS PROJECT -
;==================================================================================================   
;
;
;
;==================================================================================================
;                           - HARDWARE & SOFTWARE -  
;==================================================================================================
;
;   BOARD POWER  :  BIULTiN POWER SUPPLY
;					AC 220V INPUT AND DC 5V OUTPUT
;
;--------------------------------------------------------------------------------------------------
;   PORTS        :  PORTA [0..7]: LCD DATA BUS
;					PORTB
;						   5: LCD DATA/COMMAND SELECT(REGISTER SELECT)
;						   6: LCD READ/WRITE SELECT
;						   7: LCD STORBE

;					PORTF [4..7]: JTAG CONNECTOR
;						   4: TCK
;						   5: TMS
;						   6: TDO
;						   7: TDI
;   RELATED FILES:	
;--------------------------------------------------------------------------------------------------
