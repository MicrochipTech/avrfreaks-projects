_PicData:
	.DB  0xFF,0xFF,0xFF,0x3F,0x3F,0x7,0xF9,0xF9
	.DB  0x7,0xF9,0x31,0x7,0xFF,0xFF,0xFF,0x87
	.DB  0x3,0x1,0x3,0x1,0x7,0xF,0x3F,0x7F
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	.DB  0xFF,0xFF,0xF8,0xF0,0xE0,0xF0,0xE0,0xF8
	.DEF _satr=R4
	.DEF _hour=R5
_3:
	.DB  0xC
	.DEF _minute=R6
_4:
	.DB  0x3A
	.DEF _second=R7
_5:
	.DB  0x1E
	.DEF _weekday=R8
_6:
	.DB  0x6
	.DEF _monthday=R9
_7:
	.DB  0x7
	.DEF _monthyear=R10
_8:
	.DB  0x5
	.DEF _year=R11
_9:
	.DW  0x56A
	.DEF _char1=R13
	.DEF _char2=R14

__GLOBAL_INI_TBL:
	.DW  0x01
	.DW  0x05
	.DW  _3*2

	.DW  0x01
	.DW  0x06
	.DW  _4*2

	.DW  0x01
	.DW  0x07
	.DW  _5*2

	.DW  0x01
	.DW  0x08
	.DW  _6*2

	.DW  0x01
	.DW  0x09
	.DW  _7*2

	.DW  0x01
	.DW  0x0A
	.DW  _8*2

	.DW  0x02
	.DW  0x0B
	.DW  _9*2

	.DW  0
