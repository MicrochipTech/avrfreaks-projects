; The total length of the report descriptor is 
; 78 bytes.

rd_length:
.db 78, 0

report_descriptor:
.db	0x05, 0x01
.db	0x15, 0x00
.db	0x09, 0x04
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.db	0x02, 0xc0


; Descriptor structure:
;0x05, 0x01     ;USAGE_PAGE (Generic Desktop)
;0x15, 0x00,		;LOGICAL_MINIMUM (0)
;0x09, 0x04,		;USAGE (Joystick)
;0xa1, 0x01,		;COLLECTION (Application)
;0x05, 0x02,		;  USAGE_PAGE (Simulation Controls)
;0x09, 0xbb,		;  USAGE (Throttle)
;0x15, 0x00,		;  LOGICAL_MINIMUM (0)
;0x26, 0xff, 0x00,	;  LOGICAL_MAXIMUM (255)
;0x75, 0x08,		;  REPORT_SIZE (8)
;0x95, 0x01,		;  REPORT_COUNT (1)
;0x81, 0x02,		;  INPUT (Data Var Abs)
;0x05, 0x01,		;  USAGE_PAGE (Generic Desktop)
;0x09, 0x01,		;  USAGE (Pointer)
;0xa1, 0x00,		;  COLLECTION (Physical)
;0x09, 0x30,		;	USAGE (X)
;0x09, 0x31,		;	USAGE (Y)
;0x95, 0x02,		;	REPORT_COUNT (2)
;0x81, 0x02,		;	INPUT (Data Var Abs)
;0xc0, 			;  END_COLLECTION
;0x09, 0x39, 		;  USAGE (Hat switch)
;0x15, 0x00, 		;  LOGICAL_MINIMUM (0)
;0x25, 0x03,		;  LOGICAL_MAXIMUM (3)
;0x35, 0x00, 		;  PHYSICAL_MINIMUM (0)
;0x46, 0x0e, 0x01,	;  PHYSICAL_MAXIMUM (270)
;0x65, 0x14,		;  UNIT (Eng Rot:Angular Pos)
;0x75, 0x04,		;  REPORT_SIZE (4)
;0x95, 0x01,		;  REPORT_COUNT (1)
;0x81, 0x02,		;  INPUT (Data Var Abs)
;0x05, 0x09,		;  USAGE_PAGE (Button)
;0x19, 0x01,		; USAGE_MINIMUM (Button 1)
;0x29, 0x04,		; USAGE_MAXIMUM (Button 4)
;0x15, 0x00,		;  LOGICAL_MINIMUM (0)
;0x25, 0x01,		;  LOGICAL_MAXIMUM (1)
;0x75, 0x01,		;  REPORT_SIZE (1)
;0x95, 0x04,		;  REPORT_COUNT (4)
;0x55, 0x00,		;  UNIT_EXPONENT (0)
;0x65, 0x00,		;  UNIT (None)
;0x81, 0x02,		;  INPUT (Data Var Abs)
;0xc0			;END_COLLECTION

