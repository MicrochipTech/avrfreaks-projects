; ISDAVR.inc
; Definitions for the AVR ISDs
; These ID values *MUST* match those in the Studio+ AVR DLL.

.equ FAMILY_ATMELAVR = 1

.equ CHIP_AT90S1200 = 1
.equ CHIP_AT90S2313 = 2
.equ CHIP_AT90S2323 = 3
.equ CHIP_AT90S2343 = 4
.equ CHIP_AT90S2333 = 5
.equ CHIP_AT90S4433 = 6
.equ CHIP_AT90S4414 = 7
.equ CHIP_AT90S4434 = 8
.equ CHIP_AT90C8534 = 9
.equ CHIP_AT90S8515 = 10
.equ CHIP_AT90S8535 = 11
.equ CHIP_ATMEGA8 = 12
.equ CHIP_ATMEGA16 = 13
.equ CHIP_ATMEGA161 = 14
.equ CHIP_ATMEGA163 = 15
.equ CHIP_ATMEGA323 = 16
.equ CHIP_ATMEGA64 = 17
.equ CHIP_ATMEGA103 = 18
.equ CHIP_ATMEGA128 = 19
.equ CHIP_ATTINY11 = 20
.equ CHIP_ATTINY12 = 21
.equ CHIP_ATTINY15 = 22
.equ CHIP_ATTINY22 = 23
.equ CHIP_ATTINY28 = 24
