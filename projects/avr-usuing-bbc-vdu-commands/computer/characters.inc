;Character patterns have to be stored in program flash
.cseg
.org 0x1C00
NORMAL_CHARACTER_PATTERNS:
;characters can all be found in programme memory at 0x1800 + ASCII value * 8
.db  0x0,0x0,0x0,0x0,0x0,0x0,0x0,0x0     ;  
.db  0x0,0x0,0x2F,0x2F,0x0,0x0,0x0,0x0     ; !
.db  0x0,0x1,0x3,0x0,0x1,0x3,0x0,0x0     ; "
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.db  0x60,0x30,0x18,0xC,0x6,0x3,0x1,0x0     ; /
.db  0x0,0x1E,0x3F,0x39,0x27,0x3F,0x1E,0x0     ; 0
.db  0x0,0x0,0x22,0x3F,0x3F,0x20,0x0,0x0     ; 1
.db  0x0,0x22,0x33,0x39,0x3D,0x2F,0x36,0x0     ; 2
.db  0x0,0x13,0x31,0x25,0x25,0x3F,0x1A,0x0     ; 3
.db  0xC,0xE,0xB,0x29,0x3F,0x3F,0x28,0x0     ; 4
.db  0x17,0x35,0x25,0x25,0x25,0x3D,0x1B,0x0     ; 5
.db  0x1E,0x3F,0x25,0x25,0x25,0x3D,0x18,0x0     ; 6
.db  0x3,0x1,0x21,0x39,0x3D,0x27,0x3,0x0     ; 7
.db  0x1A,0x3F,0x25,0x25,0x25,0x3F,0x1A,0x0     ; 8
.db  0x6,0x2F,0x29,0x29,0x29,0x3F,0x1E,0x0     ; 9
.db  0x0,0x0,0x0,0x24,0x24,0x0,0x0,0x0     ; :
.db  0x0,0x0,0x40,0x64,0x24,0x0,0x0,0x0     ; ;
.db  0x8,0x8,0x1C,0x14,0x36,0x22,0x22,0x0     ; <
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.db  0xFF,0xFF,0xFF,0xFF,0xFF,0xFF,0xFF,0xFF     ; 	Solid Block

;NARROW FONT!
.org 0x1DC0
.db  0x0,0x0,0x0,0x0     ;  
.db  0x0,0x5F,0x0,0x0     ; !
.db  0x0,0x3,0x0,0x3     ; "
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.db  0x30,0xC,0x3,0x0     ; /
.db  0x1E,0x33,0x1E,0x0     ; 0
.db  0x2,0x3F,0x0,0x0     ; 1
.db  0x32,0x29,0x26,0x0     ; 2
.db  0x11,0x25,0x1B,0x0     ; 3
.db  0xE,0x9,0x3F,0x0     ; 4
.db  0x17,0x25,0x1D,0x0     ; 5
.db  0x1E,0x25,0x19,0x0     ; 6
.db  0x3,0x39,0x7,0x0     ; 7
.db  0x1A,0x25,0x1A,0x0     ; 8
.db  0x26,0x29,0x1E,0x0     ; 9
.db  0x0,0x24,0x0,0x0     ; :
.db  0x0,0x64,0x0,0x0     ; ;
.db  0x8,0x14,0x22,0x0     ; <
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.db  0x33,0xC,0xC,0x33     ; .

.org 0x1eA0
KEYBOARD_CODES:
;ASCII codes for each key in order of key code

UNSHIFTED_CODES:

.db	0x00,0x00		;0,1
.db	0x00,0x6A		;2,3				J
.db	0x00,0x62		;4,5				B
.db	0x00,0x00		;6,7	Address Book	
.db	0x00,0x09		;8,9				right
.db	0x00,0x76		;a,b				V
.db	0x00,0x75		;c,d				U
.db	0x69,0x00		;e,f	I
.db	0x00,0x00		;10
.db	0x00,0x00		;12
.db	0x00,0x00		;14				fax
.db	0x08,0x00		;16	left
.db	0x00,0x00		;18
.db	0x00,0x35		;1a	mobile		5
.db	0x00,0x36		;1c	email			6
.db	0x37,0x00		;1e	7
.db	0x00,0x71		;20				Q
.db	0x34,0x77		;22	4			W
.db	0x65,0x00		;24	E
.db	0x72,0x00		;26	R
.db	0x00,0x67		;28				G
.db	0x00,0x00		;2a	text message
.db	0x0D,0x00		;2c	enter
.db	0x0A,0x00		;2e	down
.db	0x00,0x61		;30				A
.db	0x6F,0x73		;32	O			S
.db	0x70,0x64		;34	P			D
.db	0x66,0x00		;36	F
.db	0x00,0x00		;38
.db	0x6C,0x40		;3a	L			@
.db	0x00,0x7A		;3c				z
.db	0x0B,0x00		;3e	up
.db	0x00,0x6E		;40				N
.db	0x6D,0x2E		;42	M			.
.db	0x2C,0x00		;44	,
.db	0x00,0x00		;46	services
.db	0x00,0x00		;48				symbol
.db	0x00,0x20		;4a				space
.db	0x00,0x00		;4c
.db	0x78,0x00		;4e	X
.db	0x00,0x00		;50
.db	0x74,0x00		;52	T
.db	0x63,0x00		;54	C
.db	0x00,0x00		;56
.db	0x00,0x00		;58
.db	0x00,0x68		;5a	H
.db	0x00,0x79		;5c	Y
.db	0x00,0x00		;5e
.db	0x00,0x00		;60
.db	0x00,0x00		;62
.db	0x00,0x00		;64
.db	0x00,0x00		;66
.db	0x00,0x00		;68				office
.db	0x00,0x33		;6a				3
.db	0x7F,0x00		;6c	DEL
.db	0x00,0x00		;6e
.db	0x00,0x1B		;70	store			stop
.db	0x00,0x32		;72	home			2
.db	0x31,0x30		;74	1			0
.db	0x6B,0x00		;76	K			internet
.db	0x00,0x38		;78				8
.db	0x00,0x00		;7a	setup
.db	0x00,0x39		;7c	games			9
.db	0x00,0x00		;7e


SHIFTED_CODES:

.db	0x00,0x00		;0,1
.db	0x00,0x4A		;2,3				J
.db	0x00,0x42		;4,5				B
.db	0x00,0x00		;6,7	Address Book	
.db	0x00,0x09		;8,9				right
.db	0x00,0x56		;a,b				V
.db	0x00,0x55		;c,d				U
.db	0x49,0x00		;e,f	I
.db	0x00,0x00		;10
.db	0x00,0x00		;12
.db	0x00,0x00		;14				fax
.db	0x08,0x00		;16	left
.db	0x00,0x00		;18
.db	0x00,0x25		;1a	mobile		%
.db	0x00,0x3D		;1c	email			=
.db	0x5B,0x00		;1e	[
.db	0x00,0x51		;20				Q
.db	0x24,0x57		;22	4			W
.db	0x45,0x00		;24	E
.db	0x52,0x00		;26	R
.db	0x00,0x47		;28				G
.db	0x00,0x00		;2a	text message
.db	0x0D,0x00		;2c	enter
.db	0x0A,0x00		;2e	down
.db	0x00,0x41		;30				A
.db	0x4F,0x53		;32	O			S
.db	0x50,0x44		;34	P			D
.db	0x46,0x00		;36	F
.db	0x00,0x00		;38
.db	0x4C,0x27		;3a	L			'
.db	0x00,0x5A		;3c				z
.db	0x0B,0x00		;3e	up
.db	0x00,0x4E		;40				N
.db	0x4D,0x3F		;42	M			?
.db	0x3B,0x00		;44	;
.db	0x00,0x00		;46	services
.db	0x00,0x00		;48				symbol
.db	0x00,0x20		;4a				space
.db	0x00,0x00		;4c
.db	0x58,0x00		;4e	X
.db	0x00,0x00		;50
.db	0x54,0x00		;52	T
.db	0x43,0x00		;54	C
.db	0x00,0x00		;56
.db	0x00,0x00		;58
.db	0x00,0x48		;5a	H
.db	0x00,0x59		;5c	Y
.db	0x00,0x00		;5e
.db	0x00,0x00		;60
.db	0x00,0x00		;62
.db	0x00,0x00		;64
.db	0x00,0x00		;66
.db	0x00,0x00		;68				office
.db	0x00,0x60		;6a				£
.db	0x7F,0x00		;6c	DEL
.db	0x00,0x00		;6e
.db	0x00,0x1B		;70	store			stop
.db	0x00,0x22		;72	home			"
.db	0x21,0x2D		;74	!			-
.db	0x4B,0x00		;76	K			internet
.db	0x00,0x2A		;78				*
.db	0x00,0x00		;7a	setup
.db	0x00,0x28		;7c	games			)
.db	0x00,0x00		;7e

SYMBOL_CODES:

.db	0x00,0x00		;0,1
.db	0x00,0x4A		;2,3				J
.db	0x00,0x42		;4,5				B
.db	0x00,0x00		;6,7	Address Book	
.db	0x00,0x09		;8,9				<right>	
.db	0x00,0x56		;a,b				V
.db	0x00,0x7D		;c,d				}
.db	0x49,0x00		;e,f	I
.db	0x00,0x00		;10
.db	0x00,0x00		;12
.db	0x00,0x00		;14				fax
.db	0x08,0x00		;16	<left>
.db	0x00,0x00		;18
.db	0x00,0x26		;1a	mobile		&
.db	0x00,0x2B		;1c	email			+
.db	0x5D,0x00		;1e	]
.db	0x00,0x51		;20				Q
.db	0x23,0x57		;22	4			W
.db	0x45,0x00		;24	E
.db	0x00,0x00		;26	<degree>
.db	0x00,0x27		;28				`
.db	0x00,0x00		;2a	text message
.db	0x0D,0x00		;2c	enter
.db	0x0A,0x00		;2e	<down>
.db	0x00,0x27		;30				'
.db	0x4F,0x53		;32	O			S
.db	0x50,0x44		;34	P			D
.db	0x46,0x00		;36	F
.db	0x00,0x00		;38
.db	0x4C,0x5C		;3a	L			\
.db	0x00,0x5A		;3c				z
.db	0x0B,0x00		;3e	up
.db	0x00,0x4E		;40				N
.db	0x4D,0x2F		;42	M			/
.db	0x3A,0x00		;44	:
.db	0x00,0x00		;46	services
.db	0x00,0x00		;48				symbol
.db	0x00,0x20		;4a				space
.db	0x00,0x00		;4c
.db	0x58,0x00		;4e	X
.db	0x00,0x00		;50
.db	0x7E,0x00		;52	~
.db	0x43,0x00		;54	C
.db	0x00,0x00		;56
.db	0x00,0x00		;58
.db	0x00,0x5E		;5a				^
.db	0x00,0x59		;5c	Y
.db	0x00,0x00		;5e
.db	0x00,0x00		;60
.db	0x00,0x00		;62
.db	0x00,0x00		;64
.db	0x00,0x00		;66
.db	0x00,0x00		;68				office
.db	0x00,0x00		;6a				<euro>
.db	0x7F,0x00		;6c	DEL
.db	0x00,0x00		;6e
.db	0x00,0x1B		;70	store			stop
.db	0x00,0x3E		;72	home			>
.db	0x3C,0x5F		;74	<			_
.db	0x4B,0x00		;76	K			internet
.db	0x00,0x7B		;78				{
.db	0x00,0x00		;7a	setup
.db	0x00,0x29		;7c	games			)
.db	0x00,0x00		;7e

;print is 0x83

