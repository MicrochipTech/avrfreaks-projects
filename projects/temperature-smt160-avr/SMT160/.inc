
	.DEF _full=R4
	.DEF _half=R6
	.DEF _edge=R9
_3:
	.DB  0x1
_15:
	.DB  0x80,0xC0
	.DEF __lcd_x=R8
	.DEF __lcd_y=R11
	.DEF __lcd_maxx=R10
__fround_G3:
	.DB  0x0,0x0,0x0,0x3F,0xCD,0xCC,0x4C,0x3D
	.DB  0xA,0xD7,0xA3,0x3B,0x6F,0x12,0x3,0x3A
	.DB  0x17,0xB7,0x51,0x38,0xAC,0xC5,0xA7,0x36
	.DB  0xBD,0x37,0x6,0x35
_tbl10_G4:
	.DB  0x10,0x27,0xE8,0x3,0x64,0x0,0xA,0x0
	.DB  0x1,0x0
_tbl16_G4:
	.DB  0x0,0x10,0x0,0x1,0x10,0x0,0x1,0x0
_223:
	.DW  0x00
_0:
	.DB  0x54,0x65,0x6D,0x70,0x3A,0xA,0x0,0x44
	.DB  0x2E,0x43,0x2E,0x3A,0x0,0x20,0x43,0x0
	.DB  0x20,0x25,0x0

__GLOBAL_INI_TBL:
	.DW  0x01
	.DW  0x09
	.DW  _3*2

	.DW  0x02
	.DW  __base_y_G2
	.DW  _15*2

	.DW  0x02
	.DW  _p_S65
	.DW  _223*2

	.DW  0
_0xE7:
