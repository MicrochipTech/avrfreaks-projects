_3:
	.DB  0x24
_4:
	.DB  0x1
_5:
	.DB  0xA1
_6:
	.DB  0x2
_7:
	.DB  0xF0
_8:
	.DB  0x3
_9:
	.DB  0x3
_10:
	.DB  0x4
_11:
	.DB  0x27
_12:
	.DB  0x5
_13:
	.DB  0xEF
_14:
	.DB  0x6
_15:
	.DB  0x7
_16:
	.DB  0x1
_17:
	.DB  0x8
_18:
	.DB  0x3
_19:
	.DB  0x9
_20:
	.DB  0x5
_21:
	.DB  0xA
_22:
	.DB  0xB
_23:
	.DB  0xB
_24:
	.DB  0xC
_25:
	.DB  0xD
_26:
	.DB  0xE
_27:
	.DB  0xF
_28:
	.DB  0x10
_29:
	.DB  0x11
_30:
	.DB  0x12
_31:
	.DB  0xFF
_32:
	.DB  0x13
_33:
	.DB  0x3
_34:
	.DB  0x18
_35:
	.DB  0x19
_36:
	.DB  0x1A
_37:
	.DB  0x1B
_38:
	.DB  0x1C
_39:
	.DB  0xFF
_FontTable:
	.DB  0x0,0x0,0x0,0x0,0x0,0x0,0x0,0x0
	.DB  0x30,0x78,0x78,0x30,0x30,0x0,0x30,0x0
	.DB  0x6C,0x6C,0x6C,0x0,0x0,0x0,0x0,0x0
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	.DB  0xFF,0xFF,0xFF,0xFF,0xFF,0xFF,0xFF,0xFF
	.DEF _Xbak_S2=R4
	.DEF _Ybak_S2=R6
_67:
	.DB  0x24
_68:
	.DB  0x1
_69:
	.DB  0xA1
_70:
	.DB  0x2
_71:
	.DB  0xF0
_72:
	.DB  0x3
_73:
	.DB  0x3
_74:
	.DB  0x4
_75:
	.DB  0x27
_76:
	.DB  0x5
_77:
	.DB  0xEF
_78:
	.DB  0x6
_79:
	.DB  0x7
_80:
	.DB  0x1
_81:
	.DB  0x8
_82:
	.DB  0x3
_83:
	.DB  0x9
_84:
	.DB  0x5
_85:
	.DB  0xA
_86:
	.DB  0xB
_87:
	.DB  0xB
_88:
	.DB  0xC
_89:
	.DB  0xD
_90:
	.DB  0xE
_91:
	.DB  0xF
_92:
	.DB  0x10
_93:
	.DB  0x11
_94:
	.DB  0x12
_95:
	.DB  0xFF
_96:
	.DB  0x13
_97:
	.DB  0x3
_98:
	.DB  0x18
_99:
	.DB  0x19
_100:
	.DB  0x1A
_101:
	.DB  0x1B
_102:
	.DB  0x1C
_103:
	.DB  0xFF
_LUT_16:
	.DB  0x0,0x0,0x0,0x0,0x0,0xA0,0x0,0xA0
	.DB  0x0,0x0,0xA0,0xA0,0xA0,0x0,0x0,0xA0
	.DB  0x0,0xA0,0xA0,0xA0,0x0,0xA0,0xA0,0xA0
	.DB  0x0,0x0,0x0,0x0,0x0,0xF0,0x0,0xF0
	.DB  0x0,0x0,0xF0,0xF0,0xF0,0x0,0x0,0xF0
	.DB  0x0,0xF0,0xF0,0xF0,0x0,0xF0,0xF0,0xF0
_LUT_256:
	.DB  0x0,0x0,0x0,0x0,0x0,0xA0,0x0,0xA0
	.DB  0x0,0x0,0xA0,0xA0,0xA0,0x0,0x0,0xA0
	.DB  0x0,0xA0,0xA0,0xA0,0x0,0xA0,0xA0,0xA0
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	.DB  0xD0,0xF0,0xE0,0xE0,0xF0,0xF0,0xF0,0xF0
_LUT_256_BMP:
	.DB  0x0,0x0,0x0,0x0,0x0,0x80,0x0,0x80
	.DB  0x0,0x0,0x80,0x80,0x80,0x0,0x0,0x80
	.DB  0x0,0x80,0x80,0x80,0x0,0xC0,0xC0,0xC0
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	.DB  0x0,0xFF,0xFF,0xFF,0x0,0xFF,0xFF,0xFF
_LUT_16_BMP:
	.DB  0x0,0x0,0x0,0x0,0x0,0x80,0x0,0x80
	.DB  0x0,0x0,0x80,0x80,0x80,0x0,0x0,0x80
	.DB  0x0,0x80,0x80,0x80,0x0,0x80,0x80,0x80
	.DB  0xC0,0xC0,0xC0,0x0,0x0,0xF0,0x0,0xF0
	.DB  0x0,0x0,0xF0,0xF0,0xF0,0x0,0x0,0xF0
	.DB  0x0,0xF0,0xF0,0xF0,0x0,0xF0,0xF0,0xF0
_234:
	.DB  0x24
_235:
	.DB  0x1
_236:
	.DB  0xA1
_237:
	.DB  0x2
_238:
	.DB  0xF0
_239:
	.DB  0x3
_240:
	.DB  0x3
_241:
	.DB  0x4
_242:
	.DB  0x27
_243:
	.DB  0x5
_244:
	.DB  0xEF
_245:
	.DB  0x6
_246:
	.DB  0x7
_247:
	.DB  0x1
_248:
	.DB  0x8
_249:
	.DB  0x3
_250:
	.DB  0x9
_251:
	.DB  0x5
_252:
	.DB  0xA
_253:
	.DB  0xB
_254:
	.DB  0xB
_255:
	.DB  0xC
_256:
	.DB  0xD
_257:
	.DB  0xE
_258:
	.DB  0xF
_259:
	.DB  0x10
_260:
	.DB  0x11
_261:
	.DB  0x12
_262:
	.DB  0xFF
_263:
	.DB  0x13
_264:
	.DB  0x3
_265:
	.DB  0x18
_266:
	.DB  0x19
_267:
	.DB  0x1A
_268:
	.DB  0x1B
_269:
	.DB  0x1C
_270:
	.DB  0xFF
_0x12B:
	.DB  0x0,0x13
	.DB  0x0,0x0
_306:
	.DB  0x24
_307:
	.DB  0x1
_308:
	.DB  0xA1
_309:
	.DB  0x2
_310:
	.DB  0xF0
_311:
	.DB  0x3
_312:
	.DB  0x3
_313:
	.DB  0x4
_314:
	.DB  0x27
_315:
	.DB  0x5
_316:
	.DB  0xEF
_317:
	.DB  0x6
_318:
	.DB  0x7
_319:
	.DB  0x1
_320:
	.DB  0x8
_321:
	.DB  0x3
_322:
	.DB  0x9
_323:
	.DB  0x5
_324:
	.DB  0xA
_325:
	.DB  0xB
_326:
	.DB  0xB
_327:
	.DB  0xC
_328:
	.DB  0xD
_329:
	.DB  0xE
_330:
	.DB  0xF
_331:
	.DB  0x10
_332:
	.DB  0x11
_333:
	.DB  0x12
_334:
	.DB  0xFF
_335:
	.DB  0x13
_336:
	.DB  0x3
_337:
	.DB  0x18
_338:
	.DB  0x19
_339:
	.DB  0x1A
_340:
	.DB  0x1B
_341:
	.DB  0x1C
_342:
	.DB  0xFF
_0x175:
	.DB  0x1,0x0
_tbl10_G9:
	.DB  0x10,0x27,0xE8,0x3,0x64,0x0,0xA,0x0
	.DB  0x1,0x0
_tbl16_G9:
	.DB  0x0,0x10,0x0,0x1,0x10,0x0,0x1,0x0
_0:
	.DB  0xA,0xD,0x47,0x69,0x76,0x65,0x20,0x50
	.DB  0x61,0x67,0x65,0x20,0x6E,0x75,0x6D,0x62
	.DB  0x65,0x72,0x28,0x30,0x20,0x74,0x6F,0x20
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	.DB  0x0

__GLOBAL_INI_TBL:
	.DW  0x01
	.DW  _1aS1DRegs_G1
	.DW  _3*2

	.DW  0x01
	.DW  _2aS1DRegs_G1
	.DW  _4*2

	.DW  0x01
	.DW  _3aS1DRegs_G1
	.DW  _5*2

	.DW  0x01
	.DW  _4aS1DRegs_G1
	.DW  _6*2

	.DW  0x01
	.DW  _5aS1DRegs_G1
	.DW  _7*2

	.DW  0x01
	.DW  _6aS1DRegs_G1
	.DW  _8*2

	.DW  0x01
	.DW  _7aS1DRegs_G1
	.DW  _9*2

	.DW  0x01
	.DW  _8aS1DRegs_G1
	.DW  _10*2

	.DW  0x01
	.DW  _9aS1DRegs_G1
	.DW  _11*2

	.DW  0x01
	.DW  _AaS1DRegs_G1
	.DW  _12*2

	.DW  0x01
	.DW  _BaS1DRegs_G1
	.DW  _13*2

	.DW  0x01
	.DW  _CaS1DRegs_G1
	.DW  _14*2

	.DW  0x01
	.DW  _EaS1DRegs_G1
	.DW  _15*2

	.DW  0x01
	.DW  _FaS1DRegs_G1
	.DW  _16*2

	.DW  0x01
	.DW  _10aS1DRegs_G1
	.DW  _17*2

	.DW  0x01
	.DW  _11aS1DRegs_G1
	.DW  _18*2

	.DW  0x01
	.DW  _12aS1DRegs_G1
	.DW  _19*2

	.DW  0x01
	.DW  _13aS1DRegs_G1
	.DW  _20*2

	.DW  0x01
	.DW  _14aS1DRegs_G1
	.DW  _21*2

	.DW  0x01
	.DW  _15aS1DRegs_G1
	.DW  _22*2

	.DW  0x01
	.DW  _16aS1DRegs_G1
	.DW  _23*2

	.DW  0x01
	.DW  _18aS1DRegs_G1
	.DW  _24*2

	.DW  0x01
	.DW  _1AaS1DRegs_G1
	.DW  _25*2

	.DW  0x01
	.DW  _1CaS1DRegs_G1
	.DW  _26*2

	.DW  0x01
	.DW  _1EaS1DRegs_G1
	.DW  _27*2

	.DW  0x01
	.DW  _20aS1DRegs_G1
	.DW  _28*2

	.DW  0x01
	.DW  _22aS1DRegs_G1
	.DW  _29*2

	.DW  0x01
	.DW  _24aS1DRegs_G1
	.DW  _30*2

	.DW  0x01
	.DW  _25aS1DRegs_G1
	.DW  _31*2

	.DW  0x01
	.DW  _26aS1DRegs_G1
	.DW  _32*2

	.DW  0x01
	.DW  _27aS1DRegs_G1
	.DW  _33*2

	.DW  0x01
	.DW  _28aS1DRegs_G1
	.DW  _34*2

	.DW  0x01
	.DW  _2AaS1DRegs_G1
	.DW  _35*2

	.DW  0x01
	.DW  _2CaS1DRegs_G1
	.DW  _36*2

	.DW  0x01
	.DW  _2EaS1DRegs_G1
	.DW  _37*2

	.DW  0x01
	.DW  _30aS1DRegs_G1
	.DW  _38*2

	.DW  0x01
	.DW  _31aS1DRegs_G1
	.DW  _39*2

	.DW  0x01
	.DW  _1aS1DRegs_G2
	.DW  _67*2

	.DW  0x01
	.DW  _2aS1DRegs_G2
	.DW  _68*2

	.DW  0x01
	.DW  _3aS1DRegs_G2
	.DW  _69*2

	.DW  0x01
	.DW  _4aS1DRegs_G2
	.DW  _70*2

	.DW  0x01
	.DW  _5aS1DRegs_G2
	.DW  _71*2

	.DW  0x01
	.DW  _6aS1DRegs_G2
	.DW  _72*2

	.DW  0x01
	.DW  _7aS1DRegs_G2
	.DW  _73*2

	.DW  0x01
	.DW  _8aS1DRegs_G2
	.DW  _74*2

	.DW  0x01
	.DW  _9aS1DRegs_G2
	.DW  _75*2

	.DW  0x01
	.DW  _AaS1DRegs_G2
	.DW  _76*2

	.DW  0x01
	.DW  _BaS1DRegs_G2
	.DW  _77*2

	.DW  0x01
	.DW  _CaS1DRegs_G2
	.DW  _78*2

	.DW  0x01
	.DW  _EaS1DRegs_G2
	.DW  _79*2

	.DW  0x01
	.DW  _FaS1DRegs_G2
	.DW  _80*2

	.DW  0x01
	.DW  _10aS1DRegs_G2
	.DW  _81*2

	.DW  0x01
	.DW  _11aS1DRegs_G2
	.DW  _82*2

	.DW  0x01
	.DW  _12aS1DRegs_G2
	.DW  _83*2

	.DW  0x01
	.DW  _13aS1DRegs_G2
	.DW  _84*2

	.DW  0x01
	.DW  _14aS1DRegs_G2
	.DW  _85*2

	.DW  0x01
	.DW  _15aS1DRegs_G2
	.DW  _86*2

	.DW  0x01
	.DW  _16aS1DRegs_G2
	.DW  _87*2

	.DW  0x01
	.DW  _18aS1DRegs_G2
	.DW  _88*2

	.DW  0x01
	.DW  _1AaS1DRegs_G2
	.DW  _89*2

	.DW  0x01
	.DW  _1CaS1DRegs_G2
	.DW  _90*2

	.DW  0x01
	.DW  _1EaS1DRegs_G2
	.DW  _91*2

	.DW  0x01
	.DW  _20aS1DRegs_G2
	.DW  _92*2

	.DW  0x01
	.DW  _22aS1DRegs_G2
	.DW  _93*2

	.DW  0x01
	.DW  _24aS1DRegs_G2
	.DW  _94*2

	.DW  0x01
	.DW  _25aS1DRegs_G2
	.DW  _95*2

	.DW  0x01
	.DW  _26aS1DRegs_G2
	.DW  _96*2

	.DW  0x01
	.DW  _27aS1DRegs_G2
	.DW  _97*2

	.DW  0x01
	.DW  _28aS1DRegs_G2
	.DW  _98*2

	.DW  0x01
	.DW  _2AaS1DRegs_G2
	.DW  _99*2

	.DW  0x01
	.DW  _2CaS1DRegs_G2
	.DW  _100*2

	.DW  0x01
	.DW  _2EaS1DRegs_G2
	.DW  _101*2

	.DW  0x01
	.DW  _30aS1DRegs_G2
	.DW  _102*2

	.DW  0x01
	.DW  _31aS1DRegs_G2
	.DW  _103*2

	.DW  0x01
	.DW  _1aS1DRegs_G5
	.DW  _234*2

	.DW  0x01
	.DW  _2aS1DRegs_G5
	.DW  _235*2

	.DW  0x01
	.DW  _3aS1DRegs_G5
	.DW  _236*2

	.DW  0x01
	.DW  _4aS1DRegs_G5
	.DW  _237*2

	.DW  0x01
	.DW  _5aS1DRegs_G5
	.DW  _238*2

	.DW  0x01
	.DW  _6aS1DRegs_G5
	.DW  _239*2

	.DW  0x01
	.DW  _7aS1DRegs_G5
	.DW  _240*2

	.DW  0x01
	.DW  _8aS1DRegs_G5
	.DW  _241*2

	.DW  0x01
	.DW  _9aS1DRegs_G5
	.DW  _242*2

	.DW  0x01
	.DW  _AaS1DRegs_G5
	.DW  _243*2

	.DW  0x01
	.DW  _BaS1DRegs_G5
	.DW  _244*2

	.DW  0x01
	.DW  _CaS1DRegs_G5
	.DW  _245*2

	.DW  0x01
	.DW  _EaS1DRegs_G5
	.DW  _246*2

	.DW  0x01
	.DW  _FaS1DRegs_G5
	.DW  _247*2

	.DW  0x01
	.DW  _10aS1DRegs_G5
	.DW  _248*2

	.DW  0x01
	.DW  _11aS1DRegs_G5
	.DW  _249*2

	.DW  0x01
	.DW  _12aS1DRegs_G5
	.DW  _250*2

	.DW  0x01
	.DW  _13aS1DRegs_G5
	.DW  _251*2

	.DW  0x01
	.DW  _14aS1DRegs_G5
	.DW  _252*2

	.DW  0x01
	.DW  _15aS1DRegs_G5
	.DW  _253*2

	.DW  0x01
	.DW  _16aS1DRegs_G5
	.DW  _254*2

	.DW  0x01
	.DW  _18aS1DRegs_G5
	.DW  _255*2

	.DW  0x01
	.DW  _1AaS1DRegs_G5
	.DW  _256*2

	.DW  0x01
	.DW  _1CaS1DRegs_G5
	.DW  _257*2

	.DW  0x01
	.DW  _1EaS1DRegs_G5
	.DW  _258*2

	.DW  0x01
	.DW  _20aS1DRegs_G5
	.DW  _259*2

	.DW  0x01
	.DW  _22aS1DRegs_G5
	.DW  _260*2

	.DW  0x01
	.DW  _24aS1DRegs_G5
	.DW  _261*2

	.DW  0x01
	.DW  _25aS1DRegs_G5
	.DW  _262*2

	.DW  0x01
	.DW  _26aS1DRegs_G5
	.DW  _263*2

	.DW  0x01
	.DW  _27aS1DRegs_G5
	.DW  _264*2

	.DW  0x01
	.DW  _28aS1DRegs_G5
	.DW  _265*2

	.DW  0x01
	.DW  _2AaS1DRegs_G5
	.DW  _266*2

	.DW  0x01
	.DW  _2CaS1DRegs_G5
	.DW  _267*2

	.DW  0x01
	.DW  _2EaS1DRegs_G5
	.DW  _268*2

	.DW  0x01
	.DW  _30aS1DRegs_G5
	.DW  _269*2

	.DW  0x01
	.DW  _31aS1DRegs_G5
	.DW  _270*2

	.DW  0x01
	.DW  _1aS1DRegs_G6
	.DW  _306*2

	.DW  0x01
	.DW  _2aS1DRegs_G6
	.DW  _307*2

	.DW  0x01
	.DW  _3aS1DRegs_G6
	.DW  _308*2

	.DW  0x01
	.DW  _4aS1DRegs_G6
	.DW  _309*2

	.DW  0x01
	.DW  _5aS1DRegs_G6
	.DW  _310*2

	.DW  0x01
	.DW  _6aS1DRegs_G6
	.DW  _311*2

	.DW  0x01
	.DW  _7aS1DRegs_G6
	.DW  _312*2

	.DW  0x01
	.DW  _8aS1DRegs_G6
	.DW  _313*2

	.DW  0x01
	.DW  _9aS1DRegs_G6
	.DW  _314*2

	.DW  0x01
	.DW  _AaS1DRegs_G6
	.DW  _315*2

	.DW  0x01
	.DW  _BaS1DRegs_G6
	.DW  _316*2

	.DW  0x01
	.DW  _CaS1DRegs_G6
	.DW  _317*2

	.DW  0x01
	.DW  _EaS1DRegs_G6
	.DW  _318*2

	.DW  0x01
	.DW  _FaS1DRegs_G6
	.DW  _319*2

	.DW  0x01
	.DW  _10aS1DRegs_G6
	.DW  _320*2

	.DW  0x01
	.DW  _11aS1DRegs_G6
	.DW  _321*2

	.DW  0x01
	.DW  _12aS1DRegs_G6
	.DW  _322*2

	.DW  0x01
	.DW  _13aS1DRegs_G6
	.DW  _323*2

	.DW  0x01
	.DW  _14aS1DRegs_G6
	.DW  _324*2

	.DW  0x01
	.DW  _15aS1DRegs_G6
	.DW  _325*2

	.DW  0x01
	.DW  _16aS1DRegs_G6
	.DW  _326*2

	.DW  0x01
	.DW  _18aS1DRegs_G6
	.DW  _327*2

	.DW  0x01
	.DW  _1AaS1DRegs_G6
	.DW  _328*2

	.DW  0x01
	.DW  _1CaS1DRegs_G6
	.DW  _329*2

	.DW  0x01
	.DW  _1EaS1DRegs_G6
	.DW  _330*2

	.DW  0x01
	.DW  _20aS1DRegs_G6
	.DW  _331*2

	.DW  0x01
	.DW  _22aS1DRegs_G6
	.DW  _332*2

	.DW  0x01
	.DW  _24aS1DRegs_G6
	.DW  _333*2

	.DW  0x01
	.DW  _25aS1DRegs_G6
	.DW  _334*2

	.DW  0x01
	.DW  _26aS1DRegs_G6
	.DW  _335*2

	.DW  0x01
	.DW  _27aS1DRegs_G6
	.DW  _336*2

	.DW  0x01
	.DW  _28aS1DRegs_G6
	.DW  _337*2

	.DW  0x01
	.DW  _2AaS1DRegs_G6
	.DW  _338*2

	.DW  0x01
	.DW  _2CaS1DRegs_G6
	.DW  _339*2

	.DW  0x01
	.DW  _2EaS1DRegs_G6
	.DW  _340*2

	.DW  0x01
	.DW  _30aS1DRegs_G6
	.DW  _341*2

	.DW  0x01
	.DW  _31aS1DRegs_G6
	.DW  _342*2

	.DW  0
