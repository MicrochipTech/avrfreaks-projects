	.DEF _rx_wr_index=R4
	.DEF _rx_rd_index=R5
	.DEF _rx_counter=R6
	.DEF _tx_wr_index=R7
	.DEF _tx_rd_index=R8
	.DEF _tx_counter=R9
_menuline:
	.DB  0x20,0x41,0x29,0x39,0x32,0x30,0x30,0x20
	.DB  0x20,0x42,0x29,0x31,0x34,0x34,0x30,0x30
	.DB  0x20,0x0,0x0,0x0,0x20,0x43,0x29,0x31
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	.DB  0x6E,0x2F,0x6F,0x66,0x66,0x0,0x0,0x0
_uparrow:
	.DB  0x4,0xE,0x1F,0x4,0x4,0x4,0x4,0x4
_Downarrow:
	.DB  0x4,0x4,0x4,0x4,0x4,0x1F,0xE,0x4
_f2:
	.DB  0x1F,0x10,0x1C,0x17,0x11,0x12,0x14,0x17
_f3:
	.DB  0x1F,0x10,0x1C,0x17,0x11,0x13,0x11,0x17
_0x1D:
	.DB  0x0
_unshifted:
	.DB  0xD,0x9,0xE,0x60,0x15,0x71,0x16,0x31
	.DB  0x1A,0x7A,0x1B,0x73,0x1C,0x61,0x1D,0x77
	.DB  0x1E,0x32,0x21,0x63,0x22,0x78,0x23,0x64
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	.DB  0x7B,0x2D,0x7C,0x2A,0x7D,0x39
_shifted:
	.DB  0xD,0x9,0xE,0x7E,0x15,0x51,0x16,0x21
	.DB  0x1A,0x5A,0x1B,0x53,0x1C,0x41,0x1D,0x57
	.DB  0x1E,0x40,0x21,0x43,0x22,0x58,0x23,0x44
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	.DB  0x7B,0x2D,0x7C,0x2A,0x7D,0x39
	.DEF _edge=R10
	.DEF _bitcount=R11
	.DEF _inpt=R12
	.DEF _buffcnt=R14
_248:
	.DB  0x80,0xC0
_tbl10_G8:
	.DB  0x10,0x27,0xE8,0x3,0x64,0x0,0xA,0x0
	.DB  0x1,0x0
_tbl16_G8:
	.DB  0x0,0x10,0x0,0x1,0x10,0x0,0x1,0x0
_0:
	.DB  0x20,0x20,0x57,0x45,0x4C,0x43,0x4F,0x4D
	.DB  0x45,0x20,0x54,0x4F,0x20,0x44,0x41,0x4E
	.DB  0x53,0x0,0x20,0x20,0x20,0x4C,0x43,0x44
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	.DB  0x52,0x0,0x25,0x69,0x0

;DATA STACK END MARKER INITIALIZATION
__DSTACK_END:
	.DB  'D','S','T','A','C','K','E','N','D',0

;HARDWARE STACK END MARKER INITIALIZATION
__HSTACK_END:
	.DB  'H','S','T','A','C','K','E','N','D',0

__GLOBAL_INI_TBL:
	.DW  0x09
	.DW  0x60
	.DW  __DSTACK_END*2

	.DW  0x09
	.DW  0x23C
	.DW  __HSTACK_END*2

	.DW  0x02
	.DW  __base_y_G7
	.DW  _248*2

	.DW  0
