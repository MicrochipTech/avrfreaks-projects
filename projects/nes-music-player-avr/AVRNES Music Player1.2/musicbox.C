//NES音乐播放器   AVRNES Music Player1.2

//          BY张皓
//http://www.lotusinvention.cn/ART/nes/NESMusic.htm
//  ICC-AVR Target : ATMEGA16  Crystal: 8M,
#include <iom16v.h>
#include <macros.h>

#define uchar unsigned char
#define schar signed char
#define uint unsigned int  
#define sint signed int  
#define SET_BIT(io ,bit) (   io |=  (1<<bit) )   
#define CLR_BIT(io ,bit) (   io &= ~(1<<bit) )   
#define GET_BIT(pin,bit) ( pin &    (1<<bit) ) 

const uint music_dataRect0[]={20,15,48,52, 20,11,52,55, 17,15,55,59, 17,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9999,9999};
const uint music_dataRect1[]={136,10,48,52, 136,6,52,55, 102,10,55,59, 102,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1558,0};
const uint music_dataTriangle[]={34,48,55, 26,55,62, 20,62,69, 17,69,76, 20,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1583,0};
const uint music_dataNoise[]={343,1381,1523, 343,1530,0};





//方波0//////////////////
uint i0=0;// 数组位置
uint Tone0 ;//半音长(相当于频率)
uint fcounter0;//音长计数
uchar volume0;//音量 
uchar swap0=0;//切换开关

//方波1//////////////////
uint i1=0;// 数组位置
uint Tone1 ;//半音长(相当于频率)
uint fcounter1;//音长计数
uchar volume1;//音量 
uchar swap1=0;//切换开关

//三角波//////////////////
uint i2=0; 
uint Tone2 ; 
uint fcounter2; 
uchar volume2=6*8;//三角波音量固定为6 
uchar swap2=0; 

//杂波//////////////////
uint i3=0; 
uint Tone3 ; 
uint fcounter3; 
uchar volume3=4*8;//杂波音量固定 
uchar swap3=0; 

uint sum_volume;//总音量 
uint T=0;//时间计数


void init_devices(void)
{
    
    DDRD=0b10000000;  
    PORTD=0b10000000; 
    
    //#####定时器2/PD7(OC2)pwm控制音量,周期为32us(31.2KHz)######
    TCCR2=0X01;//内部CK/1脉冲
    SET_BIT(TCCR2,WGM20);    //快速PWM方式
    SET_BIT(TCCR2,WGM21);
    SET_BIT(TCCR2,COM21); //减1匹配置位
    OCR2=255;
    //####################
    
    //#####定时器1,周期为0.025ms对音频采样######
    SET_BIT(TCCR1B,CS11);//8分频	
    SET_BIT(TCCR1B,WGM12);//CTC方式,匹配清零后自动计数
    OCR1A=25;
    TCNT1=0;
    SET_BIT(TIMSK,OCIE1A);
    //####################
    
    //#####定时器0,周期为1/60s(16.67ms),对时间进行计数######
    SET_BIT(TCCR0,CS00);//1024分频
    SET_BIT(TCCR0,CS02);
    SET_BIT(TCCR0,WGM01);//CTC方式,匹配清零后自动计数
    OCR0=133;//定时时间
    TCNT0=0;
    SET_BIT(TIMSK,OCIE0);
    //####################
    
    
    
    SET_BIT(SREG,7);  //全局中断
}


void main(void)  
{
    init_devices();
    while(1)
    {
    }
}

void delay_1ms(void)//微秒级延时,单位1微秒
{
    uint i;
    for(i=0;i<(unsigned int)(8*143-2);i++);
}


void delay_ms(uint num)//毫秒级精确延时,单位1毫秒(8M)
{
    uint i;
    for(i=0;i<num;i++) delay_1ms();
}


//#####定时器0,周期为1/60s(16.67ms),对时间T进行计数
#pragma  interrupt_handler T0_counter:20
void T0_counter(void)  
{
    T++;
    
    if(music_dataRect0[i0]==9999)//到尾部了，从头开始
    {
        delay_ms(1000);
        i0=0;i1=0;i2=0;i3=0;
		volume0=0;volume1=0;volume2=0;volume3=0;
        T=0;
    }
    
    //方波0//////////////////
	if(T>=music_dataRect0[i0-1])volume0=0;//是否结束了
    if(T>=music_dataRect0[i0+2])
    {
        Tone0=music_dataRect0[i0];
        volume0=music_dataRect0[i0+1]*8;
        fcounter0=0;
        i0+=4;
    }    
    
    //方波1//////////////////
	if(T>=music_dataRect1[i1-1])volume1=0;//是否|结束时间|了
    if(T>=music_dataRect1[i1+2])
    {
        Tone1=music_dataRect1[i1];
        volume1=music_dataRect1[i1+1]*8;
        fcounter1=0;
        i1+=4;
    }   
    
    //三角波//////////////////
	if(T>=music_dataTriangle[i2-1])volume2=0;//是否|结束时间|了
    if(T>=music_dataTriangle[i2+1])
    {
        Tone2=music_dataTriangle[i2];
		volume2=6*8;
        fcounter2=0;
        i2+=3;
    }  
    
    //杂波
	if(T>=music_dataNoise[i3-1])volume3=0;//是否|结束时间|了
    if(T>=music_dataNoise[i3+1])
    {
        Tone3=music_dataNoise[i3];
		volume3=6*8;
        fcounter3=0;
        i3+=3;
    }  	  
    
}


//#####定时器1,周期为0.025ms对音频采样
#pragma  interrupt_handler T1_counter:7
void T1_counter(void)  
{
    
    //方波0//////////////////
    fcounter0++;//音长计数
    if(fcounter0==Tone0)
    {
        swap0=(~swap0);
        fcounter0=0;
    }
    
    //方波1//////////////////
    fcounter1++;//音长计数
    if(fcounter1==Tone1)
    {
        swap1=(~swap1);
        fcounter1=0;
    }
    
    //三角波//////////////////
    fcounter2++;//音长计数
    if(fcounter2==Tone2)
    {
        swap2=(~swap2);
        fcounter2=0;
    }
    
    //杂波
    fcounter3++;//音长计数
    if(fcounter3==Tone3)
    {
        swap3=(~swap3);
        fcounter3=0;
    }
    
    sum_volume=0;
    if(swap0) sum_volume=volume0;//音量相加
    if(swap1) sum_volume+=volume1;//音量相加
    if(swap2) sum_volume+=volume2;//音量相加	
    if(swap3) sum_volume+=volume3;//音量相加		
    if(sum_volume>255)sum_volume=255;//限制最大音量
    
    OCR2=sum_volume;
}


