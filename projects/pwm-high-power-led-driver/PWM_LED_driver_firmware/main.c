#include <avr/io.h>
#include <avr/interrupt.h>
#include <util/delay.h>
#include <avr/eeprom.h>

#include "config.h"
#include "pwm.h"

//makro do testowania stanu klawiszy klawiatury
#define TEST_PIN(NR) \
		if ( !(PIN_ ## NR & _BV(IN_ ## NR)) ) \
		{ cnt++; new_pos = NR; }
		
		
	
uint8_t value_r = 0x01;
uint8_t value_g	= 0x01;
uint8_t value_b = 0x01;

uint8_t EEMEM eeprom_red;
uint8_t EEMEM eeprom_green;
uint8_t EEMEM eeprom_blue;

ISR(BADISR_vect){};

int main(void)
{
	
	//inicjalizacja PWM
	PWM_T0_init();	//inicjalizacja trybu PWM dla dwóch kanałów
	PWM_T1_init();	//inicjalizacja trybu PWM dla dwóch kanałów
	
	sei();
	
	//konfiguracja portu klawiatury i wyjscia diody GREEN
	DDRD  = 0b00000000;
	DDRD |= _BV(6);				//PD6 jako wyjscie
	PORTD = 0b11111111; 		//podciagnij klawiature i zgas diode G
	
	//konfiguracja wyjscia dla diody RED i BLUE
	DDRB  |= (_BV(0) | _BV(1));	//PB0 i PB1 wyjscia
	PORTD |= (_BV(0) | _BV(1));	//zgas diody R i B
	
	
	//odczytaj dane dla PWM z eepromu 
	value_r = eeprom_read_byte(&eeprom_red);
	value_g = eeprom_read_byte(&eeprom_green);
	value_b = eeprom_read_byte(&eeprom_blue);

	//wylacz diode RGB
	PORT_OUT_G |= _BV(OUT_G);
	PORT_OUT_R |= _BV(OUT_R);
	PORT_OUT_B |= _BV(OUT_B);

	//miekki rozruch i ustalenie wartości początkowych PWM
	_delay_ms(200);

	//zmienne rozne
	uint8_t a=0;

	while(a!=value_r)
	{
		PWM_RED = a;
		_delay_ms(3);
		a++;
	}
	a=0;
	while(a!=value_g)
	{
		PWM_GREEN = a;
		_delay_ms(3);
		a++;
	}
	a=0;
	while(a!=value_b)
	{
		PWM_BLUE = a;
		_delay_ms(3);
		a++;
	}
		
	//petla nieskonczona
	
	uint8_t cnt, pos = 0, new_pos = 0;
	uint8_t mode = 0;
	
	while(1)
	{	
		cnt = 0;
		
		TEST_PIN(0);	//mode set
		TEST_PIN(1);	//down
		TEST_PIN(2);	//up
		TEST_PIN(3);	//store
		
		if (cnt != 1) 
			continue;
			
		if(new_pos == 0)	//mode set
		{
			_delay_ms(300);	// opoznienie pomiedzy trybami
			
			mode++;
			
			if(mode >= 5) mode = 0;

			//wyłącz wszystkie diody
			PORT_OUT_B |= _BV(OUT_B);
			PORT_OUT_G |= _BV(OUT_G);
			PORT_OUT_R |= _BV(OUT_R);

			switch(mode)
			{
				case 1:	PORT_OUT_R &= ~_BV(OUT_R);	//ustawianie czerwonego
					break;
				case 2: PORT_OUT_G &= ~_BV(OUT_G);	//ustawianie zielonego
					break;
				case 3: PORT_OUT_B &= ~_BV(OUT_B);	//ustawianie niebieskiego
					break;
				case 4:	demo();						//tryb demo
					break;
			}
		}
		
		
		if(new_pos == 1)	//down
		{
			_delay_ms(10);
			switch(mode)
			{
				case 1: 
				{
					if(value_r > 0x00) value_r--;
					PWM_RED = value_r;
				}
				break;
				case 2: 
				{
					if(value_g > 0x00) value_g--;
					PWM_GREEN = value_g;
				}
				break;
				case 3: 
				{
					if(value_b > 0x00) value_b--;
					PWM_BLUE = value_b;
				}
				break;
			}
		}//new_pos == 1

		if(new_pos == 2)	//up
		{
			_delay_ms(10);
			switch(mode)
			{
				case 1: 
				{
					if(value_r < 0xff) value_r++;
					PWM_RED = value_r;
				}
				break;
				case 2: 
				{
					if(value_g < 0xff) value_g++;
					PWM_GREEN = value_g;
				}
				break;
				case 3: 
				{
					if(value_b < 0xff) value_b++;
					PWM_BLUE = value_b;
				}
				break;
			}
		}//new_pos == 2
		
		if(new_pos == 3)	//store
		{
			
			eeprom_write_byte(&eeprom_red, value_r); 
			eeprom_write_byte(&eeprom_green, value_g); 
			eeprom_write_byte(&eeprom_blue, value_b); 
			
			for(a=0;a<6;a++)
			{
				PORT_OUT_R &= ~_BV(OUT_R);
				PORT_OUT_G &= ~_BV(OUT_G);
				PORT_OUT_B &= ~_BV(OUT_B);
				
				_delay_ms(100);
								
				PORT_OUT_R |= _BV(OUT_R);
				PORT_OUT_G |= _BV(OUT_G);
				PORT_OUT_B |= _BV(OUT_B);
				
				_delay_ms(100);

			}
		}//new_pos == 3
		pos = new_pos;

	}// while - petla nieskonczona

	return 0;
}//main 

void demo(void)
				{	
					uint8_t	a,i;
					for(i=0;i<5;i++)
					{
						for(a=0; a<0xff;a++)
						{
							PWM_RED = PWM_GREEN = PWM_BLUE = a;
							_delay_ms(5);
						}
						for(a=0xff; a>0;a--)
						{
							PWM_RED = PWM_GREEN = PWM_BLUE = a;
							_delay_ms(5);
						}
					}//for(i)
					for(i=0;i<5;i++)
					{
						for(a=0; a<0xff;a++)
						{
							PWM_RED = PWM_GREEN = PWM_BLUE = a;
							_delay_ms(2);
						}
						for(a=0xff; a>0;a--)
						{
							PWM_RED = PWM_GREEN = PWM_BLUE = a;
							_delay_ms(2);
						}
					}//for(i)
					
					PWM_RED = value_r;
					PWM_GREEN = value_g;
					PWM_BLUE = value_b;
				}//case


