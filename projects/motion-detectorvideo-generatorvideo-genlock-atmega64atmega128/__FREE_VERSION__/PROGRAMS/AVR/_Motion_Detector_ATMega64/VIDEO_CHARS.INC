;+------------------------------+
;|				|
;|ASCII VIDEO CHARACTERS TABLE	|
;|				|
;+------------------------------+

_VIDEO_OUT_CHARACTERS:

;+-----------+
;| ASCII( )  |
;+-----------+
      .DB 0b00000000,0b00000000
      .DB 0b00000000,0b00000000
      .DB 0b00000000,0b00000000
      .DB 0b00000000,0b00000000
;+-----------+
;| ASCII(!)  |
;+-----------+
      .DB 0b00011000,0b00111100
      .DB 0b00111100,0b00011000
      .DB 0b00011000,0b00000000
      .DB 0b00011000,0b00000000
;+-----------+
;| ASCII(")  |
;+-----------+
      .DB 0b01101100,0b00100100
      .DB 0b00100100,0b00000000
      .DB 0b00000000,0b00000000
      .DB 0b00000000,0b00000000
;+-----------+
;| ASCII(#)  |
;+-----------+
      .DB 0b01101100,0b01101100
      .DB 0b11111110,0b01101100
      .DB 0b11111110,0b01101100
      .DB 0b01101100,0b00000000
;+-----------+
;| ASCII($)  |
;+-----------+
      .DB 0b00010000,0b01111100
      .DB 0b11010000,0b01111100
      .DB 0b00010110,0b11111100
      .DB 0b00010000,0b00000000
;+-----------+
;| ASCII(%)  |
;+-----------+
      .DB 0b00000000,0b01100110
      .DB 0b10101100,0b11011000
      .DB 0b00110110,0b01101010
      .DB 0b11001100,0b00000000
;+-----------+
;| ASCII(&)  |
;+-----------+
      .DB 0b00111000,0b01001100
      .DB 0b00111000,0b01111000
      .DB 0b11001110,0b11001100
      .DB 0b01111010,0b00000000
;+-----------+
;| ASCII(')  |
;+-----------+
      .DB 0b00110000,0b00010000
      .DB 0b00100000,0b00000000
      .DB 0b00000000,0b00000000
      .DB 0b00000000,0b00000000
;+-----------+
;| ASCII(()  |
;+-----------+
      .DB 0b00011000,0b00110000
      .DB 0b01100000,0b01100000
      .DB 0b01100000,0b00110000
      .DB 0b00011000,0b00000000
;+-----------+
;| ASCII())  |
;+-----------+
      .DB 0b01100000,0b00110000
      .DB 0b00011000,0b00011000
      .DB 0b00011000,0b00110000
      .DB 0b01100000,0b00000000
;+-----------+
;| ASCII(*)  |
;+-----------+
      .DB 0b00000000,0b01100110
      .DB 0b00111100,0b11111111
      .DB 0b00111100,0b01100110
      .DB 0b00000000,0b00000000
;+-----------+
;| ASCII(+)  |
;+-----------+
      .DB 0b00000000,0b00110000
      .DB 0b00110000,0b11111100
      .DB 0b00110000,0b00110000
      .DB 0b00000000,0b00000000
;+-----------+
;| ASCII(,)  |
;+-----------+
      .DB 0b00000000,0b00000000
      .DB 0b00000000,0b00000000
      .DB 0b00000000,0b00110000
      .DB 0b00010000,0b00100000
;+-----------+
;| ASCII(-)  |
;+-----------+
      .DB 0b00000000,0b00000000
      .DB 0b00000000,0b11111100
      .DB 0b00000000,0b00000000
      .DB 0b00000000,0b00000000
;+-----------+
;| ASCII(.)  |
;+-----------+
      .DB 0b00000000,0b00000000
      .DB 0b00000000,0b00000000
      .DB 0b00000000,0b00000000
      .DB 0b00110000,0b00000000
;+-----------+
;| ASCII(/)  |
;+-----------+
      .DB 0b00000010,0b00000110
      .DB 0b00001100,0b00011000
      .DB 0b00110000,0b01100000
      .DB 0b11000000,0b00000000
;+-----------+
;| ASCII(0)  |
;+-----------+
      .DB 0b01111100,0b11001110
      .DB 0b11011110,0b11110110
      .DB 0b11100110,0b11100110
      .DB 0b01111100,0b00000000
;+-----------+
;| ASCII(1)  |
;+-----------+
      .DB 0b00011000,0b00111000
      .DB 0b01111000,0b00011000
      .DB 0b00011000,0b00011000
      .DB 0b01111110,0b00000000
;+-----------+
;| ASCII(2)  |
;+-----------+
      .DB 0b01111100,0b11000110
      .DB 0b00000110,0b00011100
      .DB 0b01110000,0b11000110
      .DB 0b11111110,0b00000000
;+-----------+
;| ASCII(3)  |
;+-----------+
      .DB 0b01111100,0b11000110
      .DB 0b00000110,0b00111100
      .DB 0b00000110,0b11000110
      .DB 0b01111100,0b00000000
;+-----------+
;| ASCII(4)  |
;+-----------+
      .DB 0b00011100,0b00111100
      .DB 0b01101100,0b11001100
      .DB 0b11111110,0b00001100
      .DB 0b00011110,0b00000000
;+-----------+
;| ASCII(5)  |
;+-----------+
      .DB 0b11111110,0b11000000
      .DB 0b11111100,0b00000110
      .DB 0b00000110,0b11000110
      .DB 0b01111100,0b00000000
;+-----------+
;| ASCII(6)  |
;+-----------+
      .DB 0b01111100,0b11000110
      .DB 0b11000000,0b11111100
      .DB 0b11000110,0b11000110
      .DB 0b01111100,0b00000000
;+-----------+
;| ASCII(7)  |
;+-----------+
      .DB 0b11111110,0b11000110
      .DB 0b00001100,0b00011000
      .DB 0b00110000,0b00110000
      .DB 0b00110000,0b00000000
;+-----------+
;| ASCII(8)  |
;+-----------+
      .DB 0b01111100,0b11000110
      .DB 0b11000110,0b01111100
      .DB 0b11000110,0b11000110
      .DB 0b01111100,0b00000000
;+-----------+
;| ASCII(9)  |
;+-----------+
      .DB 0b01111100,0b11000110
      .DB 0b11000110,0b01111110
      .DB 0b00000110,0b11000110
      .DB 0b01111100,0b00000000
;+-----------+
;| ASCII(:)  |
;+-----------+
      .DB 0b00000000,0b00110000
      .DB 0b00000000,0b00000000
      .DB 0b00000000,0b00110000
      .DB 0b00000000,0b00000000
;+-----------+
;| ASCII(;)  |
;+-----------+
      .DB 0b00000000,0b00110000
      .DB 0b00000000,0b00000000
      .DB 0b00000000,0b00110000
      .DB 0b00010000,0b00100000
;+-----------+
;| ASCII(<)  |
;+-----------+
      .DB 0b00001100,0b00011000
      .DB 0b00110000,0b01100000
      .DB 0b00110000,0b00011000
      .DB 0b00001100,0b00000000
;+-----------+
;| ASCII(=)  |
;+-----------+
      .DB 0b00000000,0b00000000
      .DB 0b01111110,0b00000000
      .DB 0b00000000,0b01111110
      .DB 0b00000000,0b00000000
;+-----------+
;| ASCII(>)  |
;+-----------+
      .DB 0b01100000,0b00110000
      .DB 0b00011000,0b00001100
      .DB 0b00011000,0b00110000
      .DB 0b01100000,0b00000000
;+-----------+
;| ASCII(?)  |
;+-----------+
      .DB 0b01111000,0b11001100
      .DB 0b00001100,0b00011000
      .DB 0b00110000,0b00000000
      .DB 0b00110000,0b00000000
;+-----------+
;| ASCII(@)  |
;+-----------+
      .DB 0b01111100,0b10000010
      .DB 0b10011110,0b10100110
      .DB 0b10011110,0b10000000
      .DB 0b01111100,0b00000000
;+-----------+
;| ASCII(A)  |
;+-----------+
      .DB 0b01111100,0b11000110
      .DB 0b11000110,0b11111110
      .DB 0b11000110,0b11000110
      .DB 0b11000110,0b00000000
;+-----------+
;| ASCII(B)  |
;+-----------+
      .DB 0b11111100,0b01100110
      .DB 0b01100110,0b01111100
      .DB 0b01100110,0b01100110
      .DB 0b11111100,0b00000000
;+-----------+
;| ASCII(C)  |
;+-----------+
      .DB 0b01111100,0b11000110
      .DB 0b11000000,0b11000000
      .DB 0b11000000,0b11000110
      .DB 0b01111100,0b00000000
;+-----------+
;| ASCII(D)  |
;+-----------+
      .DB 0b11111100,0b01100110
      .DB 0b01100110,0b01100110
      .DB 0b01100110,0b01100110
      .DB 0b11111100,0b00000000
;+-----------+
;| ASCII(E)  |
;+-----------+
      .DB 0b11111110,0b01100010
      .DB 0b01101000,0b01111000
      .DB 0b01101000,0b01100010
      .DB 0b11111110,0b00000000
;+-----------+
;| ASCII(F)  |
;+-----------+
      .DB 0b11111110,0b01100010
      .DB 0b01101000,0b01111000
      .DB 0b01101000,0b01100000
      .DB 0b11110000,0b00000000
;+-----------+
;| ASCII(G)  |
;+-----------+
      .DB 0b01111100,0b11000110
      .DB 0b11000110,0b11000000
      .DB 0b11001110,0b11000110
      .DB 0b01111110,0b00000000
;+-----------+
;| ASCII(H)  |
;+-----------+
      .DB 0b11000110,0b11000110
      .DB 0b11000110,0b11111110
      .DB 0b11000110,0b11000110
      .DB 0b11000110,0b00000000
;+-----------+
;| ASCII(I)  |
;+-----------+
      .DB 0b00111100,0b00011000
      .DB 0b00011000,0b00011000
      .DB 0b00011000,0b00011000
      .DB 0b00111100,0b00000000
;+-----------+
;| ASCII(J)  |
;+-----------+
      .DB 0b00011110,0b00001100
      .DB 0b00001100,0b00001100
      .DB 0b11001100,0b11001100
      .DB 0b01111000,0b00000000
;+-----------+
;| ASCII(K)  |
;+-----------+
      .DB 0b11100110,0b01100110
      .DB 0b01101100,0b01111000
      .DB 0b01101100,0b01100110
      .DB 0b11100110,0b00000000
;+-----------+
;| ASCII(L)  |
;+-----------+
      .DB 0b11110000,0b01100000
      .DB 0b01100000,0b01100000
      .DB 0b01100010,0b01100110
      .DB 0b11111110,0b00000000
;+-----------+
;| ASCII(M)  |
;+-----------+
      .DB 0b10000010,0b11000110
      .DB 0b11101110,0b11111110
      .DB 0b11010110,0b11000110
      .DB 0b11000110,0b00000000
;+-----------+
;| ASCII(N)  |
;+-----------+
      .DB 0b11000110,0b11100110
      .DB 0b11110110,0b11011110
      .DB 0b11001110,0b11000110
      .DB 0b11000110,0b00000000
;+-----------+
;| ASCII(O)  |
;+-----------+
      .DB 0b01111100,0b11000110
      .DB 0b11000110,0b11000110
      .DB 0b11000110,0b11000110
      .DB 0b01111100,0b00000000
;+-----------+
;| ASCII(P)  |
;+-----------+
      .DB 0b11111100,0b01100110
      .DB 0b01100110,0b01111100
      .DB 0b01100000,0b01100000
      .DB 0b11110000,0b00000000
;+-----------+
;| ASCII(Q)  |
;+-----------+
      .DB 0b01111100,0b11000110
      .DB 0b11000110,0b11000110
      .DB 0b11010110,0b11011110
      .DB 0b01111100,0b00000110
;+-----------+
;| ASCII(R)  |
;+-----------+
      .DB 0b11111100,0b01100110
      .DB 0b01100110,0b01111100
      .DB 0b01100110,0b01100110
      .DB 0b11100110,0b00000000
;+-----------+
;| ASCII(S)  |
;+-----------+
      .DB 0b01111100,0b11000110
      .DB 0b11000000,0b01111100
      .DB 0b00000110,0b11000110
      .DB 0b01111100,0b00000000
;+-----------+
;| ASCII(T)  |
;+-----------+
      .DB 0b01111110,0b01011010
      .DB 0b01011010,0b00011000
      .DB 0b00011000,0b00011000
      .DB 0b00111100,0b00000000
;+-----------+
;| ASCII(U)  |
;+-----------+
      .DB 0b11000110,0b11000110
      .DB 0b11000110,0b11000110
      .DB 0b11000110,0b11000110
      .DB 0b01111100,0b00000000
;+-----------+
;| ASCII(V)  |
;+-----------+
      .DB 0b11000110,0b11000110
      .DB 0b11000110,0b11000110
      .DB 0b01101100,0b00111000
      .DB 0b00010000,0b00000000
;+-----------+
;| ASCII(W)  |
;+-----------+
      .DB 0b11000110,0b11000110
      .DB 0b11010110,0b11111110
      .DB 0b11101110,0b11000110
      .DB 0b10000010,0b00000000
;+-----------+
;| ASCII(X)  |
;+-----------+
      .DB 0b11000110,0b01101100
      .DB 0b00111000,0b00111000
      .DB 0b00111000,0b01101100
      .DB 0b11000110,0b00000000
;+-----------+
;| ASCII(Y)  |
;+-----------+
      .DB 0b01100110,0b01100110
      .DB 0b01100110,0b00111100
      .DB 0b00011000,0b00011000
      .DB 0b00111100,0b00000000
;+-----------+
;| ASCII(Z)  |
;+-----------+
      .DB 0b11111110,0b11000110
      .DB 0b10001100,0b00011000
      .DB 0b00110010,0b01100110
      .DB 0b11111110,0b00000000
;+-----------+
;| ASCII([)  |
;+-----------+
      .DB 0b01111000,0b01100000
      .DB 0b01100000,0b01100000
      .DB 0b01100000,0b01100000
      .DB 0b01111000,0b00000000
;+-----------+
;| ASCII(\)  |
;+-----------+
      .DB 0b11000000,0b01100000
      .DB 0b00110000,0b00011000
      .DB 0b00001100,0b00000110
      .DB 0b00000010,0b00000000
;+-----------+
;| ASCII(])  |
;+-----------+
      .DB 0b01111000,0b00011000
      .DB 0b00011000,0b00011000
      .DB 0b00011000,0b00011000
      .DB 0b01111000,0b00000000
;+-----------+
;| ASCII(^)  |
;+-----------+
      .DB 0b00010000,0b00111000
      .DB 0b01101100,0b11000110
      .DB 0b00000000,0b00000000
      .DB 0b00000000,0b00000000
;+-----------+
;| ASCII(_)  |
;+-----------+
      .DB 0b00000000,0b00000000
      .DB 0b00000000,0b00000000
      .DB 0b00000000,0b00000000
      .DB 0b00000000,0b11111111
;+-----------+
;| ASCII(`)  |
;+-----------+
      .DB 0b00110000,0b00100000
      .DB 0b00010000,0b00000000
      .DB 0b00000000,0b00000000
      .DB 0b00000000,0b00000000
;+-----------+
;| ASCII(a)  |
;+-----------+
      .DB 0b00000000,0b00000000
      .DB 0b01111000,0b00001100
      .DB 0b01111100,0b11001100
      .DB 0b01110110,0b00000000
;+-----------+
;| ASCII(b)  |
;+-----------+
      .DB 0b11100000,0b01100000
      .DB 0b01100000,0b01111100
      .DB 0b01100110,0b01100110
      .DB 0b01111100,0b00000000
;+-----------+
;| ASCII(c)  |
;+-----------+
      .DB 0b00000000,0b00000000
      .DB 0b01111100,0b11000110
      .DB 0b11000000,0b11000110
      .DB 0b01111100,0b00000000
;+-----------+
;| ASCII(d)  |
;+-----------+
      .DB 0b00011100,0b00001100
      .DB 0b00001100,0b01111100
      .DB 0b11001100,0b11001100
      .DB 0b01110110,0b00000000
;+-----------+
;| ASCII(e)  |
;+-----------+
      .DB 0b00000000,0b00000000
      .DB 0b01111100,0b11000110
      .DB 0b11111110,0b11000000
      .DB 0b01111100,0b00000000
;+-----------+
;| ASCII(f)  |
;+-----------+
      .DB 0b00011100,0b00110110
      .DB 0b00110000,0b01111000
      .DB 0b00110000,0b00110000
      .DB 0b01111000,0b00000000
;+-----------+
;| ASCII(g)  |
;+-----------+
      .DB 0b00000000,0b00000000
      .DB 0b01110110,0b11001100
      .DB 0b11001100,0b01111100
      .DB 0b00001100,0b01111000
;+-----------+
;| ASCII(h)  |
;+-----------+
      .DB 0b11100000,0b01100000
      .DB 0b01101100,0b01110110
      .DB 0b01100110,0b01100110
      .DB 0b11100110,0b00000000
;+-----------+
;| ASCII(i)  |
;+-----------+
      .DB 0b00011000,0b00000000
      .DB 0b00111000,0b00011000
      .DB 0b00011000,0b00011000
      .DB 0b00111100,0b00000000
;+-----------+
;| ASCII(j)  |
;+-----------+
      .DB 0b00000000,0b00001100
      .DB 0b00000000,0b00011100
      .DB 0b00001100,0b00001100
      .DB 0b11001100,0b01111000
;+-----------+
;| ASCII(k)  |
;+-----------+
      .DB 0b11100000,0b01100000
      .DB 0b01100110,0b01101100
      .DB 0b01111000,0b01101100
      .DB 0b11100110,0b00000000
;+-----------+
;| ASCII(l)  |
;+-----------+
      .DB 0b00111000,0b00011000
      .DB 0b00011000,0b00011000
      .DB 0b00011000,0b00011000
      .DB 0b00111100,0b00000000
;+-----------+
;| ASCII(m)  |
;+-----------+
      .DB 0b00000000,0b00000000
      .DB 0b11001100,0b11111110
      .DB 0b11010110,0b11010110
      .DB 0b11010110,0b00000000
;+-----------+
;| ASCII(n)  |
;+-----------+
      .DB 0b00000000,0b00000000
      .DB 0b11011100,0b01100110
      .DB 0b01100110,0b01100110
      .DB 0b01100110,0b00000000
;+-----------+
;| ASCII(o)  |
;+-----------+
      .DB 0b00000000,0b00000000
      .DB 0b01111100,0b11000110
      .DB 0b11000110,0b11000110
      .DB 0b01111100,0b00000000
;+-----------+
;| ASCII(p)  |
;+-----------+
      .DB 0b00000000,0b00000000
      .DB 0b11011100,0b01100110
      .DB 0b01100110,0b01111100
      .DB 0b01100000,0b11110000
;+-----------+
;| ASCII(q)  |
;+-----------+
      .DB 0b00000000,0b00000000
      .DB 0b01111100,0b11001100
      .DB 0b11001100,0b01111100
      .DB 0b00001100,0b00011110
;+-----------+
;| ASCII(r)  |
;+-----------+
      .DB 0b00000000,0b00000000
      .DB 0b11011110,0b01110110
      .DB 0b01100000,0b01100000
      .DB 0b11110000,0b00000000
;+-----------+
;| ASCII(s)  |
;+-----------+
      .DB 0b00000000,0b00000000
      .DB 0b01111100,0b11000000
      .DB 0b01111100,0b00000110
      .DB 0b01111100,0b00000000
;+-----------+
;| ASCII(t)  |
;+-----------+
      .DB 0b00010000,0b00110000
      .DB 0b11111100,0b00110000
      .DB 0b00110000,0b00110100
      .DB 0b00011000,0b00000000
;+-----------+
;| ASCII(u)  |
;+-----------+
      .DB 0b00000000,0b00000000
      .DB 0b11001100,0b11001100
      .DB 0b11001100,0b11001100
      .DB 0b01110110,0b00000000
;+-----------+
;| ASCII(v)  |
;+-----------+
      .DB 0b00000000,0b00000000
      .DB 0b11000110,0b11000110
      .DB 0b01101100,0b00111000
      .DB 0b00010000,0b00000000
;+-----------+
;| ASCII(w)  |
;+-----------+
      .DB 0b00000000,0b00000000
      .DB 0b11000110,0b11010110
      .DB 0b11010110,0b11111110
      .DB 0b01101100,0b00000000
;+-----------+
;| ASCII(x)  |
;+-----------+
      .DB 0b00000000,0b00000000
      .DB 0b11000110,0b01101100
      .DB 0b00111000,0b01101100
      .DB 0b11000110,0b00000000
;+-----------+
;| ASCII(y)  |
;+-----------+
      .DB 0b00000000,0b00000000
      .DB 0b11001100,0b11001100
      .DB 0b11001100,0b01111100
      .DB 0b00001100,0b11111000
;+-----------+
;| ASCII(z)  |
;+-----------+
      .DB 0b00000000,0b00000000
      .DB 0b11111100,0b10011000
      .DB 0b00110000,0b01100100
      .DB 0b11111100,0b00000000
;+-----------+
;| ASCII({)  |
;+-----------+
      .DB 0b00001110,0b00011000
      .DB 0b00011000,0b00110000
      .DB 0b00011000,0b00011000
      .DB 0b00001110,0b00000000
;+-----------+
;| ASCII(|)  |
;+-----------+
      .DB 0b00011000,0b00011000
      .DB 0b00011000,0b00000000
      .DB 0b00011000,0b00011000
      .DB 0b00011000,0b00000000
;+-----------+
;| ASCII(})  |
;+-----------+
      .DB 0b11100000,0b00110000
      .DB 0b00110000,0b00011000
      .DB 0b00110000,0b00110000
      .DB 0b11100000,0b00000000
;+-----------+
;| ASCII(~)  |
;+-----------+
      .DB 0b01110110,0b11011100
      .DB 0b00000000,0b00000000
      .DB 0b00000000,0b00000000
      .DB 0b00000000,0b00000000
