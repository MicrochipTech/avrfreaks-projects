;+--------------------------------------------------------------------------------------------
;| Source
;|     Path : C:\NEPER_THE_MATH\PROJETOS\MOTION_DETECTOR\VERSIONS\DSQUARE\PROGRAMS\AVR\BMPS\
;|     File : TIME_24_12.BMP
;|
;| Destiny
;|     Path : C:\NEPER_THE_MATH\PROJETOS\MOTION_DETECTOR\VERSIONS\DSQUARE\PROGRAMS\AVR\BMPS\
;|     File : TIME_24_12.ASM
;|
;| Destiny Image Properties
;|     Size   :    80 Bytes
;|     Width  :   128 Pixels
;|     Height :     5 Pixels
;|     Width  :    16 Bytes
;|     Colors :     2 Levels (1 bit)
;+--------------------------------------------------------------------------------------------

;( IMAGE CONTENTS )

;                                                                                                         1                           
;               1         2         3         4         5         6         7         8         9         0         1         2       
;     01234567890123456789012345678901234567890123456789012345678901234567890123456789012345678901234567890123456789012345678901234567
;     |         |         |         |         |         |         |         |         |         |         |         |         |       
;   0-###################   #   #############################   #   ############################# ##   ###############################-   0
;   1-#### ########### #### # # ############## ########### #### # # ############# ########### ##  ## # ############# ################ -   1
;   2-#### ###### ###   ##  # # ###### ####### ####### ##   #   # # ##### ####### ####### ##   ## ## # #### ######## ######## ####### -   2
;   3-#### ########### #### # # ############## ########### ## ### # ############# ########### ### ## # ############# ################ -   3
;   4-###################   #   #############################   #   ############################   #   ###############################-   4
;     |         |         |         |         |         |         |         |         |         |         |         |         |       
;                                                                                                         1                           
;               1         2         3         4         5         6         7         8         9         0         1         2       
;     01234567890123456789012345678901234567890123456789012345678901234567890123456789012345678901234567890123456789012345678901234567

;( IMAGE DATA )

BMP_TIME_24_12:

	;+------------+
	;| BMP Header |
	;+------------+
	.DW      1 ;Bits Color 1 bit
	.DW    128 ;Width Pixels
	.DW      5 ;Height Pixels
	.DW     16 ;Width Bytes
	.DW     80 ;Size Bytes
	;+------------+
	;|  BMP Data  |
	;+------------+
	.DB 0x00,0x00,0x1D,0xC0,0x00,0x00,0x01,0xDC,0x00,0x00,0x00,0x13,0x80,0x00,0x00,0x00
	.DB 0x08,0x00,0x85,0x40,0x00,0x80,0x08,0x54,0x00,0x10,0x01,0x32,0x80,0x02,0x00,0x01
	.DB 0x08,0x11,0xCD,0x40,0x80,0x80,0x9D,0xD4,0x10,0x10,0x13,0x92,0x84,0x02,0x01,0x01
	.DB 0x08,0x00,0x85,0x40,0x00,0x80,0x09,0x14,0x00,0x10,0x01,0x12,0x80,0x02,0x00,0x01
	.DB 0x00,0x00,0x1D,0xC0,0x00,0x00,0x01,0xDC,0x00,0x00,0x00,0x3B,0x80,0x00,0x00,0x00

