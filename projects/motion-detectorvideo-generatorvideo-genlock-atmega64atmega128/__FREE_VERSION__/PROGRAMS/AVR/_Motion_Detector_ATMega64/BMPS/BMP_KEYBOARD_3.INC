;+--------------------------------------------------------------------------------------------
;| Source
;|     Path : C:\NEPER_THE_MATH\PROJETOS\MOTION_DETECTOR\VERSIONS\DSQUARE\PROGRAMS\AVR\BMPS\
;|     File : KEYBOARD_3.BMP
;|
;| Destiny
;|     Path : C:\NEPER_THE_MATH\PROJETOS\MOTION_DETECTOR\VERSIONS\DSQUARE\PROGRAMS\AVR\BMPS\
;|     File : KEYBOARD_3.ASM
;|
;| Destiny Image Properties
;|     Size   :   741 Bytes
;|     Width  :    98 Pixels
;|     Height :    57 Pixels
;|     Width  :    13 Bytes
;|     Colors :     2 Levels (1 bit)
;+--------------------------------------------------------------------------------------------

;( IMAGE CONTENTS )

;##################################################################################################
;# ############################################################################################## #
;###                                                                                      #     ###
;##                                                                                       #      ##
;##   #      # #     # #      #     ##       #         #     #         ##    ###    ##    # #  # ##
;##   #      # #     # #     ####   ##  #   # #       #       #       ##    #   #    ##   # #### ##
;##   #      # #    #####   # #        #     #       #         #     ##         #     ##  #  ##  ##
;##   #              # #     ###      #     # # #    #         #    ##         #       ## # #  # ##
;##   #             #####     # #    #      #  #     #         #     ##       #       ##  # #  # ##
;##                  # #    ####    #  ##   #  ##     #       #       ##             ##   #      ##
;##   #              # #      #        ##    ##        #     #         ##     #     ##    #      ##
;##                                                                                       #      ##
;##################################################################################################
;##                                                               #                              ##
;##   #     ####      ##    ###     #####   #####    ###    #   # #   #####      ###       ###   ##
;##  # #     #  #    #  #    # #    #       #       #   #   #   # #   #   #     #   #     #   #  ##
;## #   #    #  #   #        #  #   #       #       #       #   # #      #      #   #     #   #  ##
;## #   #    ###    #        #  #   ####    ####    # ###   ##### #     #        ###       ####  ##
;## #####    #  #   #        #  #   #       #       #   #   #   # #     #       #   #         #  ##
;## #   #    #  #    #  #    # #    #       #       #   #   #   # #     #       #   #        #   ##
;## #   #   ####      ##    ###     #####   #        ###    #   # #     #        ###       ##    ##
;##                                                               #                              ##
;##  ###      ###   #   #   #       #   #   #   #    ###    ####  #      #      #####       ##   ##
;##   #        #    #  #    #       ## ##   ##  #   #   #   #   # #     ##      #          #     ##
;##   #        #    # #     #       # # #   ##  #   #   #   #   # #    # #      ###       #      ##
;##   #        #    ##      #       # # #   # # #   #   #   ####  #   #  #         #      ####   ##
;##   #     #  #    # #     #       #   #   #  ##   #   #   #     #   #####         #     #   #  ##
;##   #     #  #    #  #    #       #   #   #  ##   #   #   #     #      #         #      #   #  ##
;##  ###     ##     #   #   #####   #   #   #   #    ###    #     #      #      ###        ###   ##
;##                                                               #                              ##
;##  ###    ####     ###    #####   #   #   #   #   #   #   #   # #     #        ###       ###   ##
;## #   #   #   #   #   #     #     #   #   #   #   #   #   #   # #    ##       #   #     #   #  ##
;## #   #   #   #   #         #     #   #   #   #   #   #    # #  #   # #           #         #  ##
;## #   #   ####     ###      #     #   #   #   #   # # #     #   #     #          #        ##   ##
;## # # #   # #         #     #     #   #    # #    # # #    # #  #     #        ##           #  ##
;## #  #    #  #    #   #     #     #   #    # #    ## ##   #   # #     #       #         #   #  ##
;##  ## #   #   #    ###      #      ###      #     #   #   #   # #   #####     #####      ###   ##
;##                                                               #                              ##
;## #   #   #####  ################################################              ###             ##
;## #   #       #  #                                              #     #       #   #            ##
;## #   #      #   #  ##########################################  #     #       #  ##            ##
;##  ###      #    # #                                          # #   #####     # # #      ####  ##
;##   #      #     # #                                          # #     #       ##  #            ##
;##   #     #      # #                                          # #     #       #   #            ##
;##   #     #####  # #                                          # #              ###             ##
;##                #  ##########################################  #                              ##
;###################                                              #     #                        ##
;##                                                               #   # # #                      ##
;##   ###    #                                                    #    ###      #####         #  ##
;##  #   #  # #        #       #        #      #       #      # # #     #                    #   ##
;##  #   #  ###  #    ######  ##        ##    ###      #     ## # #    ###      #####       #    ##
;##   # #   # # # #  ####### ######  ######  #####   #####  ##### #   # # #                #     ##
;##   # #   # # ###   ######  ##        ##     #      ###    ##   #     #                 #      ##
;##  ## ##  # # # #    #       #        #      #       #      #   #                              ##
;###                                                              #                             ###
;# ############################################################################################## #
;##################################################################################################

;( IMAGE DATA )

BMP_KEYBOARD_3:

	;+------------+
	;| BMP Header |
	;+------------+
	.DW      1 ;Bits Color 1 bit
	.DW     98 ;Width Pixels
	.DW     57 ;Height Pixels
	.DW     13 ;Width Bytes
	.DW    741 ;Size Bytes
	;+------------+
	;|  BMP Data  |
	;+------------+
	.DB 0x00,0x00,0x00,0x00,0x00,0x00,0x00,0x00,0x00,0x00,0x00,0x00,0x00,0x40,0x00,0x00
	.DB 0x00,0x00,0x00,0x00,0x00,0x00,0x00,0x00,0x00,0x80,0x1F,0xFF,0xFF,0xFF,0xFF,0xFF
	.DB 0xFF,0xFF,0xFF,0xFF,0xFF,0xBE,0x00,0x3F,0xFF,0xFF,0xFF,0xFF,0xFF,0xFF,0xFF,0xFF
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	.DB 0x00,0x00,0x00,0x00,0x00,0x00

