;+------------------------------------------------------------------------------------------------------------------------------
;| Source
;|     Path : C:\____NEPER\___PROJETOS\_MOTION_DETECTOR\VERSIONS\__FREE_VERSION__\PROGRAMS\AVR\_MOTION_DETECTOR_ATMEGA64\BMPS\
;|     File : CLOCK_ANALOGICO_1.BMP
;|
;| Destiny
;|     Path : C:\____NEPER\___PROJETOS\_MOTION_DETECTOR\VERSIONS\__FREE_VERSION__\PROGRAMS\AVR\_MOTION_DETECTOR_ATMEGA64\BMPS\
;|     File : BMP_CLOCK_ANALOGICO_1.INC
;|
;| Destiny Image Properties
;|     Size   :  1152 Bytes
;|     Width  :    96 Pixels
;|     Height :    96 Pixels
;|     WidthB :    12 Bytes
;|     Colors :     2 Levels (1 bit)
;+------------------------------------------------------------------------------------------------------------------------------

;( IMAGE CONTENTS )

;                                                                                                     
;               1         2         3         4         5         6         7         8         9     
;     012345678901234567890123456789012345678901234567890123456789012345678901234567890123456789012345
;     |         |         |         |         |         |         |         |         |         |     
;   0-############################################       #############################################-   0
;   1-##########################################    ###    ###########################################-   1
;   2-####################################      ###########      #####################################-   2
;   3-#################################   ######           ######   ##################################-   3
;   4-##############################   ####                     ####   ###############################-   4
;   5-############################  ###         ##      ###         ###  #############################-   5
;   6-##########################  ###          ###     #####          ###  ###########################-   6
;   7-########################  ##              ##     ## ###            ##  #########################-   7
;   8-####################### ##                ##    ##   ##           ## ## ########################-   8
;   9-#####################  # ##      ##       ##         ##          ###   #  ######################-   9
;  10-#################### ## ###     ###       ##        ##            ##    ## #####################-  10
;  11-################### ##   ##      ##       ##        ##            ##     ##  ###################-  11
;  12-#################  ##    ##      ##       ##       ##             ##      ##  ##################-  12
;  13-################  #      ##      ##       ##      ##              ##        ## #################-  13
;  14-############### ##       ##      ##       ##     ##               ##         ## ################-  14
;  15-############## ##        ##      ##      ####   #######           ##          ## ###############-  15
;  16-############# ##         ##      ##     ######  #######           ##           ## ##############-  16
;  17-############  #          ##      ##                               ##            ## #############-  17
;  18-###########  #           ##      ##                              ####            #  ############-  18
;  19-########### #           ####    ####           #                ######            #  ###########-  19
;  20-########## ##          ######  ######                                             ##  ##########-  20
;  21-######### ##                                                                       ## ##########-  21
;  22-########  #                                                                          # #########-  22
;  23-######## # ##     ####           #                            #               ###    #  ########-  23
;  24-####### # ###    ##  ##                                                      #####    # ########-  24
;  25-####### #  ##    ##  ##                                                      ## ###   ## #######-  25
;  26-###### ##  ##   ###  ###                                                    ##   ##    # #######-  26
;  27-###### #   ##   ##    ##                                                         ##    ## ######-  27
;  28-##### ##   ##   ##    ##                                                        ##      # ######-  28
;  29-##### #    ##   ##    ##                                                        ##      #  #####-  29
;  30-#### ##    ##   ##    ##                                                       ##        ## ####-  30
;  31-#### #     ##   ###  ###                                                      ##         ## ####-  31
;  32-###  #     ##    ##  ###                                                     ##          #  ####-  32
;  33-### ##    ####   ##  ##                                                 #   #######       # ####-  33
;  34-### #    ######   ####  #                                                   #######       #  ###-  34
;  35-##  #                                                                                     ## ###-  35
;  36-##  #                                                                                      # ###-  36
;  37-## #                                                                                       # ###-  37
;  38-## #                                                                                       #  ##-  38
;  39-## #                                                                                       #  ##-  39
;  40-#  #                                                                                       ## ##-  40
;  41-#  #                                                                                 ###    # ##-  41
;  42-# #   ######                                                                        ## ##   # ##-  42
;  43-# #   ##  ##                                                                       ##   ##  # ##-  43
;  44-# #  ##    ##                                                                      #    ##  # ##-  44
;  45-# #  ##    ##                                                                          ###  # ##-  45
;  46-# #  ###  ###                                 ###                                    ####   #  #-  46
;  47- ##   #######                                #####                                   #####  ## #-  47
;  48-# #    ######     #                          #####                          #          ###  #  #-  48
;  49-# #       ##                                 #####                                      ##  #  #-  49
;  50-# #      ###                                  ###                                  #    ##  # ##-  50
;  51-# #     ###                                                                        ##  ##   # ##-  51
;  52-# #   ###                                                                           ####    # ##-  52
;  53-# ##                                                                                        # ##-  53
;  54-#  #                                                                                        # ##-  54
;  55-#  #                                                                                        # ##-  55
;  56-## #                                                                                       #  ##-  56
;  57-## #                                                                                       #  ##-  57
;  58-## #                                                                                       # ###-  58
;  59-##  #                                                                                      # ###-  59
;  60-##  #                                                                                     ## ###-  60
;  61-### #                                                                                     #  ###-  61
;  62-### ##       #####    #                                                 #       ##        # ####-  62
;  63-###  #      ### ###                                                            ###       ## ####-  63
;  64-#### #      ##   ##                                                            ###       #  ####-  64
;  65-#### ##     ### ###                                                           ####       # #####-  65
;  66-####  #      #####                                                           ## ##      #  #####-  66
;  67-##### ##      ###                                                            #  ##      # ######-  67
;  68-#####  #     #####                                                          ########   ## ######-  68
;  69-###### ##   ### ###                                                         ########   # #######-  69
;  70-######  #   ##   ##                                                             ##    ## #######-  70
;  71-####### ##  ### ###                                                             ##   ## ########-  71
;  72-######## ##  #####               #                                              ##  ##  ########-  72
;  73-########  ##                                                  #                    ##  #########-  73
;  74-#########  #              #######                               ######             #  ##########-  74
;  75-########## ##             #######                              #######            ##  ##########-  75
;  76-##########  #             ##  ##                               ##                 #  ###########-  76
;  77-###########  #            #   ##               #               ##                #  ############-  77
;  78-############  #               ##                               ######           #  #############-  78
;  79-############# ##             ##                ####              #####         ## ##############-  79
;  80-##############  #            ##               ###                  ###        ## ###############-  80
;  81-###############  #           ##              ###                    ##       ##  ###############-  81
;  82-################  #         ##               ##                     ##      #   ################-  82
;  83-#################  ##       ##              ######                 ###    ##  ##################-  83
;  84-##################  ###     ##              ##   ##            ######    ##  ###################-  84
;  85-###################   ##                    ##   ##             ####   ##   ####################-  85
;  86-#####################  ###                  ##   ##                  ###   #####################-  86
;  87-######################   ###                ##   ##                ###   #######################-  87
;  88-########################   ###               ## ###              ###   #########################-  88
;  89-##########################  ####              ####            #####  ###########################-  89
;  90-###########################    ###                           ###    ############################-  90
;  91-############################     #####                   #####     #############################-  91
;  92-################################     #########   #########     #################################-  92
;  93-###################################          #####          ####################################-  93
;  94-#######################################       ###       ########################################-  94
;  95-############################################       #############################################-  95
;     |         |         |         |         |         |         |         |         |         |     
;                                                                                                     
;               1         2         3         4         5         6         7         8         9     
;     012345678901234567890123456789012345678901234567890123456789012345678901234567890123456789012345

;( IMAGE DATA )

BMP_CLOCK_ANALOGICO_1:

	;+------------+
	;| BMP Header |
	;+------------+
	.DW      1 ;Bits Color 1 bit
	.DW     96 ;Width Pixels
	.DW     96 ;Height Pixels
	.DW     12 ;Width Bytes
	.DW   1152 ;Size Bytes
	;+------------+
	;|  BMP Data  |
	;+------------+
	.DB 0x00,0x00,0x00,0x00,0x00,0x0F,0xE0,0x00,0x00,0x00,0x00,0x00,0x00,0x00,0x00,0x00
	.DB 0x00,0x3C,0x78,0x00,0x00,0x00,0x00,0x00,0x00,0x00,0x00,0x00,0x0F,0xC0,0x07,0xE0
	.DB 0x00,0x00,0x00,0x00,0x00,0x00,0x00,0x00,0x70,0x3F,0xF8,0x1C,0x00,0x00,0x00,0x00
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	.DB 0x00,0x00,0x00,0x00,0x00,0x00,0x00,0x00,0x00,0x0F,0xE0,0x00,0x00,0x00,0x00,0x00

