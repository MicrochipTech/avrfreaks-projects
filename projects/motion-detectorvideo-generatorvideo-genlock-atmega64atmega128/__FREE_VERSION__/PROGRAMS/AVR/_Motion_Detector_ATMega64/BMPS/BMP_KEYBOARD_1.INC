;+--------------------------------------------------------------------------------------------
;| Source
;|     Path : C:\NEPER_THE_MATH\PROJETOS\MOTION_DETECTOR\VERSIONS\DSQUARE\PROGRAMS\AVR\BMPS\
;|     File : KEYBOARD_1.BMP
;|
;| Destiny
;|     Path : C:\NEPER_THE_MATH\PROJETOS\MOTION_DETECTOR\VERSIONS\DSQUARE\PROGRAMS\AVR\BMPS\
;|     File : KEYBOARD_1.ASM
;|
;| Destiny Image Properties
;|     Size   :   660 Bytes
;|     Width  :    89 Pixels
;|     Height :    55 Pixels
;|     Width  :    12 Bytes
;|     Colors :     2 Levels (1 bit)
;+--------------------------------------------------------------------------------------------

;( IMAGE CONTENTS )

;  #####################################################################################  
; #                                                                                     # 
;#                                                                                       #
;#   #      # #     # #      #     ##       #         #     #         ##    ###    ##    #
;#   #      # #     # #     ####   ##  #   # #       #       #       ##    #   #    ##   #
;#   #      # #    #####   # #        #     #       #         #     ##         #     ##  #
;#   #              # #     ###      #     # # #    #         #    ##         #       ## #
;#   #             #####     # #    #      #  #     #         #     ##       #       ##  #
;#                  # #    ####    #  ##   #  ##     #       #       ##             ##   #
;#   #              # #      #        ##    ##        #     #         ##     #     ##    #
;#                                                                                       #
;################################################################ ########################
;#                                                               #                       #
;#   #     ####      ##    ###     #####   #####    ###    #   # # #####    ###     ###  #
;#  # #     #  #    #  #    # #    #       #       #   #   #   # # #   #   #   #   #   # #
;# #   #    #  #   #        #  #   #       #       #       #   # #    #    #   #   #   # #
;# #   #    ###    #        #  #   ####    ####    # ###   ##### #   #      ###     #### #
;# #####    #  #   #        #  #   #       #       #   #   #   # #   #     #   #       # #
;# #   #    #  #    #  #    # #    #       #       #   #   #   # #   #     #   #      #  #
;# #   #   ####      ##    ###     #####   #        ###    #   # #   #      ###     ##   #
;#                                                               #                       #
;#  ###      ###   #   #   #       #   #   #   #    ###    ####  #    #    #####     ##  #
;#   #        #    #  #    #       ## ##   ##  #   #   #   #   # #   ##    #        #    #
;#   #        #    # #     #       # # #   ##  #   #   #   #   # #  # #    ###     #     #
;#   #        #    ##      #       # # #   # # #   #   #   ####  # #  #       #    ####  #
;#   #     #  #    # #     #       #   #   #  ##   #   #   #     # #####       #   #   # #
;#   #     #  #    #  #    #       #   #   #  ##   #   #   #     #    #       #    #   # #
;#  ###     ##     #   #   #####   #   #   #   #    ###    #     #    #    ###      ###  #
;#                                                               #                       #
;#  ###    ####     ###    #####   #   #   #   #   #   #   #   # #   #      ###     ###  #
;# #   #   #   #   #   #     #     #   #   #   #   #   #   #   # #  ##     #   #   #   # #
;# #   #   #   #   #         #     #   #   #   #   #   #    # #  # # #         #       # #
;# #   #   ####     ###      #     #   #   #   #   # # #     #   #   #        #      ##  #
;# # # #   # #         #     #     #   #    # #    # # #    # #  #   #      ##         # #
;# #  #    #  #    #   #     #     #   #    # #    ## ##   #   # #   #     #       #   # #
;#  ## #   #   #    ###      #      ###      #     #   #   #   # # #####   #####    ###  #
;#                                                               #                       #
;# #   #   #####  ################################################          ###          #
;# #   #       #  #                                              #   #     #   #         #
;# #   #      #   #  ##########################################  #   #     #  ##         #
;#  ###      #    # #                                          # # #####   # # #    #### #
;#   #      #     # #                                          # #   #     ##  #         #
;#   #     #      # #                                          # #   #     #   #         #
;#   #     #####  # #                                          # #          ###          #
;#                #  ##########################################  #                       #
;##################                                              #   #                   #
;#                                                               # # # #                 #
;#   ###    #                                                    #  ###    #####       # #
;#  #   #  # #        #       #        #      #       #      # # #   #                #  #
;#  #   #  ###  #    ######  ##        ##    ###      #     ## # #  ###    #####     #   #
;#   # #   # # # #  ####### ######  ######  #####   #####  ##### # # # #            #    #
;#   # #   # # ###   ######  ##        ##     #      ###    ##   #   #             #     #
;#  ## ##  # # # #    #       #        #      #       #      #   #                       #
; #                                                              #                      # 
;  #####################################################################################  

;( IMAGE DATA )

BMP_KEYBOARD_1:

	;+------------+
	;| BMP Header |
	;+------------+
	.DW      1 ;Bits Color 1 bit
	.DW     89 ;Width Pixels
	.DW     55 ;Height Pixels
	.DW     12 ;Width Bytes
	.DW    660 ;Size Bytes
	;+------------+
	;|  BMP Data  |
	;+------------+
	.DB 0xC0,0x00,0x00,0x00,0x00,0x00,0x00,0x00,0x00,0x00,0x01,0x80,0xBF,0xFF,0xFF,0xFF
	.DB 0xFF,0xFF,0xFF,0xFF,0xFF,0xFF,0xFE,0x80,0x7F,0xFF,0xFF,0xFF,0xFF,0xFF,0xFF,0xFF
	.DB 0xFF,0xFF,0xFF,0x00,0x77,0xEB,0xEB,0xF7,0xCF,0xEF,0xFB,0xEF,0xF9,0xE3,0xCF,0x00
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	.DB 0x00,0x00,0x01,0x80

