;+--------------------------------------------------------------------------------------------
;| Source
;|     Path : C:\NEPER_THE_MATH\PROJETOS\MOTION_DETECTOR\VERSIONS\DSQUARE\PROGRAMS\AVR\BMPS\
;|     File : KEYBOARD_4.BMP
;|
;| Destiny
;|     Path : C:\NEPER_THE_MATH\PROJETOS\MOTION_DETECTOR\VERSIONS\DSQUARE\PROGRAMS\AVR\BMPS\
;|     File : KEYBOARD_4.ASM
;|
;| Destiny Image Properties
;|     Size   :   767 Bytes
;|     Width  :   100 Pixels
;|     Height :    59 Pixels
;|     Width  :    13 Bytes
;|     Colors :     2 Levels (1 bit)
;+--------------------------------------------------------------------------------------------

;( IMAGE CONTENTS )

;                                                                                                         
;               1         2         3         4         5         6         7         8         9         
;     0123456789012345678901234567890123456789012345678901234567890123456789012345678901234567890123456789
;     |         |         |         |         |         |         |         |         |         |         
;   0-                                                                                                    -   0
;   1- ################################################################################################## -   1
;   2- ################################################################################################## -   2
;   3- ##                                                                                       #      ## -   3
;   4- ##                                                                                       #      ## -   4
;   5- ##   #      # #     # #      #     ##       #         #     #         ##    ###    ##    # #  # ## -   5
;   6- ##   #      # #     # #     ####   ##  #   # #       #       #       ##    #   #    ##   # #### ## -   6
;   7- ##   #      # #    #####   # #        #     #       #         #     ##         #     ##  #  ##  ## -   7
;   8- ##   #              # #     ###      #     # # #    #         #    ##         #       ## # #  # ## -   8
;   9- ##   #             #####     # #    #      #  #     #         #     ##       #       ##  # #  # ## -   9
;  10- ##                  # #    ####    #  ##   #  ##     #       #       ##             ##   #      ## -  10
;  11- ##   #              # #      #        ##    ##        #     #         ##     #     ##    #      ## -  11
;  12- ##                                                                                       #      ## -  12
;  13- ################################################################################################## -  13
;  14- ##                                                                #                             ## -  14
;  15- ##   #     ####      ##    ###     #####   #####    ###    #   #  #  #####      ###       ###   ## -  15
;  16- ##  # #     #  #    #  #    # #    #       #       #   #   #   #  #  #   #     #   #     #   #  ## -  16
;  17- ## #   #    #  #   #        #  #   #       #       #       #   #  #     #      #   #     #   #  ## -  17
;  18- ## #   #    ###    #        #  #   ####    ####    # ###   #####  #    #        ###       ####  ## -  18
;  19- ## #####    #  #   #        #  #   #       #       #   #   #   #  #    #       #   #         #  ## -  19
;  20- ## #   #    #  #    #  #    # #    #       #       #   #   #   #  #    #       #   #        #   ## -  20
;  21- ## #   #   ####      ##    ###     #####   #        ###    #   #  #    #        ###       ##    ## -  21
;  22- ##                                                                #                             ## -  22
;  23- ##  ###      ###   #   #   #       #   #   #   #    ###    ####   #     #      #####       ##   ## -  23
;  24- ##   #        #    #  #    #       ## ##   ##  #   #   #   #   #  #    ##      #          #     ## -  24
;  25- ##   #        #    # #     #       # # #   ##  #   #   #   #   #  #   # #      ###       #      ## -  25
;  26- ##   #        #    ##      #       # # #   # # #   #   #   ####   #  #  #         #      ####   ## -  26
;  27- ##   #     #  #    # #     #       #   #   #  ##   #   #   #      #  #####         #     #   #  ## -  27
;  28- ##   #     #  #    #  #    #       #   #   #  ##   #   #   #      #     #         #      #   #  ## -  28
;  29- ##  ###     ##     #   #   #####   #   #   #   #    ###    #      #     #      ###        ###   ## -  29
;  30- ##                                                                #                             ## -  30
;  31- ##  ###    ####     ###    #####   #   #   #   #   #   #   #   #  #    #        ###       ###   ## -  31
;  32- ## #   #   #   #   #   #     #     #   #   #   #   #   #   #   #  #   ##       #   #     #   #  ## -  32
;  33- ## #   #   #   #   #         #     #   #   #   #   #   #    # #   #  # #           #         #  ## -  33
;  34- ## #   #   ####     ###      #     #   #   #   #   # # #     #    #    #          #        ##   ## -  34
;  35- ## # # #   # #         #     #     #   #    # #    # # #    # #   #    #        ##           #  ## -  35
;  36- ## #  #    #  #    #   #     #     #   #    # #    ## ##   #   #  #    #       #         #   #  ## -  36
;  37- ##  ## #   #   #    ###      #      ###      #     #   #   #   #  #  #####     #####      ###   ## -  37
;  38- ##                                                                #                             ## -  38
;  39- ## #   #   #####     ##########################################   #             ###             ## -  39
;  40- ## #   #       #    #                                          #  #    #       #   #            ## -  40
;  41- ## #   #      #     #                                          #  #    #       #  ##            ## -  41
;  42- ##  ###      #      #                                          #  #  #####     # # #      ####  ## -  42
;  43- ##   #      #       #                                          #  #    #       ##  #            ## -  43
;  44- ##   #     #         ##########################################   #    #       #   #            ## -  44
;  45- ##   #     #####                                                  #             ###             ## -  45
;  46- ##                                                                #                             ## -  46
;  47- ###################################################################                             ## -  47
;  48- ##                                                                #    #                        ## -  48
;  49- ##   ###    #                                                     #  # # #                      ## -  49
;  50- ##  #   #  # #        #       #       #       #       #      # #  #   ###      #####         #  ## -  50
;  51- ##  #   #  ####      ####    ##       ##     ###      #     ## #  #    #                    #   ## -  51
;  52- ##   # #   # # #    #####   #####   #####   #####   #####  #####  #   ###      #####       #    ## -  52
;  53- ##   # #   # ###     ####    ##       ##      #      ###    ##    #  # # #                #     ## -  53
;  54- ##  ## ##  # # #      #       #       #       #       #      #    #    #                 #      ## -  54
;  55- ##                                                                #                             ## -  55
;  56- ################################################################################################## -  56
;  57- ################################################################################################## -  57
;  58-                                                                                                    -  58
;     |         |         |         |         |         |         |         |         |         |         
;                                                                                                         
;               1         2         3         4         5         6         7         8         9         
;     0123456789012345678901234567890123456789012345678901234567890123456789012345678901234567890123456789

;( IMAGE DATA )

BMP_KEYBOARD_4:

	;+------------+
	;| BMP Header |
	;+------------+
	.DW      1 ;Bits Color 1 bit
	.DW    100 ;Width Pixels
	.DW     59 ;Height Pixels
	.DW     13 ;Width Bytes
	.DW    767 ;Size Bytes
	;+------------+
	;|  BMP Data  |
	;+------------+
	.DB 0xFF,0xFF,0xFF,0xFF,0xFF,0xFF,0xFF,0xFF,0xFF,0xFF,0xFF,0xFF,0xF0,0x80,0x00,0x00
	.DB 0x00,0x00,0x00,0x00,0x00,0x00,0x00,0x00,0x00,0x10,0x80,0x00,0x00,0x00,0x00,0x00
	.DB 0x00,0x00,0x00,0x00,0x00,0x00,0x10,0x9F,0xFF,0xFF,0xFF,0xFF,0xFF,0xFF,0xFF,0xFF
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	.DB 0x00,0x10,0xFF,0xFF,0xFF,0xFF,0xFF,0xFF,0xFF,0xFF,0xFF,0xFF,0xFF,0xFF,0xF0,0x00

