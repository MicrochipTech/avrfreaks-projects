;+------------------------------------------------------------------------------------------------------------------------------
;| Source
;|     Path : C:\____NEPER\___PROJETOS\_MOTION_DETECTOR\VERSIONS\__FREE_VERSION__\PROGRAMS\AVR\_MOTION_DETECTOR_ATMEGA64\BMPS\
;|     File : DIGITO_8_1.BMP
;|
;| Destiny
;|     Path : C:\____NEPER\___PROJETOS\_MOTION_DETECTOR\VERSIONS\__FREE_VERSION__\PROGRAMS\AVR\_MOTION_DETECTOR_ATMEGA64\BMPS\
;|     File : BMP_DIGITO_8_1.INC
;|
;| Destiny Image Properties
;|     Size   :   128 Bytes
;|     Width  :    28 Pixels
;|     Height :    32 Pixels
;|     WidthB :     4 Bytes
;|     Colors :     2 Levels (1 bit)
;+------------------------------------------------------------------------------------------------------------------------------

;( IMAGE CONTENTS )

;                                 
;               1         2       
;     0123456789012345678901234567
;     |         |         |       
;   0-############################    -   0
;   1-#########           ########    -   1
;   2-#######   #########   ######    -   2
;   3-######  #############  #####    -   3
;   4-#####  ###############  ####    -   4
;   5-####  #################  ###    -   5
;   6-#### #######     ####### ###    -   6
;   7-#### ######  ###  ###### ###    -   7
;   8-#### ###### ##### ###### ###    -   8
;   9-#### ###### ##### ###### ###    -   9
;  10-#### ######  ###  ###### ###    -  10
;  11-####  #######    ######  ###    -  11
;  12-#####  ###############  ####    -  12
;  13-###### ############### #####    -  13
;  14-###### ############### #####    -  14
;  15-#####  ###############  ####    -  15
;  16-####  #################  ###    -  16
;  17-###  #######     #######  ##    -  17
;  18-### #######  ###  ####### ##    -  18
;  19-### ####### ##### ####### ##    -  19
;  20-### ####### ##### ####### ##    -  20
;  21-### ####### ##### ####### ##    -  21
;  22-### ####### ##### ####### ##    -  22
;  23-### #######  ###  ####### ##    -  23
;  24-### ########     ######## ##    -  24
;  25-###  ###################  ##    -  25
;  26-####  #################  ###    -  26
;  27-#####  ###############  ####    -  27
;  28-######   ###########   #####    -  28
;  29-########             #######    -  29
;  30-############################    -  30
;  31-############################    -  31
;     |         |         |       
;                                 
;               1         2       
;     0123456789012345678901234567

;( IMAGE DATA )

BMP_DIGITO_8_1:

	;+------------+
	;| BMP Header |
	;+------------+
	.DW      1 ;Bits Color 1 bit
	.DW     28 ;Width Pixels
	.DW     32 ;Height Pixels
	.DW      4 ;Width Bytes
	.DW    128 ;Size Bytes
	;+------------+
	;|  BMP Data  |
	;+------------+
	.DB 0x00,0x00,0x00,0x00,0x00,0x7F,0xF0,0x00,0x01,0xC0,0x1C,0x00,0x03,0x00,0x06,0x00
	.DB 0x06,0x00,0x03,0x00,0x0C,0x00,0x01,0x80,0x08,0x0F,0x80,0x80,0x08,0x18,0xC0,0x80
	.DB 0x08,0x10,0x40,0x80,0x08,0x10,0x40,0x80,0x08,0x18,0xC0,0x80,0x0C,0x07,0x81,0x80
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	.DB 0x03,0x80,0x0E,0x00,0x00,0xFF,0xF8,0x00,0x00,0x00,0x00,0x00,0x00,0x00,0x00,0x00

