;<$DS_HEADER>
;+--------------------------------------------------------------------------------+              
;|João D´Artagnan A. Oliveira Programmer and Author; 				  |
;|										  |
;| All rights reserved.								  |
;|										  |
;|   Redistribution and use in source and binary forms, with or without		  |
;|  modification, are permitted provided that the following conditions are met:	  |
;|										  |
;|   * Redistributions of source code must retain the above copyright		  |
;|     notice, this list of conditions and the following disclaimer.		  |
;|										  |
;|   THIS SOFTWARE IS PROVIDED BY THE COPYRIGHT HOLDERS AND CONTRIBUTORS "AS IS"  |
;|   AND ANY EXPRESS OR IMPLIED WARRANTIES, INCLUDING, BUT NOT LIMITED TO, THE    |
;|   IMPLIED WARRANTIES OF MERCHANTABILITY AND FITNESS FOR A PARTICULAR PURPOSE   |
;|   ARE DISCLAIMED. IN NO EVENT SHALL THE COPYRIGHT OWNER OR CONTRIBUTORS BE     |
;|   LIABLE FOR ANY DIRECT, INDIRECT, INCIDENTAL, SPECIAL, EXEMPLARY, OR	  |
;|   CONSEQUENTIAL DAMAGES (INCLUDING, BUT NOT LIMITED TO, PROCUREMENT OF	  |
;|   SUBSTITUTE GOODS OR SERVICES; LOSS OF USE, DATA, OR PROFITS; OR BUSINESS	  |
;|   INTERRUPTION) HOWEVER CAUSED AND ON ANY THEORY OF LIABILITY, WHETHER IN	  |
;|   CONTRACT, STRICT LIABILITY, OR TORT (INCLUDING NEGLIGENCE OR OTHERWISE)	  |
;|   ARISING IN ANY WAY OUT OF THE USE OF THIS SOFTWARE, EVEN IF ADVISED OF THE   |
;|   POSSIBILITY OF SUCH DAMAGE.						  |
;|										  |
;|   Brasília, Brazil November 30,2015 	06:28 am				  |
;+--------------------------------------------------------------------------------+
;</$DS_HEADER>
;+--------------------------------------------------------------------------------------------
;| Source
;|     Path : C:\NEPER_THE_MATH\PROJETOS\MOTION_DETECTOR\VERSIONS\_FREE_VERSION_\PROGRAMS\AVR\BMPS\
;|     File : KEYBOARD_5.BMP
;|
;| Destiny
;|     Path : C:\NEPER_THE_MATH\PROJETOS\MOTION_DETECTOR\VERSIONS\_FREE_VERSION_\PROGRAMS\AVR\BMPS\
;|     File : KEYBOARD_5.ASM
;|
;| Destiny Image Properties
;|     Size   :   736 Bytes
;|     Width  :   128 Pixels
;|     Height :    46 Pixels
;|     Width  :    16 Bytes
;|     Colors :     2 Levels (1 bit)
;+--------------------------------------------------------------------------------------------

;( IMAGE CONTENTS )

;                                                                                                         1                           
;               1         2         3         4         5         6         7         8         9         0         1         2       
;     01234567890123456789012345678901234567890123456789012345678901234567890123456789012345678901234567890123456789012345678901234567
;     |         |         |         |         |         |         |         |         |         |         |         |         |       
;   0-                                                                                                                        #   #   -   0
;   1-                                                                                                                        #       -   1
;   2-################################################################################################################################-   2
;   3-                                                                                                                #       #       -   3
;   4-       #      # #     # #      #     ##       #         #     #         ##    ###    ##      #####   #####      # ####  #       -   4
;   5-       #      # #     # #     ####   ##  #   # #       #       #       ##    #   #    ##     #           #      # #  ## # #   # -   5
;   6-       #      # #    #####   # #        #     #       #         #     ##         #     ##    #           #      # #  ## #  # #  -   6
;   7-       #              # #     ###      #     # # #    #         #    ##         #       ##   #           #      # #  ## #   #   -   7
;   8-       #             #####     # #    #      #  #     #         #     ##       #       ##    #           #      # #  ## #  # #  -   8
;   9-                      # #    ####    #  ##   #  ##     #       #       ##             ##     #           #      # ##### # #   # -   9
;  10-       #              # #      #        ##    ##        #     #         ##     #     ##      #####   #####      #  #### #       -  10
;  11-                                                                                                                #       #       -  11
;  12-################################################################################################################################-  12
;  13-                                                                  #                            #                                -  13
;  14-     #     ####      ##    ###     #####   #####    ###    #   #  #           ######  ######   #   #####   ###    ###           -  14
;  15-    # #     #  #    #  #    # #    #       #       #   #   #   #  #    #      #  # #  #    #   #   #   #  #   #  #   #    #     -  15
;  16-   #   #    #  #   #        #  #   #       #       #       #   #  #   #####   #   ##  # ## #   #      #   #   #  #   #    #     -  16
;  17-   #   #    ###    #        #  #   ####    ####    # ###   #####  #  ######   #    #  #    #   #     #     ###    ####  #####   -  17
;  18-   #####    #  #   #        #  #   #       #       #   #   #   #  #   #####   #    #  # ## #   #     #    #   #      #    #     -  18
;  19-   #   #    #  #    #  #    # #    #       #       #   #   #   #  #    #      #    #  #    #   #     #    #   #     #     #     -  19
;  20-   #   #   ####      ##    ###     #####   #        ###    #   #  #           ######  ######   #     #     ###    ##            -  20
;  21-                                                                  #                            #                                -  21
;  22-    ###      ###   #   #   #       #   #   #   #    ###    ####   #            #       ###     #      #   #####    ##           -  22
;  23-     #        #    #  #    #       ## ##   ##  #   #   #   #   #  #    #  #   # #     #   #    #     ##   #       #             -  23
;  24-     #        #    # #     #       # # #   ##  #   #   #   #   #  #   ##  #   ### #   #   #    #    # #   ###    #              -  24
;  25-     #        #    ##      #       # # #   # # #   #   #   ####   #  ######   # ## #   # #     #   #  #      #   ####   #####   -  25
;  26-     #     #  #    # #     #       #   #   #  ##   #   #   #      #   ##      # ####   # #     #   #####      #  #   #          -  26
;  27-     #     #  #    #  #    #       #   #   #  ##   #   #   #      #    #      # ## #  ## ##    #      #      #   #   #          -  27
;  28-    ###     ##     #   #   #####   #   #   #   #    ###    #      #                            #      #   ###     ###           -  28
;  29-                                                                  #                            #                                -  29
;  30-    ###    ####     ###    #####   #   #   #   #   #   #   #   #  #  #                     #   #     #     ###    ###     #     -  30
;  31-   #   #   #   #   #   #     #     #   #   #   #   #   #   #   #  #  #  #       #       #  #   #    ##    #   #  #   #  # # #   -  31
;  32-   #   #   #   #   #         #     #   #   #   #   #   #    # #   #  # ##      ###      ## #   #   # #        #      #   ###    -  32
;  33-   #   #   ####     ###      #     #   #   #   #   # # #     #    #  ######   #####   ######   #     #       #     ##     #     -  33
;  34-   # # #   # #         #     #     #   #    # #    # # #    # #   #  # ##       #       ## #   #     #     ##        #   ###    -  34
;  35-   #  #    #  #    #   #     #     #   #    # #    ## ##   #   #  #  #  #       #       #  #   #     #    #      #   #  # # #   -  35
;  36-    ## #   #   #    ###      #      ###      #     #   #   #   #  #  #                     #   #   #####  #####   ###     #     -  36
;  37-                                                                  #                            #                                -  37
;  38-   #   #   #####     ##########################################   #                            #           ###                  -  38
;  39-   #   #       #    #                                          #  #    #        #        #     #          #   #                 -  39
;  40-   #   #      #     #                                          #  #   ##        #        ##    #          #  ##             #   -  40
;  41-    ###      #      #                                          #  #  ######   #####   ######   #          # # #    ##      #    -  41
;  42-     #      #       #                                          #  #   ##       ###       ##    #    ##    ##  #    ##     #     -  42
;  43-     #     #        #                                          #  #    #        #        #     #    ##    #   #    #     #      -  43
;  44-     #     #####     ##########################################   #                            #           ###    #     #       -  44
;  45-                                                                  #                            #                                -  45
;     |         |         |         |         |         |         |         |         |         |         |         |         |       
;                                                                                                         1                           
;               1         2         3         4         5         6         7         8         9         0         1         2       
;     01234567890123456789012345678901234567890123456789012345678901234567890123456789012345678901234567890123456789012345678901234567

;( IMAGE DATA )

BMP_KEYBOARD_5:

	;+------------+
	;| BMP Header |
	;+------------+
	.DW      1 ;Bits Color 1 bit
	.DW    128 ;Width Pixels
	.DW     46 ;Height Pixels
	.DW     16 ;Width Bytes
	.DW    736 ;Size Bytes
	;+------------+
	;|  BMP Data  |
	;+------------+
	.DB 0xFF,0xFF,0xFF,0xFF,0xFF,0xFF,0xFF,0xFF,0xFF,0xFF,0xFF,0xFF,0xFF,0xFF,0xFF,0x77
	.DB 0xFF,0xFF,0xFF,0xFF,0xFF,0xFF,0xFF,0xFF,0xFF,0xFF,0xFF,0xFF,0xFF,0xFF,0xFF,0x7F
	.DB 0x00,0x00,0x00,0x00,0x00,0x00,0x00,0x00,0x00,0x00,0x00,0x00,0x00,0x00,0x00,0x00
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        .DB 0xB5,0x3A,0xE8,0xEF,0xF2,0xE1,0x3D,0xB0,0xB2,0xAE,0xB1,0xB8,0x3A,0x27,0x18,0X00

