;+--------------------------------------------------------------------------------------------
;| Source
;|     Path : C:\NEPER_THE_MATH\PROJETOS\MOTION_DETECTOR\VERSIONS\DSQUARE\PROGRAMS\AVR\BMPS\
;|     File : IP_INPUT_1.BMP
;|
;| Destiny
;|     Path : C:\NEPER_THE_MATH\PROJETOS\MOTION_DETECTOR\VERSIONS\DSQUARE\PROGRAMS\AVR\BMPS\
;|     File : IP_INPUT_1.ASM
;|
;| Destiny Image Properties
;|     Size   :   198 Bytes
;|     Width  :    85 Pixels
;|     Height :    18 Pixels
;|     Width  :    11 Bytes
;|     Colors :     2 Levels (1 bit)
;+--------------------------------------------------------------------------------------------

;( IMAGE CONTENTS )

;                                                                                          
;               1         2         3         4         5         6         7         8    
;     0123456789012345678901234567890123456789012345678901234567890123456789012345678901234
;     |         |         |         |         |         |         |         |         |    
;   0- ###################################################################################    -   0
;   1-#                                                                                   #   -   1
;   2-#  ###############################################################################  #   -   2
;   3-# #                                                                               # #   -   3
;   4-# #  ###   ###   ###     ###   ###   ###     ###   ###   ###     ###   ###   ###  # #   -   4
;   5-# # #   # #   # #   #   #   # #   # #   #   #   # #   # #   #   #   # #   # #   # # #   -   5
;   6-# # #  ## #  ## #  ##   #  ## #  ## #  ##   #  ## #  ## #  ##   #  ## #  ## #  ## # #   -   6
;   7-# # # # # # # # # # #   # # # # # # # # #   # # # # # # # # #   # # # # # # # # # # #   -   7
;   8-# # ##  # ##  # ##  #   ##  # ##  # ##  #   ##  # ##  # ##  #   ##  # ##  # ##  # # #   -   8
;   9-# # #   # #   # #   #   #   # #   # #   #   #   # #   # #   #   #   # #   # #   # # #   -   9
;  10-# #  ###   ###   ###  #  ###   ###   ###  #  ###   ###   ###  #  ###   ###   ###  # #   -  10
;  11-# #                                                                               # #   -  11
;  12-#  ###############################################################################  #   -  12
;  13-#                                                                                   #   -  13
;  14-#                                                                                   #   -  14
;  15-#                                                                                   #   -  15
;  16-#                                                                                   #   -  16
;  17- ###################################################################################    -  17
;     |         |         |         |         |         |         |         |         |    
;                                                                                          
;               1         2         3         4         5         6         7         8    
;     0123456789012345678901234567890123456789012345678901234567890123456789012345678901234

;( IMAGE DATA )

BMP_IP_INPUT_1:

	;+------------+
	;| BMP Header |
	;+------------+
	.DW      1 ;Bits Color 1 bit
	.DW     85 ;Width Pixels
	.DW     18 ;Height Pixels
	.DW     11 ;Width Bytes
	.DW    198 ;Size Bytes
	;+------------+
	;|  BMP Data  |
	;+------------+
	.DB 0x80,0x00,0x00,0x00,0x00,0x00,0x00,0x00,0x00,0x00,0x08,0x7F,0xFF,0xFF,0xFF,0xFF
	.DB 0xFF,0xFF,0xFF,0xFF,0xFF,0xF0,0x60,0x00,0x00,0x00,0x00,0x00,0x00,0x00,0x00,0x00
	.DB 0x30,0x5F,0xFF,0xFF,0xFF,0xFF,0xFF,0xFF,0xFF,0xFF,0xFF,0xD0,0x58,0xE3,0x8F,0x8E
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	.DB 0x00,0x00,0x00,0x00,0x00,0x08

