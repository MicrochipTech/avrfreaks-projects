;+--------------------------------------------------------------------------------------------
;| Source
;|     Path : C:\NEPER_THE_MATH\PROJETOS\MOTION_DETECTOR\VERSIONS\DSQUARE\PROGRAMS\AVR\BMPS\
;|     File : BNC_MACHO_ANI_6.BMP
;|
;| Destiny
;|     Path : C:\NEPER_THE_MATH\PROJETOS\MOTION_DETECTOR\VERSIONS\DSQUARE\PROGRAMS\AVR\BMPS\
;|     File : BNC_MACHO_ANI_6.ASM
;|
;| Destiny Image Properties
;|     Size   :   464 Bytes
;|     Width  :   128 Pixels
;|     Height :    29 Pixels
;|     Width  :    16 Bytes
;|     Colors :     2 Levels (1 bit)
;+--------------------------------------------------------------------------------------------

;( IMAGE CONTENTS )

;                                                                                                         1                           
;               1         2         3         4         5         6         7         8         9         0         1         2       
;     01234567890123456789012345678901234567890123456789012345678901234567890123456789012345678901234567890123456789012345678901234567
;     |         |         |         |         |         |         |         |         |         |         |         |         |       
;   0-################################################################################################################################-   0
;   1-################################################################################################################################-   1
;   2-##################################################################################################        #########             -   2
;   3-################################################################################################## ###### ######### ##          -   3
;   4-################################################################################################## #    # ######### ##   # # # #-   4
;   5-################################################################################################## ###### ######### ##   # # # #-   5
;   6-################################################################################################## #    #           ##   # # # #-   6
;   7-#############################################################################################      ######  ### #### ##   # # # #-   7
;   8-###########################################################################################   #### #    #  ###  ### ## # # # # #-   8
;   9-################################################################################            ###### ######   ### ### ## # # # # #-   9
;  10-                                                                                 ################# #    # # ### ### ## # # # #  -  10
;  11-################################################################################ ################# ###### #  ##  ## ## # # # ## -  11
;  12-################################################################################ ################# #    # ## # #    ## # # #  # -  12
;  13-################################################################################ ################# ###### ##  ### # ## # # ## # -  13
;  14-################################################################################ ################# #    # ### ### # ## # #  # # -  14
;  15-################################################################################ ################# ###### ###  # ## ## # ## # # -  15
;  16-################################################################################ ################# #    # ####      ## # ## # # -  16
;  17-################################################################################ ################# ###### ######### ## #  # # # -  17
;  18-                                                                                 ################# #    # ######### ## #  # # # -  18
;  19-################################################################################            ###### ###### ######### ## ## # # # -  19
;  20-###########################################################################################   #### #    # ######### ## ## # # # -  20
;  21-#############################################################################################      ###### ######### ##    # # # -  21
;  22-################################################################################################## #    #           ##    # # ##-  22
;  23-################################################################################################## ###### ######### ##    # #  #-  23
;  24-################################################################################################## #    # ######### ##    # ## #-  24
;  25-################################################################################################## ###### ######### ##          -  25
;  26-##################################################################################################        #########             -  26
;  27-################################################################################################################################-  27
;  28-################################################################################################################################-  28
;     |         |         |         |         |         |         |         |         |         |         |         |         |       
;                                                                                                         1                           
;               1         2         3         4         5         6         7         8         9         0         1         2       
;     01234567890123456789012345678901234567890123456789012345678901234567890123456789012345678901234567890123456789012345678901234567

;( IMAGE DATA )

BMP_BNC_MACHO_ANI_6:

	;+------------+
	;| BMP Header |
	;+------------+
	.DW      1 ;Bits Color 1 bit
	.DW    128 ;Width Pixels
	.DW     29 ;Height Pixels
	.DW     16 ;Width Bytes
	.DW    464 ;Size Bytes
	;+------------+
	;|  BMP Data  |
	;+------------+
	.DB 0x00,0x00,0x00,0x00,0x00,0x00,0x00,0x00,0x00,0x00,0x00,0x00,0x00,0x00,0x00,0x00
	.DB 0x00,0x00,0x00,0x00,0x00,0x00,0x00,0x00,0x00,0x00,0x00,0x00,0x00,0x00,0x00,0x00
	.DB 0x00,0x00,0x00,0x00,0x00,0x00,0x00,0x00,0x00,0x00,0x00,0x00,0x3F,0xC0,0x1F,0xFF
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	.DB 0x00,0x00,0x00,0x00,0x00,0x00,0x00,0x00,0x00,0x00,0x00,0x00,0x00,0x00,0x00,0x00

