;+--------------------------------------------------------------------------------------------------------
;| Source
;|     Path : D:\__NEPER_THE_MATH__\PROJETOS\MOTION_DETECTOR\VERSIONS\HICHAM_GHORAYEB\PROGRAMS\AVR\BMPS\
;|     File : DARTAGNAN.JPG
;|
;| Destiny
;|     Path : D:\__NEPER_THE_MATH__\PROJETOS\MOTION_DETECTOR\VERSIONS\HICHAM_GHORAYEB\PROGRAMS\AVR\BMPS\
;|     File : DARTAGNAN.ASM
;|
;| Destiny Image Properties
;|     Size   :  1664 Bytes
;|     Width  :    51 Pixels
;|     Height :    64 Pixels
;|     WidthBt:    26 Bytes
;|     Colors :    16 Levels (4 bit)
;+--------------------------------------------------------------------------------------------------------

;( IMAGE CONTENTS )

;                                                                                                           
;                         1                   2                   3                   4                   5 
;     0 1 2 3 4 5 6 7 8 9 0 1 2 3 4 5 6 7 8 9 0 1 2 3 4 5 6 7 8 9 0 1 2 3 4 5 6 7 8 9 0 1 2 3 4 5 6 7 8 9 0 
;     |                   |                   |                   |                   |                   | 
;   0-......................  ....      ..  ..    ..++  ..--..--....**++++++++++++++++++++++++++++++++++++++XX-   0
;   1-....................  ..  ......    ..  ....    --..  ----..++******++++++++++++++++++++++++++++++++++XX-   1
;   2-..........................----    ..  ..  ....--  ....++****==**********++++++++++++++++++++++++++++++XX-   2
;   3-..........................++..++..==....--....--....==**##********************++++++++++++++++++++++++XX-   3
;   4---................--........@@++----++----..##--..  ######==******************++****++++++++++++++++++XX-   4
;   5-----................##==++..##  --**##@@..--++==..--**====####**********++++********++++++++++++++++++XX-   5
;   6-------................++##==++++==++@@@@@@##====@@@@**####@@@@@@**********++****++++++++++++++++++++++XX-   6
;   7-------............------@@########**@@**##==@@@@==######==##@@@@######==**++**++++++++++++++++++++++++XX-   7
;   8-....------......--..--**@@@@@@######@@@@@@@@XX@@==**##@@##==@@##**##==**==++++++**++++++++++++++++++++XX-   8
;   9-------....--....++..****##XX@@==##@@@@##XX@@XX@@@@==############@@########**++++++++++++++++++++++++++XX-   9
;  10-..------------**--**@@@@@@@@@@@@@@@@==##XX####XX@@########==@@##@@@@@@########**++++++++++++++++++++++XX-  10
;  11-------..----..++..####@@XX##XX@@@@@@##==--++====**==####@@@@@@XX##########@@##**++++++++++++++++++++++XX-  11
;  12---....--------######@@@@@@XX@@@@@@@@==--------**====++++****@@@@##@@@@########==++**++++++++++++++++++XX-  12
;  13---..------++--==##@@@@@@XXXX@@####--++..--..........--..--++**##@@######@@====##**==**++++++++++++++++XX-  13
;  14-------..--XX@@==##@@XX@@XXXX####----++      ..    ........--**====##@@@@@@####**==##==**++++++++++++++XX-  14
;  15---..------@@@@XX@@@@XX##------....--........  ....  ......----**@@####@@@@@@@@##==@@##**++++++++++++++XX-  15
;  16-----------##@@@@##@@##--......--..--................    ......++**==@@XXXXXX@@@@##==****++++++++++++++XX-  16
;  17-----..++++**==@@@@##++....  ..--..........    ....  --....--..--**==##XX@@##XXXX@@==**++++++**++++++++XX-  17
;  18---------##++##==@@@@--........--......----**++##@@##XX  ==------++##++==@@@@@@==##====++++++++++++++++XX-  18
;  19---------++##==####==----........  --**--..@@@@##==++**XX++@@@@@@++++##==####@@####====++++++++++++++++XX-  19
;  20---------++**@@@@XX++----  ....    --  XX@@--....      @@####@@XX@@XXXX==##XX@@@@##**++++**++++++++++XX-  20
;  21-++--++----**@@@@XX++--..--++------  ####  ....--------##**....**@@@@@@@@@@@@XX@@**++++**++++++++++XX-  21
;  22---++----++==@@######XX@@XX@@++--##..@@......++++@@++..++..==      --++@@####XX@@##@@##**++++++++++++++XX-  22
;  23-----++--++##@@XXXX##@@##++**@@XX@@XX##----  ++--..--..----**........--++@@XX@@@@##@@##++++++**++++++++XX-  23
;  24-++++++++**==XX@@##@@==..  ..****==........++------  ....--##**--......--**@@####==@@@@++**++++++++++++XX-  24
;  25-++++++--**@@==--@@==++..**----++..  @@  ..--..  --..--++**--..--..  ++**##**##==##XX**++**++++++++++XX-  25
;  26-++++++++++XX==--**##--**======**........  ..----....--##....  ..----..**@@####++++XX**++****++++++++XX-  26
;  27-++++++++@@XX**..  ##++@@..**--++..  ..  **  ..++++##++..  ....--....**##----  ..@@**++++++**++++++XX-  27
;  28-**++++++++==**XX..##--**++----..        ++##++......  ........----....----**..##****++++++++++++XX-  28
;  29-++++++++++**XX--  --**----==**      ++@@++  ..          ......--....--++    --##++**++**++++++++XX-  29
;  30-**++****++**##XX++++--..--@@  ##............  ..      ....--..--..--++....--==++++****++++++++XX-  30
;  31-++**++++****##@@XX@@**##@@##  ..  ++....----....                  ..----....++  --..********++++++++++XX-  31
;  32-++**++++++==##@@@@XX==----      --++--........--..                ..----..--++....--++**++++**++++++++XX-  32
;  33-****++++**##@@@@@@@@++....    ..++--......  ......                  ..----..--  ..##@@**++++++**++++++XX-  33
;  34-**++++**##@@@@@@##@@**++      --++--..--                            ..----..++**--XXXX++****++++++++++XX-  34
;  35-**++**==@@##@@@@##@@##**....  ++++--  ..--++++++**++--..            ..----..--**@@@@##++**++++++++++++XX-  35
;  36-++**####@@####@@@@##@@++......----++==--**..--..........      ..    ..--------++==@@@@**++++**++++++++XX-  36
;  37-++==########@@##@@@@##**--..--..++**++..++....      ......          ..--..--++++--##@@****++**++++++++XX-  37
;  38-**==##############@@@@##++..--..--**----....        ....      ..  ....++..--++++++####******++********XX-  38
;  39-@@####@@############@@@@++--....++++--..--....      ......    ..    ..--..--++++--==##******++********XX-  39
;  40-@@@@@@##@@##@@####@@@@@@##++....----........--------....    ....  ..--..--..--++++==..**++************XX-  40
;  41-@@@@##**####@@@@######@@##**--..----..----....................    ..--------++++--  ..==************XX-  41
;  42-@@@@==++######@@########@@##++----++----..          ..........  ....----..--++--    ..**************XX-  42
;  43-@@==++++################@@##==++..--++--..        ................----..------      ..************XX-  43
;  44-##**++++##################@@##**--++++..  ........----....  ......--..------    ..**********XX-  44
;  45-**++++++####@@##====######@@@@##**++++----..------....    ............----..  --********XX-  45
;  46-++++++++##########==######@@@@@@==++****++------..      ........--..----..    ..        XX-  46
;  47-++++++++##################@@@@@@@@**++--......      ..........--........              XX-  47
;  48-++++++++##################@@@@@@@@@@==------....  ........--......----        XX-  48
;  49-++++++++####################@@@@@@@@@@==**++----------..----....----    XX-  49
;  50-++++++++############@@@@####@@@@XX@@@@@@****++----..----......--..XX-  50
;  51-++++++++########@@@@@@@@########@@XX@@XX@@++++--------......--..  XX-  51
;  52-++++++++######@@@@@@@@@@@@########XX@@@@  ****----......----..XX-  52
;  53-++++++++######@@@@@@@@@@@@##########XX..  ==++--........--..  XX-  53
;  54-****++**######@@@@@@@@@@@@##########    **----........--**    --  XX-  54
;  55-********######@@@@@@@@@@@@########@@  **++....    ..--XX-  55
;  56-====****######@@@@@@@@@@@@##########  ++++++......==XX-  56
;  57-====****######@@@@@@@@@@@@##########**..----++--  XX-  57
;  58-====**==######@@@@@@@@@@@@############  ------++..  **  XX-  58
;  59-========######@@@@@@@@@@@@##########@@@@++....    XX-  59
;  60-========######@@@@@@@@@@@@##########@@@@##      ..--  **XX-  60
;  61-======########@@@@@@@@@@@@##########@@@@  ==    --..@@XX-  61
;  62-======########@@@@@@@@@@@@############**..--++  ++  ==  XX-  62
;  63-======####==##@@@@@@@@@@############..    @@--##XX-  63
;     |                   |                   |                   |                   |                   | 
;                                                                                                           
;                         1                   2                   3                   4                   5 
;     0 1 2 3 4 5 6 7 8 9 0 1 2 3 4 5 6 7 8 9 0 1 2 3 4 5 6 7 8 9 0 1 2 3 4 5 6 7 8 9 0 1 2 3 4 5 6 7 8 9 0 

;( IMAGE DATA )

BMP_DARTAGNAN:

	;+------------+
	;| BMP Header |
	;+------------+
	.DW      4 ;Bits Color 4 bit
	.DW     51 ;Width Pixels
	.DW     64 ;Height Pixels
	.DW     26 ;Width Bytes
	.DW   1664 ;Size Bytes
	;+------------+
	;|  BMP Data  |
	;+------------+
	.DB 0xAA,0xAA,0xAA,0xBB,0xBB,0xBB,0xBB,0xCB,0xCB,0xCB,0xCB,0xB8,0xCB,0x9B,0x9A,0xA6
	.DB 0x77,0x77,0x87,0x77,0x77,0x77,0x77,0x77,0x77,0x70,0xAA,0xAA,0xAA,0xAB,0xAB,0xCB
	.DB 0xCB,0xBB,0xBC,0xBC,0xBB,0xCC,0x9B,0xB9,0x9A,0x76,0x67,0x77,0x77,0x77,0x77,0x77
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	.DB 0xC1,0x9E,0xDE,0xFE,0xDE,0xFE,0xE4,0xEE,0xEE,0xFE,0xEE,0xFF,0xDF,0xEF,0xDE,0xF0

