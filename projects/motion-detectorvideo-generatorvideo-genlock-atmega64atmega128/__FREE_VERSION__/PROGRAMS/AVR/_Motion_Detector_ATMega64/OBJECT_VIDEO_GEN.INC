;<$DS_HEADER>
;+--------------------------------------------------------------------------------+              
;|João D´Artagnan A. Oliveira Programmer and Author; 				  |
;|										  |
;| All rights reserved.								  |
;|										  |
;|   Redistribution and use in source and binary forms, with or without		  |
;|  modification, are permitted provided that the following conditions are met:	  |
;|										  |
;|   * Redistributions of source code must retain the above copyright		  |
;|     notice, this list of conditions and the following disclaimer.		  |
;|										  |
;|   THIS SOFTWARE IS PROVIDED BY THE COPYRIGHT HOLDERS AND CONTRIBUTORS "AS IS"  |
;|   AND ANY EXPRESS OR IMPLIED WARRANTIES, INCLUDING, BUT NOT LIMITED TO, THE    |
;|   IMPLIED WARRANTIES OF MERCHANTABILITY AND FITNESS FOR A PARTICULAR PURPOSE   |
;|   ARE DISCLAIMED. IN NO EVENT SHALL THE COPYRIGHT OWNER OR CONTRIBUTORS BE     |
;|   LIABLE FOR ANY DIRECT, INDIRECT, INCIDENTAL, SPECIAL, EXEMPLARY, OR	  |
;|   CONSEQUENTIAL DAMAGES (INCLUDING, BUT NOT LIMITED TO, PROCUREMENT OF	  |
;|   SUBSTITUTE GOODS OR SERVICES; LOSS OF USE, DATA, OR PROFITS; OR BUSINESS	  |
;|   INTERRUPTION) HOWEVER CAUSED AND ON ANY THEORY OF LIABILITY, WHETHER IN	  |
;|   CONTRACT, STRICT LIABILITY, OR TORT (INCLUDING NEGLIGENCE OR OTHERWISE)	  |
;|   ARISING IN ANY WAY OUT OF THE USE OF THIS SOFTWARE, EVEN IF ADVISED OF THE   |
;|   POSSIBILITY OF SUCH DAMAGE.						  |
;|										  |
;|   Brasília, Brazil November 30,2015 	06:28 am				  |
;+--------------------------------------------------------------------------------+
;</$DS_HEADER>;
						 ///////////////////////\\\\\\\\\\\\\\\\\\\\\\\\\
;						//						\\
;-----------------------------------------------|| S O F T W A R E  V I D E O  G E N E R A T O R ||-----------------------------------------------------
;						\\						//
;						 \\\\\\\\\\\\\\\\\\\\\\\/////////////////////////

;
;
; COMPOSITE VIDEO GENERATED BY THIS SOFTARE DETAILS
;
;
; VERTICAL SYNCRONISM ODD FIELD
;
; +  +----------+ +----+ +----+ +----+ +----+ +----+ +----+    +-+    +-+    +-+    +-+    +-+    +-+ +----+ +----+ +----+ +----+ +----+ +----+  +----------
; |  |          | |    | |    | |    | |    | |    | |    |    | |    | |    | |    | |    | |    | | |    | |    | |    | |    | |    | |    |  |
; |HS|          | |    | |    | |    | |    | |    | |    |    | |    | |    | |    | |    | |    | | |    | |    | |    | |    | |    | |    |HS| 
; +--+          +-+    +-+    +-+    +-+    +-+    +-+    +----+ +----+ +----+ +----+ +----+ +----+ +-+    +-+    +-+    +-+    +-+    +-+    +--+
; |     262     |      1      |      2      |      3      |      4      |      5      |     6       |       7     |       8     |       9     |     10      |   
;
; <----- H ----><------------ EQUALIZING PULSES ---------><--------- VERT SYNC PULES --------------><---------- EQUALIZING PULSES -----------><----- H ---->
;
;
; VERTICAL SYNCRONISM EVEN FIELD
;																  <---- H ----->																     <
;------+  +-----+ +----+ +----+ +----+ +----+ +----+ +----+    +-+    +-+    +-+    +-+    +-+    +-+ +----+ +----+ +----+ +----+ +----+ +----------+  +----------+  +-
;      |  |     | |    | |    | |    | |    | |    | |    |    | |    | |    | |    | |    | |    | | |    | |    | |    | |    | |    | |     |    |  |	  |  |
;      |HS|     | |    | |    | |    | |    | |    | |    |    | |    | |    | |    | |    | |    | | |    | |    | |    | |    | |    | |     |    |HS| 	  |HS|
;      +--+     +-+    +-+    +-+    +-+    +-+    +-+    +----+ +----+ +----+ +----+ +----+ +----+ +-+    +-+    +-+    +-+    +-+    +-+     |    +--+	  +--+
; 262  |   263  |      1      |      2      |      3      |      4      |      5      |      6      |      7      |       8     |       9      |     10              
;
; <- H/2 -><------------ EQUALIZING PULSES ---------><--------- VERT SYNC PULES --------------><-------------- EQUALIZING PULSES -------------><----- H ---->
;
; HORIZONTAL SYNCRONISM
;
;			      +--------------------------------------+ .......... <--- WHITE LEVEL
;                             |					     |
;                             |					     |
;                             |					     |
;                             |	      VIDEO OUT AREA DOT PIXELS	     |
;                             |					     |
;                             |					     |
; +-+                         +--------------------------------------+ .......... <--- BLACK LEVEL
;   |			      |					     |
;   +-----+         +---------+<------ VIDEO TIME 128 PIXELS ------->+----------- <--- BASE LEVEL
;         |         |
;         |         |
;         |         |
;         |         |
;         |         |
;         |         |
;         +---------+ ........................................................... <--- SYNC LEVEL
;   |  d  |--- a ---|--- b----|----------------- c ------------------|
;
; NTSC TIMING
;
; a =  4.70 us
; b =  9.20 us
; c = 42.00 us
; d =  7.65 us
;
; PAL TIMING
;
; a =  4.70 us
; b =  9.20 us
; c = 42.00 us
; d =  8.10 us

;>--------------------------------------------------------------<
;| OBJECT     : VIDEO_OUT					|
;>--------------------------------------------------------------<
;| DESCRIPTION: This object generate a composite video signal	|
;|		NTSC M standard BW using a DAC with resistor and|
;|		a transistor for buffer.			|
;>--------------------------------------------------------------<

;>----------------------<
;| OBJECT DEFINITIONS	|
;>----------------------<

;-------------------------< PORT DEFINITONS >----------------------------

.EQU	_VIDEO_OUT_PORT_OUTPUT	= PORTF		;VIDEO OUTPUT port definitions
.EQU	_VIDEO_OUT_PORT_DIR	= DDRF
.EQU	_VIDEO_OUT_PORT_INPUT	= PINF

.EQU	_VIDEO_IN_PORT_OUTPUT	= PORTC		;VIDEO INPUT port definitions
.EQU	_VIDEO_IN_PORT_DIR	= DDRC
.EQU	_VIDEO_IN_PORT_INPUT	= PINC

.EQU	_VIDEO_COMP_PORT_OUTPUT	= PORTE		;VIDEO COMPARATOR port definitions
.EQU	_VIDEO_COMP_PORT_DIR	= DDRE
.EQU	_VIDEO_COMP_PORT_INPUT	= PINE

.EQU	_VIDEO_MIX_PORT_OUTPUT	= PORTG		;VIDEO MIXER port definitions
.EQU	_VIDEO_MIX_PORT_DIR	= DDRG
.EQU	_VIDEO_MIX_PORT_INPUT	= PING

.EQU	_VIDEO_SYNC_PORT_OUTPUT	= PORTA		;VIDEO SYNCHRONISM port definitions
.EQU	_VIDEO_SYNC_PORT_DIR	= DDRA
.EQU	_VIDEO_SYNC_PORT_INPUT	= PINA

;-------------------------< CONSTANT DEFINITONS >------------------------


;+---------------------------------------
;| VIDEO Constants
;+---------------------------------------
.EQU	_VIDEO_OUT_NTSC			= 1				;to load NTSC parameters
.EQU	_VIDEO_OUT_PAL			= 2				;to load PAL parameters
.EQU	_VIDEO_OUT_NTSC_FREQUENCY	= 60				;in Hertz
.EQU	_VIDEO_OUT_PAL_FREQUENCY	= 50				;in Hertz
.EQU	_VIDEO_OUT_TIMER1_DIV_NTSC	= 1017-1 			;16Mhz/(1017*1xPrescaler)=15732,55Hz 0,01% error of NTSC standard
.EQU	_VIDEO_OUT_H_TIME_NTSC		= _VIDEO_OUT_TIMER1_DIV_NTSC
.EQU	_VIDEO_OUT_H_TIME_HALF_NTSC	= _VIDEO_OUT_TIMER1_DIV_NTSC/2	;H LINE HALF TIME
.EQU	_VIDEO_OUT_TIMER1_DIV_PAL	= 1024-1 			;16Mhz/(1024*1xPrescaler)=15625Hz of PAL standard
.EQU	_VIDEO_OUT_H_TIME_PAL		= _VIDEO_OUT_TIMER1_DIV_PAL
.EQU	_VIDEO_OUT_H_TIME_HALF_PAL	= _VIDEO_OUT_TIMER1_DIV_PAL/2	;H LINE HALF TIME
.EQU	_VIDEO_OUT_LEVEL_SYNC		= 0			;DAC value for sync
.EQU	_VIDEO_OUT_LEVEL_BASE		= 12			;DAC value for base
.EQU	_VIDEO_OUT_LEVEL_BLACK		= 13			;DAC value for black
.EQU	_VIDEO_OUT_LEVEL_WHITE_TOP	= 31			;DAC value for white top value
.EQU	_VIDEO_OUT_LEVEL_WHITE_TOP_MIXED= 31			;DAC value for white top value when mixed
.EQU	_VIDEO_OUT_CPU_LED_CT_MAX	= 15
.EQU	_VIDEO_OUT_MAX_WIDTH		= 128			;128 pixels
.EQU	_VIDEO_OUT_MAX_HEIGHT		= 192			;96 pixels
.EQU	_VIDEO_OUT_ODD_LINE_START_NTSC	= 43			;start line of odd lines
.EQU	_VIDEO_OUT_EVEN_LINE_START_NTSC	= 42			;start line of even lines
.EQU	_VIDEO_OUT_ODD_LINE_END_NTSC	= 233			;end line of odd lines
.EQU	_VIDEO_OUT_EVEN_LINE_END_NTSC	= 232			;end line of even lines
.EQU	_VIDEO_OUT_ODD_LINE_START_PAL	= 75			;start line of odd lines
.EQU	_VIDEO_OUT_EVEN_LINE_START_PAL	= 74			;start line of even lines
.EQU	_VIDEO_OUT_ODD_LINE_END_PAL	= 263			;end line of odd lines
.EQU	_VIDEO_OUT_EVEN_LINE_END_PAL	= 262			;end line of even lines

;+---------------------------------------
;| VIDEO Modes
;+---------------------------------------
.EQU	_VIDEO_MODE_128X96X2N		= 0			;128 x 96 pixels 2 colors sync internal
.EQU	_VIDEO_MODE_128X192X2N		= 1			;128 x 192 pixels 2 colors sync internal
.EQU	_VIDEO_MODE_128X96X2G		= 2			;128 x 96 pixels 2 colors sync external genlock
.EQU	_VIDEO_MODE_128X192X2G		= 3			;128 x 192 pixels 2 colors sync external genlock
.EQU	_VIDEO_MODE_96X72X16N		= 4			;64 x 96 pixels 16 colors sync internal	
								;take a very care with memory when use this mode
.EQU	_VIDEO_MODE_24X24X16N		= 5			;24 x 18 pixels 16 colors sync 
.EQU	_VIDEO_MODE_24X24X16D		= 6			;24 x 18 pixels 16 colors sync external genlog
								;used for digitalizing tests
;+---------------------------------------
;| VIDEO Sizes
;+---------------------------------------
.EQU	_VIDEO_SIZE_128X96X2N		= (128/8)*96*LOG2(2)			;128 x 96 pixels 2 colors sync internal
.EQU	_VIDEO_SIZE_128X192X2N		= (128/8)*192*LOG2(2)			;128 x 192 pixels 2 colors sync internal
.EQU	_VIDEO_SIZE_128X96X2G		= (128/8)*96*LOG2(2)			;128 x 96 pixels 2 colors sync external genlock
.EQU	_VIDEO_SIZE_128X192X2G		= (128/8)*192*LOG2(2)			;128 x 192 pixels 2 colors sync external genlock
.EQU	_VIDEO_SIZE_96X72X16N		= (96/8)*72*LOG2(16)			;64 x 96 pixels 16 colors sync internal						;take a very care with memory when use this mode
.EQU	_VIDEO_SIZE_24X24X16N		= 24*24*LOG2(16)			;24 x 18 pixels 16 colors sync 
.EQU	_VIDEO_SIZE_24X24X16D		= 24*24*LOG2(16)			;24 x 18 pixels 16 colors sync external genlog

;+---------------------------------------
;| VIDEO Buffers Areas Sizes
;+---------------------------------------

.EQU    _VIDEO_OUT_BUFFER_SIZE          = _VIDEO_SIZE_128x96x2N                                 ;Max size used in this version 
                                                                                                ;96X72X16N (Max size Screen)
.EQU	_VIDEO_OUT_BUFFER_INPUT_SIZE	= (_VIDEO_OUT_MAX_WIDTH*3/16)*(_VIDEO_OUT_MAX_HEIGHT/8)	;define VIDEO size buffer for 
												;digitizing (actual captured)
												;this buffer eventually overlaped
												;by _VIDEO_OUT_BUFFER


;.EQU	_VIDEO_OUT_BUFFER_OVERLAP_SIZE	= (_VIDEO_OUT_MAX_WIDTH*3/8)*(_VIDEO_OUT_MAX_HEIGHT*3/8)-(_VIDEO_OUT_BUFFER_SIZE+3*_VIDEO_OUT_BUFFER_INPUT_SIZE)+48 ;area overlap for others screen modes(NOT USED IN THIS PROGRAM)

;+---------------------------------------
;| VIDEO Mixer Constants
;+---------------------------------------
.EQU	_VIDEO_MIX_DIRECTION_BIT	= 3			;control video mixer direction
								;if 0 from internal video generator
								;if 1 from external video input
.EQU	_VIDEO_MIX_ENABLE_BIT		= 4			;0 to enable mix
;+---------------------------------------
;| VIDEO Synchronism Constants
;+---------------------------------------
.EQU	_VIDEO_SYNC_FIELD_BIT		= 1			;FRAME LM1881
.EQU	_VIDEO_SYNC_COMPOSITE_BIT	= 2			;COMPOSITE LM1881
.EQU	_VIDEO_SYNC_VERTICAL_BIT	= 3			;VERTICAL LM1881
.EQU	_VIDEO_SYNC_EXTERNAL_COUNT_MAX	= 8			;TIME TO VALID EXTERNAL SYNC
;+---------------------------------------
;| VIDEO Characters Constants
;+---------------------------------------
.EQU	_VIDEO_OUT_TAB_SIZE		= 8			;size in characters
.EQU	_VIDEO_OUT_CHAR_WIDTH		= 6			;character width in pixels
.EQU	_VIDEO_OUT_CHAR_HEIGHT		= 8			;character height in pixels
.EQU	_VIDEO_OUT_TEXT_MODE_SOLID	= 1			;solid text mode
.EQU	_VIDEO_OUT_TEXT_MODE_TRANSPARENT= 2			;transparent txt mode
.EQU	_VIDEO_OUT_TEXT_SOURCE_FLASH	= 1			;source string text Flash
.EQU	_VIDEO_OUT_TEXT_SOURCE_SRAM	= 2			;source string text SRAM
;+---------------------------------------
;| VIDEO Comparator Constants
;+---------------------------------------
.EQU	_VIDEO_COMP_R2R_BIT		= 3			;R2R input
.EQU	_VIDEO_COMP_VIDEO_BIT		= 2			;video input
.EQU	_VIDEO_COMP_PWM_B_BIT		= 4
.EQU	_VIDEO_COMP_TOP			= 1023			;max AD output value
.EQU	_VIDEO_COMP_BOTTOM		= 0			;min AD output value
.EQU	_VIDEO_COMP_HSYNC_VOLTAGE	= 1200			;1200 mvolts messured after video amplify gain 2X
.EQU	_VIDEO_COMP_MIN_STEP		= 4			;minimal step voltage to ad (1024/256)=4

;+---------------------------------------
;| VIDEO Digitizing events
;+---------------------------------------
.EQU	_VIDEO_DIGITIZING_EVENT_TO_UP		= 1		;EVENT digitizing up ramp
.EQU	_VIDEO_DIGITIZING_EVENT_ON_TOP		= 2		;EVENT capture image on top
.EQU	_VIDEO_DIGITIZING_EVENT_TO_DOWN		= 3		;EVENT digitizing donw ramp
.EQU	_VIDEO_DIGITIZING_EVENT_ON_BOTTOM	= 4		;EVENT capture image on bottom
;+---------------------------------------
;| VIDEO Digitizing area
;+---------------------------------------
.EQU	_VIDEO_DIGITIZING_ROWS			= 24		;number of dots for digitizing purpose
.EQU	_VIDEO_DIGITIZING_COLS			= 24
.EQU	_VIDEO_DIGITIZING_MASK_ROWS		= 12		;number of mask for validate move
.EQU	_VIDEO_DIGITIZING_MASK_COLS		= 12		;signalizing areas that sense detection
.EQU	_VIDEO_DIGITIZING_MASK_SIZE		= (_VIDEO_DIGITIZING_MASK_ROWS*_VIDEO_DIGITIZING_MASK_COLS)/8+1

;-------------------------< SRAM VARIABLES >-----------------------------

.DSEG
	;+-------------------------------
	;| VIDEO GENERATOR Variables
	;+-------------------------------
	_VIDEO_RASTER_AREA:		.BYTE	_BYTE		;_ON when in video raster area _OFF when not
	_VIDEO_OUT_CPU_CT:		.BYTE 	_BYTE		;used by cpu led
	_VIDEO_OUT_CMD_POINTER:		.BYTE 	_WORD		;pointer for command what to do for lines
	_VIDEO_OUT_PIXEL_POINTER:	.BYTE	_WORD		;pointer for pixels video buffer
	_VIDEO_OUT_PIXEL_POINTER_INPUT:	.BYTE	_WORD		;pointer for pixels video buffer when input
	_VIDEO_OUT_WIDTH:		.BYTE	_BYTE		;width in bytes (8 pixel per byte)
	_VIDEO_OUT_HEIGHT:		.BYTE	_BYTE		;height in lines
	_VIDEO_OUT_GRAPH_WIDTH:		.BYTE	_BYTE		;video width in pixels
	_VIDEO_OUT_GRAPH_HEIGHT:	.BYTE	_BYTE		;video height in pixels
	_VIDEO_OUT_TEXT_ROWS:		.BYTE	_BYTE		;video text rows
	_VIDEO_OUT_TEXT_COLS:		.BYTE	_BYTE		;video text cols
	_VIDEO_OUT_MODE:		.BYTE	_BYTE		;video mode
	_VIDEO_OUT_FIELD:		.BYTE   _BYTE		;_ODD OR _EVEN
	_VIDEO_OUT_LEVEL_WHITE:		.BYTE   _BYTE		;level of white	
	_VIDEO_OUT_TIMER1_DIV:		.BYTE	_WORD		;timer1 division factor 
	_VIDEO_OUT_H_TIME:		.BYTE	_WORD		;timer1 ticks to obtain H TIME
	_VIDEO_OUT_H_TIME_HALF:		.BYTE	_WORD		;timer1 ticks to obtain H/2 TIME
	_VIDEO_OUT_TIME_ADJUST_Ha:	.BYTE	_BYTE		;H(a) time adjust
	_VIDEO_OUT_TIME_ADJUST_Hb:	.BYTE	_BYTE		;H(b) time adjust
	_VIDEO_OUT_TIME_ADJUST_Hc:	.BYTE	_BYTE		;H(c) time adjust
	_VIDEO_OUT_TIME_ADJUST_EQa:	.BYTE	_BYTE		;EQ(a) time adjust
	_VIDEO_OUT_TIME_ADJUST_EQb:	.BYTE	_BYTE		;EQ(b) time adjust
	_VIDEO_OUT_TIME_ADJUST_SYNCa:	.BYTE	_BYTE		;SYNC(a) time adjust
	_VIDEO_OUT_TIME_ADJUST_SYNCb:	.BYTE	_BYTE		;SYNC(b) time adjust
	_VIDEO_OUT_TIME_ADJUST_1:	.BYTE	_WORD		;H/2 TIME + interrupt delay + some adjust
	_VIDEO_OUT_TIME_ADJUST_2:	.BYTE	_WORD		;H TIME + interrupt delay + some adjust
	_VIDEO_OUT_TIME_ADJUST_3:	.BYTE	_WORD		;H TIME + 2.2Us+interrupt delay+ some adjust line 262
	_VIDEO_OUT_TIME_ADJUST_4:	.BYTE	_WORD		;H/2 TIME + interrupt delay + some adjust
	_VIDEO_OUT_TIME_ADJUST_5:	.BYTE	_WORD		;H TIME -4.7us + some adjust
	_VIDEO_OUT_TIME_ADJUST_6:	.BYTE	_WORD		;H TIME + interrupt delay + some adjust
	_VIDEO_OUT_H_POSITION:		.BYTE	_BYTE		;start video h position
	_VIDEO_OUT_H_SYNC_ADDR:		.BYTE	_WORD		;address of H sync routine
	_VIDEO_OUT_V_SYNC_ADDR:		.BYTE	_WORD		;address of V sync routine
	_VIDEO_OUT_VIDEO_ODD_ADDR:	.BYTE	_WORD		;address of Video Odd Lines routine
	_VIDEO_OUT_VIDEO_EVEN_ADDR:	.BYTE	_WORD		;address of Video Even Lines routine
	_VIDEO_OUT_VIDEO_BLANK_ADDR:	.BYTE	_WORD		;address of Video Blank Lines routine
	_VIDEO_TABLE_COMMANDS_ADDR:	.BYTE	_WORD		;ptr to video table 
	_VIDEO_OUT_INT_COMPENSATE:	.BYTE	_BYTE		;interrupt Flick compensation
	_VIDEO_OUT_ODD_LINE_START:	.BYTE	_WORD		;start video line ODD
	_VIDEO_OUT_ODD_LINE_END:	.BYTE	_WORD		;stop video line ODD
	_VIDEO_OUT_EVEN_LINE_START:	.BYTE	_WORD		;start video line EVEN
	_VIDEO_OUT_EVEN_LINE_END:	.BYTE	_WORD		;stop video line EVEN
	_VIDEO_SYNC_EXTERNAL_COUNT:	.BYTE	_BYTE		;count to valid external sync
	_VIDEO_SYNC_EXTERNAL_LAST:	.BYTE	_BYTE		;hold last transiction of sync signal
	_VIDEO_SYNC_EXTERNAL_CHANGE:	.BYTE	_BYTE		;to signalizing that external sync was changed
        _VIDEO_SYNC_EXTERNAL:		.BYTE	_BYTE		;_ON if external sync present
	_VIDEO_DIGITIZING_BOTTOM_FLAG:	.BYTE	_BYTE		;_OFF if comp video lower hsync backpost
	_VIDEO_DIGITIZING_TOP_FLAG:	.BYTE	_BYTE		;_OFF if comp video high video area information
								;this flag is accumulative it must be
								;clead at the end of each field
	_VIDEO_DIGITIZING_PWM_LAST:	.BYTE	_WORD		;hold a last value of PWM TOP VALUE or PWM BOTTOM VALUE
	_VIDEO_DIGITIZING_PWM_PREP:	.BYTE	_WORD		;hold a preparation value for PWM da
	_VIDEO_DIGITIZING_LO_STEP:	.BYTE	_BYTE		;da PWM ramp lower_step, step beetwen main video steps
	_VIDEO_DIGITIZING_HI_STEP:	.BYTE	_BYTE		;da PWM ramp high step, step of video.
	_VIDEO_DIGITIZING_DIR_STEP:	.BYTE	_BYTE		;direction step may be -1 or 1
	_VIDEO_DIGITIZING_EVENT:	.BYTE	_BYTE		;digitizing event
	_VIDEO_DIGITIZING_DECAY:	.BYTE	_BYTE		;decay value for video difference buffer
	_VIDEO_DIGITIZING_SENSIBILITY:	.BYTE	_BYTE		;digitizing sensibility
	_VIDEO_DIGITIZING_MASK_AREAS:	.BYTE	_VIDEO_DIGITIZING_MASK_SIZE ;reserve space for digitizing mask areas
	_VIDEO_OUT_BUFFER:		.BYTE 	_VIDEO_OUT_BUFFER_SIZE 		;<-- reserved area for mode 128x96x2
	_VIDEO_OUT_BUFFER_DIG_NEW:	.BYTE	_VIDEO_OUT_BUFFER_INPUT_SIZE	;new captured data
	_VIDEO_OUT_BUFFER_DIG_CAP:	.BYTE	_VIDEO_OUT_BUFFER_INPUT_SIZE	;old captured data(last field)
	_VIDEO_OUT_BUFFER_DIG_DIF:	.BYTE	_VIDEO_OUT_BUFFER_INPUT_SIZE	;(new-old) captured data
;	_VIDEO_OUT_OVERLAP_AREA:	.BYTE	_VIDEO_OUT_BUFFER_OVERLAP_SIZE	;<-- NOT USED IN THIS PROGRAM
										;SINCE MODE 96X72X16 NOT USED
.CSEG
;
;-------------------------< M A C R O S  >-------------------------------
;
;/////////////////////////////////////////////////////////////////////////////
;/
;/ VIDEO SET COMPARATOR RAMP DA VALUE
;/ INPUT: AccH:Acc register
;/
;/////////////////////////////////////////////////////////////////////////////

	.MACRO	_M_VIDEO_SET_RAMP
		sts	OCR3BH,AccH
		sts	OCR3BL,Acc
	.ENDMACRO

;/////////////////////////////////////////////////////////////////////////////
;/
;/ VIDEO GET COMPARATOR RAMP DA VALUE
;/ OUTPUT: AccH:Acc register
;/
;/////////////////////////////////////////////////////////////////////////////

	.MACRO	_M_VIDEO_GET_RAMP
		lds	Acc,OCR3BL
		lds	AccH,OCR3BH
	.ENDMACRO

;/////////////////////////////////////////////////////////////////////////////
;/
;/ VIDEO MIX TO INTERNAL
;/ INPUT: @0 register
;/
;/////////////////////////////////////////////////////////////////////////////

	.MACRO	_M_VIDEO_MIX_INTERNAL
		lds	@0,_VIDEO_MIX_PORT_OUTPUT
		andi	@0,~(1<<_VIDEO_MIX_DIRECTION_BIT)
		sts	_VIDEO_MIX_PORT_OUTPUT,@0
	.ENDMACRO

;/////////////////////////////////////////////////////////////////////////////
;/
;/ VIDEO MIX TO EXTERNAL
;/ INPUT: @0 register 
;/
;/////////////////////////////////////////////////////////////////////////////

	.MACRO	_M_VIDEO_MIX_EXTERNAL
		lds	@0,_VIDEO_MIX_PORT_OUTPUT
		ori	@0,(1<<_VIDEO_MIX_DIRECTION_BIT)
		sts	_VIDEO_MIX_PORT_OUTPUT,@0
	.ENDMACRO

;/////////////////////////////////////////////////////////////////////////////
;/
;/ VIDEO OUTPUT A PIXEL 2 COLORS
;/ INPUT: @0 Register with pixels(bits) 7=pixel 0 6=pixel 1...
;/        @1 Register for temporary use
;/	  @2 Register with level of white
;/	  @3 Bit number of pixel
;/
;/////////////////////////////////////////////////////////////////////////////
	
	.MACRO	_M_VIDEO_OUT_PIXEL
		ldi	@1,_VIDEO_OUT_LEVEL_BLACK		;set pixel as black
		sbrc	@0,@3					;skip if bit=0
		;sbic	ACSR,ACO
		mov	@1,@2					;else set pixel as white
		sts	_VIDEO_OUT_PORT_OUTPUT,@1		;set pixel
	.ENDMACRO

;/////////////////////////////////////////////////////////////////////////////
;/
;/ VIDEO OUTPUT A 8 PIXELS 2 COLORS
;/ INPUT: Acc pixels
;/
;/////////////////////////////////////////////////////////////////////////////

	.MACRO	_M_VIDEO_OUT_8_PIXELS
		_M_VIDEO_OUT_PIXEL	Acc,Temp,AccH,7		;output pixel 0
		_M_VIDEO_OUT_PIXEL	Acc,Temp,AccH,6		;output pixel 1
		_M_VIDEO_OUT_PIXEL	Acc,Temp,AccH,5		;output pixel 2
		_M_VIDEO_OUT_PIXEL	Acc,Temp,AccH,4		;output pixel 3
		_M_VIDEO_OUT_PIXEL	Acc,Temp,AccH,3		;output pixel 4
		_M_VIDEO_OUT_PIXEL	Acc,Temp,AccH,2		;output pixel 5
		_M_VIDEO_OUT_PIXEL	Acc,Temp,AccH,1		;output pixel 6
		_M_VIDEO_OUT_PIXEL	Acc,Temp,AccH,0		;output pixel 7
	.ENDMACRO

;/////////////////////////////////////////////////////////////////////////////
;/
;/ VIDEO OUTPUT A 128 PIXELS 2 COLORS
;/ INPUT: Z--> PIXELS INTO SRAM
;/ TIME EQUATION T=(2+5*8)*16=672 clks=42us
;/////////////////////////////////////////////////////////////////////////////

	.MACRO	_M_VIDEO_OUT_128_PIXELS
		ld	Acc,Z+
		_M_VIDEO_OUT_8_PIXELS				;0..7
		ld	Acc,Z+
		_M_VIDEO_OUT_8_PIXELS				;8..15
		ld	Acc,Z+
		_M_VIDEO_OUT_8_PIXELS				;16..23
		ld	Acc,Z+
		_M_VIDEO_OUT_8_PIXELS				;24..31
		ld	Acc,Z+
		_M_VIDEO_OUT_8_PIXELS				;32..39
		ld	Acc,Z+
		_M_VIDEO_OUT_8_PIXELS				;40..47
		ld	Acc,Z+
		_M_VIDEO_OUT_8_PIXELS				;48..55
		ld	Acc,Z+
		_M_VIDEO_OUT_8_PIXELS				;56..63
		ld	Acc,Z+
		_M_VIDEO_OUT_8_PIXELS				;64..71
		ld	Acc,Z+
		_M_VIDEO_OUT_8_PIXELS				;72..79
		ld	Acc,Z+
		_M_VIDEO_OUT_8_PIXELS				;80..87
		ld	Acc,Z+
		_M_VIDEO_OUT_8_PIXELS				;88..95
		ld	Acc,Z+
		_M_VIDEO_OUT_8_PIXELS				;96..103
		ld	Acc,Z+
		_M_VIDEO_OUT_8_PIXELS				;104..111
		ld	Acc,Z+
		_M_VIDEO_OUT_8_PIXELS				;112..119
		ld	Acc,Z+
		_M_VIDEO_OUT_8_PIXELS				;120..127
	.ENDMACRO

;/////////////////////////////////////////////////////////////////////////////
;/
;/ VIDEO OUTPUT A PIXEL MIXED 2 COLORS
;/ INPUT: @0 Register with pixels(bits) 7=pixel 0 6=pixel 1...
;/        @1 Register for temporary use
;/	  @2 Register with mix state external
;/	  @3 Register with mix state internal
;/	  @4 Bit number of pixel
;/
;/////////////////////////////////////////////////////////////////////////////

	.MACRO	_M_VIDEO_OUT_PIXEL_MIXED
		mov	@1,@2					;set pixel mix to external
		sbrc	@0,@4					;skip if bit=0
;		sbic	ACSR,ACO
		mov	@1,@3					;else set pixel mix to internal
		sts	_VIDEO_MIX_PORT_OUTPUT,@1		;set pixel
	.ENDMACRO

;/////////////////////////////////////////////////////////////////////////////
;/
;/ VIDEO OUTPUT A 8 PIXELS MIXED 2 COLORS
;/ INPUT: Acc pixels
;/
;/////////////////////////////////////////////////////////////////////////////

	.MACRO	_M_VIDEO_OUT_8_PIXELS_MIXED
		_M_VIDEO_OUT_PIXEL_MIXED	Acc,Temp,AccT,AccTH,7	;output pixel 0
		_M_VIDEO_OUT_PIXEL_MIXED	Acc,Temp,AccT,AccTH,6	;output pixel 1
		_M_VIDEO_OUT_PIXEL_MIXED	Acc,Temp,AccT,AccTH,5	;output pixel 2
		_M_VIDEO_OUT_PIXEL_MIXED	Acc,Temp,AccT,AccTH,4	;output pixel 3
		_M_VIDEO_OUT_PIXEL_MIXED	Acc,Temp,AccT,AccTH,3	;output pixel 4
		_M_VIDEO_OUT_PIXEL_MIXED	Acc,Temp,AccT,AccTH,2	;output pixel 5
		_M_VIDEO_OUT_PIXEL_MIXED	Acc,Temp,AccT,AccTH,1	;output pixel 6
		_M_VIDEO_OUT_PIXEL_MIXED	Acc,Temp,AccT,AccTH,0	;output pixel 7
	.ENDMACRO

;/////////////////////////////////////////////////////////////////////////////
;/
;/ VIDEO OUTPUT A 128 PIXELS MIXED 2 COLORS
;/ INPUT: Z--> PIXELS INTO SRAM
;/ TIME EQUATION T=(2+5*8)*16=672 clks=42us
;/////////////////////////////////////////////////////////////////////////////

	.MACRO	_M_VIDEO_OUT_128_PIXELS_MIXED
		ld	Acc,Z+
		_M_VIDEO_OUT_8_PIXELS_MIXED			;0..7
		ld	Acc,Z+
		_M_VIDEO_OUT_8_PIXELS_MIXED			;8..15
		ld	Acc,Z+
		_M_VIDEO_OUT_8_PIXELS_MIXED			;16..23
		ld	Acc,Z+
		_M_VIDEO_OUT_8_PIXELS_MIXED			;24..31
		ld	Acc,Z+
		_M_VIDEO_OUT_8_PIXELS_MIXED			;32..39
		ld	Acc,Z+
		_M_VIDEO_OUT_8_PIXELS_MIXED			;40..47
		ld	Acc,Z+
		_M_VIDEO_OUT_8_PIXELS_MIXED			;48..55
		ld	Acc,Z+
		_M_VIDEO_OUT_8_PIXELS_MIXED			;56..63
		ld	Acc,Z+
		_M_VIDEO_OUT_8_PIXELS_MIXED			;64..71
		ld	Acc,Z+
		_M_VIDEO_OUT_8_PIXELS_MIXED			;72..79
		ld	Acc,Z+
		_M_VIDEO_OUT_8_PIXELS_MIXED			;80..87
		ld	Acc,Z+
		_M_VIDEO_OUT_8_PIXELS_MIXED			;88..95
		ld	Acc,Z+
		_M_VIDEO_OUT_8_PIXELS_MIXED			;96..103
		ld	Acc,Z+
		_M_VIDEO_OUT_8_PIXELS_MIXED			;104..111
		ld	Acc,Z+
		_M_VIDEO_OUT_8_PIXELS_MIXED			;112..119
		ld	Acc,Z+
		_M_VIDEO_OUT_8_PIXELS_MIXED			;120..127
	.ENDMACRO

;/////////////////////////////////////////////////////////////////////////////
;/
;/ VIDEO OUTPUT A PIXEL 16 COLORS
;/ INPUT: @0 Register with pixels(bits) 7..4 pixel 0, 3..0 pixel 1
;/
;/////////////////////////////////////////////////////////////////////////////
	
	.MACRO	_M_VIDEO_OUT_PIXEL_16
		ld	@0,Z				;get pixel low and high
		swap	@0				;get low
		andi	@0,0x0f
		subi	@0,-_VIDEO_OUT_LEVEL_BLACK	;add black bias
		sts	_VIDEO_OUT_PORT_OUTPUT,@0
		ld	@0,Z+				;get pixel low and high
		nop					;to get same time
		andi	@0,0x0f
		subi	@0,-_VIDEO_OUT_LEVEL_BLACK	;add black bias
		sts	_VIDEO_OUT_PORT_OUTPUT,@0
	.ENDMACRO

;/////////////////////////////////////////////////////////////////////////////
;/
;/ VIDEO OUTPUT A 96 PIXELs 16 COLORS
;/ TIME EQUATION T=(14*48)=672 clks=42us
;/////////////////////////////////////////////////////////////////////////////

	.MACRO	_M_VIDEO_OUT_96_PIXELS_16
		_M_VIDEO_OUT_PIXEL_16	Acc		;0,1
		_M_VIDEO_OUT_PIXEL_16	Acc		;2,3
		_M_VIDEO_OUT_PIXEL_16	Acc		;4,5
		_M_VIDEO_OUT_PIXEL_16	Acc		;5,7
		_M_VIDEO_OUT_PIXEL_16	Acc		;8,9
		_M_VIDEO_OUT_PIXEL_16	Acc		;10,11
		_M_VIDEO_OUT_PIXEL_16	Acc		;12,13
		_M_VIDEO_OUT_PIXEL_16	Acc		;14,15

		_M_VIDEO_OUT_PIXEL_16	Acc		;0,1
		_M_VIDEO_OUT_PIXEL_16	Acc		;2,3
		_M_VIDEO_OUT_PIXEL_16	Acc		;4,5
		_M_VIDEO_OUT_PIXEL_16	Acc		;5,7
		_M_VIDEO_OUT_PIXEL_16	Acc		;8,9
		_M_VIDEO_OUT_PIXEL_16	Acc		;10,11
		_M_VIDEO_OUT_PIXEL_16	Acc		;12,13
		_M_VIDEO_OUT_PIXEL_16	Acc		;14,15

		_M_VIDEO_OUT_PIXEL_16	Acc		;0,1
		_M_VIDEO_OUT_PIXEL_16	Acc		;2,3
		_M_VIDEO_OUT_PIXEL_16	Acc		;4,5
		_M_VIDEO_OUT_PIXEL_16	Acc		;5,7
		_M_VIDEO_OUT_PIXEL_16	Acc		;8,9
		_M_VIDEO_OUT_PIXEL_16	Acc		;10,11
		_M_VIDEO_OUT_PIXEL_16	Acc		;12,13
		_M_VIDEO_OUT_PIXEL_16	Acc		;14,15

		_M_VIDEO_OUT_PIXEL_16	Acc		;0,1
		_M_VIDEO_OUT_PIXEL_16	Acc		;2,3
		_M_VIDEO_OUT_PIXEL_16	Acc		;4,5
		_M_VIDEO_OUT_PIXEL_16	Acc		;5,7
		_M_VIDEO_OUT_PIXEL_16	Acc		;8,9
		_M_VIDEO_OUT_PIXEL_16	Acc		;10,11
		_M_VIDEO_OUT_PIXEL_16	Acc		;12,13
		_M_VIDEO_OUT_PIXEL_16	Acc		;14,15

		_M_VIDEO_OUT_PIXEL_16	Acc		;0,1
		_M_VIDEO_OUT_PIXEL_16	Acc		;2,3
		_M_VIDEO_OUT_PIXEL_16	Acc		;4,5
		_M_VIDEO_OUT_PIXEL_16	Acc		;5,7
		_M_VIDEO_OUT_PIXEL_16	Acc		;8,9
		_M_VIDEO_OUT_PIXEL_16	Acc		;10,11
		_M_VIDEO_OUT_PIXEL_16	Acc		;12,13
		_M_VIDEO_OUT_PIXEL_16	Acc		;14,15

		_M_VIDEO_OUT_PIXEL_16	Acc		;0,1
		_M_VIDEO_OUT_PIXEL_16	Acc		;2,3
		_M_VIDEO_OUT_PIXEL_16	Acc		;4,5
		_M_VIDEO_OUT_PIXEL_16	Acc		;5,7
		_M_VIDEO_OUT_PIXEL_16	Acc		;8,9
		_M_VIDEO_OUT_PIXEL_16	Acc		;10,11
		_M_VIDEO_OUT_PIXEL_16	Acc		;12,13
		_M_VIDEO_OUT_PIXEL_16	Acc		;14,15
	.ENDMACRO


	;>--------------------------------------------------------------<
	;| OBJECT     : VIDEO_OUT					|
	;>--------------------------------------------------------------<
	;| FUNCTION   : Make Horizontal synchronism for internal video	|
	;|		Generator					|
	;>--------------------------------------------------------------<
	;| INPUT      :	AccT TCNT1 clock until a point that call this	|
	;|		routine						|
	;| OUTPUT     :	None						|
	;| DESTROYED  :	Acc,Flags					|
	;| TIME	      :	----						|
	;>--------------------------------------------------------------<
	;| OBSERVATION:	----						|
	;+--------------------------------------------------------------+-------------------------------------------------------------------------------\
	;| This routine take long 4.8us plus interrupt response variation clocks
	;| the value obtained in "adjust line value" represents number of NOPS following 
	;| IJMP instruction. A very care must be take when change value of this routine,
	;| any change must be following changes in VIDEO_OUT_ADJUST_n variables
	;|
	_VIDEO_OUT_INTERRUPT_COMPENSATE:
		ldiw	Z,_VIDEO_OUT_TIME_ADJUST_TABLE
		in	Acc,TCNT1L
		in	AccH,TCNT1H
		sub	Acc,AccT
		cpi	Acc,52					;<----------- adjust line value
		lbrsh	_VIDEO_OUT_TIME_ADJUST_TABLE_EXIT
		add	ZL,Acc
		ldi	AccH,0
		adc	ZH,AccH
		ijmp
	_VIDEO_OUT_TIME_ADJUST_TABLE:
		nop		;1
		nop		;2
		nop		;3
		nop		;4
		nop		;5
		nop		;6
		nop		;7
		nop		;8
		nop		;9
		nop		;10

		nop		;1
		nop		;2
		nop		;3
		nop		;4
		nop		;5
		nop		;6
		nop		;7
		nop		;8
		nop		;9
		nop		;20

		nop		;1
		nop		;2
		nop		;3
		nop		;4
		nop		;5
		nop		;6
		nop		;7
		nop		;8
		nop		;9
		nop		;30

		nop		;1
		nop		;2
		nop		;3
		nop		;4
		nop		;5
		nop		;6
		nop		;7
		nop		;8
		nop		;9
		nop		;40

		nop		;1
		nop		;2
		nop		;3
		nop		;4
		nop		;5
		nop		;6
		nop		;7
		nop		;8
		nop		;9
		nop		;50

		nop		;1
		nop		;2

	_VIDEO_OUT_TIME_ADJUST_TABLE_EXIT:
		ret

	;>--------------------------------------------------------------<
	;| OBJECT     : VIDEO_OUT					|
	;>--------------------------------------------------------------<
	;| FUNCTION   : Make Horizontal synchronism for internal video	|
	;|		Generator					|
	;>--------------------------------------------------------------<
	;| INPUT      :	None						|
	;| OUTPUT     :	None						|
	;| DESTROYED  :	Acc,Flags					|
	;| TIME	      :	----						|
	;>--------------------------------------------------------------<
	;| OBSERVATION:	----						|
	;+--------------------------------------------------------------+-------------------------------------------------------------------------------\
	;|																		|
	;| <-a-><---b---><--c-->
	;| ----+        +-------
	;|     |        |  
	;|     |        |  HSYNC
	;|     +--------+
	;|
	;|	NAME			NTSC	Hn	PAL	Hn
	;|
	;| a = Front porch 		1,5us	11	2.22us	
	;| b = Synchornism Pulse	4,7us	24	4,7us
	;| c = Back porch		3.3us	15	3.3us
	;| 
	;| Time Equation T=3+1+2+(b*3+1)+1+2+(c*3+1)+4
	;| obs: a time not generate by this routine
	;\--------------------------------------------------------------------
	_VIDEO_OUT_H_SYNC_INTERNAL:
		ldi	Acc,_VIDEO_OUT_LEVEL_SYNC			;sync level (b)
		sts	_VIDEO_OUT_PORT_OUTPUT,Acc

		lds	AccT,_VIDEO_OUT_INT_COMPENSATE			;make H sync and 
		rcall	_VIDEO_OUT_INTERRUPT_COMPENSATE			;compensate int time

		ldi	Acc,_VIDEO_OUT_LEVEL_BASE			;base level (c)
		sts	_VIDEO_OUT_PORT_OUTPUT,Acc
		lds	Acc,_VIDEO_OUT_TIME_ADJUST_Hc			;get c
		dec	Acc
		brne	PC-1
		ldi	Acc,_VIDEO_OUT_LEVEL_BASE			;base level
		sts	_VIDEO_OUT_PORT_OUTPUT,Acc
		ret

	;>--------------------------------------------------------------<
	;| OBJECT     : VIDEO_OUT					|
	;>--------------------------------------------------------------<
	;| FUNCTION   : Make Horizontal synchronism with external video	|
	;|		GenLock						|
	;>--------------------------------------------------------------<
	;| INPUT      :	None						|
	;| OUTPUT     :	None						|
	;| DESTROYED  :	Acc,AccH,Flags					|
	;| TIME	      :	----						|
	;>--------------------------------------------------------------<
	;| OBSERVATION:	----						|
	;+--------------------------------------------------------------+-------------------------------------------------------------------------------\
	;|																		|
	;| <-a-><---b---><--c-->
	;| ----+        +-------
	;|     |        |  
	;|     |        |  HSYNC
	;|     +--------+
	;|          ^
	;|	    |
	;|	    d
	;|
	;|	NAME			NTSC	Hn	PAL	Hn
	;|
	;| a = Front porch 		1,5us	11	2.22us	
	;| b = Synchornism Pulse	4,7us	24	4,7us
	;| c = Back porch		3.3us	15	3.3us
	;| d = GenLock meter point
	;| 
	;| obs: a time not generate by this routine
	;\--------------------------------------------------------------------
	_VIDEO_OUT_H_SYNC_EXTERNAL:
		ldi	Acc,_VIDEO_OUT_LEVEL_SYNC				;sync level
		sts	_VIDEO_OUT_PORT_OUTPUT,Acc
		;///////////////////////////////////
		;// synchronism with external h sync
		;///////////////////////////////////
		sbic	_VIDEO_SYNC_PORT_INPUT,_VIDEO_SYNC_COMPOSITE_BIT	;1
		rjmp	_VIDEO_OUT_H_SYNC_00
		sbic	_VIDEO_SYNC_PORT_INPUT,_VIDEO_SYNC_COMPOSITE_BIT	;2
		rjmp	_VIDEO_OUT_H_SYNC_00
		sbic	_VIDEO_SYNC_PORT_INPUT,_VIDEO_SYNC_COMPOSITE_BIT	;3
		rjmp	_VIDEO_OUT_H_SYNC_00
		sbic	_VIDEO_SYNC_PORT_INPUT,_VIDEO_SYNC_COMPOSITE_BIT	;4
		rjmp	_VIDEO_OUT_H_SYNC_00
		sbic	_VIDEO_SYNC_PORT_INPUT,_VIDEO_SYNC_COMPOSITE_BIT	;5
		rjmp	_VIDEO_OUT_H_SYNC_00
		sbic	_VIDEO_SYNC_PORT_INPUT,_VIDEO_SYNC_COMPOSITE_BIT	;6
		rjmp	_VIDEO_OUT_H_SYNC_00
		sbic	_VIDEO_SYNC_PORT_INPUT,_VIDEO_SYNC_COMPOSITE_BIT	;7
		rjmp	_VIDEO_OUT_H_SYNC_00
		sbic	_VIDEO_SYNC_PORT_INPUT,_VIDEO_SYNC_COMPOSITE_BIT	;8
		rjmp	_VIDEO_OUT_H_SYNC_00
		sbic	_VIDEO_SYNC_PORT_INPUT,_VIDEO_SYNC_COMPOSITE_BIT	;9
		rjmp	_VIDEO_OUT_H_SYNC_00
		sbic	_VIDEO_SYNC_PORT_INPUT,_VIDEO_SYNC_COMPOSITE_BIT	;10
		rjmp	_VIDEO_OUT_H_SYNC_00
		sbic	_VIDEO_SYNC_PORT_INPUT,_VIDEO_SYNC_COMPOSITE_BIT	;1
		rjmp	_VIDEO_OUT_H_SYNC_00
		sbic	_VIDEO_SYNC_PORT_INPUT,_VIDEO_SYNC_COMPOSITE_BIT	;2
		rjmp	_VIDEO_OUT_H_SYNC_00
		sbic	_VIDEO_SYNC_PORT_INPUT,_VIDEO_SYNC_COMPOSITE_BIT	;3
		rjmp	_VIDEO_OUT_H_SYNC_00
		sbic	_VIDEO_SYNC_PORT_INPUT,_VIDEO_SYNC_COMPOSITE_BIT	;4
		rjmp	_VIDEO_OUT_H_SYNC_00
		sbic	_VIDEO_SYNC_PORT_INPUT,_VIDEO_SYNC_COMPOSITE_BIT	;5
		rjmp	_VIDEO_OUT_H_SYNC_00
		sbic	_VIDEO_SYNC_PORT_INPUT,_VIDEO_SYNC_COMPOSITE_BIT	;6
		rjmp	_VIDEO_OUT_H_SYNC_00
		sbic	_VIDEO_SYNC_PORT_INPUT,_VIDEO_SYNC_COMPOSITE_BIT	;7
		rjmp	_VIDEO_OUT_H_SYNC_00
		sbic	_VIDEO_SYNC_PORT_INPUT,_VIDEO_SYNC_COMPOSITE_BIT	;8
		rjmp	_VIDEO_OUT_H_SYNC_00
		sbic	_VIDEO_SYNC_PORT_INPUT,_VIDEO_SYNC_COMPOSITE_BIT	;9
		rjmp	_VIDEO_OUT_H_SYNC_00
		sbic	_VIDEO_SYNC_PORT_INPUT,_VIDEO_SYNC_COMPOSITE_BIT	;20
		rjmp	_VIDEO_OUT_H_SYNC_00
		sbic	_VIDEO_SYNC_PORT_INPUT,_VIDEO_SYNC_COMPOSITE_BIT	;1
		rjmp	_VIDEO_OUT_H_SYNC_00
		sbic	_VIDEO_SYNC_PORT_INPUT,_VIDEO_SYNC_COMPOSITE_BIT	;2
		rjmp	_VIDEO_OUT_H_SYNC_00
		sbic	_VIDEO_SYNC_PORT_INPUT,_VIDEO_SYNC_COMPOSITE_BIT	;3
		rjmp	_VIDEO_OUT_H_SYNC_00
		sbic	_VIDEO_SYNC_PORT_INPUT,_VIDEO_SYNC_COMPOSITE_BIT	;4
		rjmp	_VIDEO_OUT_H_SYNC_00
		sbic	_VIDEO_SYNC_PORT_INPUT,_VIDEO_SYNC_COMPOSITE_BIT	;5
		rjmp	_VIDEO_OUT_H_SYNC_00
		sbic	_VIDEO_SYNC_PORT_INPUT,_VIDEO_SYNC_COMPOSITE_BIT	;6
		rjmp	_VIDEO_OUT_H_SYNC_00
		sbic	_VIDEO_SYNC_PORT_INPUT,_VIDEO_SYNC_COMPOSITE_BIT	;7
		rjmp	_VIDEO_OUT_H_SYNC_00
		sbic	_VIDEO_SYNC_PORT_INPUT,_VIDEO_SYNC_COMPOSITE_BIT	;8
		rjmp	_VIDEO_OUT_H_SYNC_00
		sbic	_VIDEO_SYNC_PORT_INPUT,_VIDEO_SYNC_COMPOSITE_BIT	;9
		rjmp	_VIDEO_OUT_H_SYNC_00
		sbic	_VIDEO_SYNC_PORT_INPUT,_VIDEO_SYNC_COMPOSITE_BIT	;30
		rjmp	_VIDEO_OUT_H_SYNC_00

	_VIDEO_OUT_H_SYNC_00:
		
		ldsaw	_VIDEO_OUT_TIME_ADJUST_6				;load sync H time adjust
		out	TCNT1H,AccH
		out	TCNT1L,Acc

		lds	Acc,_VIDEO_OUT_TIME_ADJUST_Hc				;get c
		subi	Acc,3							;little adjust
		dec	Acc
		brne	PC-1

		ldi	Acc,_VIDEO_OUT_LEVEL_BASE				;base level
		sts	_VIDEO_OUT_PORT_OUTPUT,Acc
		
		ldi	Acc,_ON							;set ABOVE
		sbic	ACSR,ACO
		ldi	Acc,_OFF						;else BELLOW
		sts	_VIDEO_DIGITIZING_BOTTOM_FLAG,Acc			;set video bottom state
		ret

	;>--------------------------------------------------------------<
	;| OBJECT     : VIDEO_OUT					|
	;>--------------------------------------------------------------<
	;| FUNCTION   : Make Vertical Synchronism with external video	|
	;|		GenLock						|
	;>--------------------------------------------------------------<
	;| INPUT      :	None						|
	;| OUTPUT     :	None						|
	;| DESTROYED  :	Acc,AccH,AccT,Flags				|
	;| TIME	      :	----						|
	;>--------------------------------------------------------------<
	;| OBSERVATION:	----						|
	;+--------------------------------------------------------------+-------------------------------------------------------------------------------\
	;|																		|
	;| <-a-><---b---><--c-->
	;| ----+        +-------
	;|     |        |  
	;|     |        |  HSYNC
	;|     +--------+
	;|          ^
	;|	    |
	;|	    d
	;|
	;|	NAME			NTSC	Hn	PAL	Hn
	;|
	;| a = Front porch 		1,5us	11	2.22us	
	;| b = Synchornism Pulse	4,7us	24	4,7us
	;| c = Back porch		3.3us	15	3.3us
	;| d = GenLock meter point
	;| 
	;| obs: a time not generate by this routine
	;\--------------------------------------------------------------------
	_VIDEO_OUT_V_SYNC_GENLOCK:
		ldi	Acc,_VIDEO_OUT_LEVEL_SYNC			;force sync
		sts	_VIDEO_OUT_PORT_OUTPUT,Acc

		ldsaw	_VIDEO_OUT_H_TIME				;make delayed interrupt
		lsl	Acc						;for waiting external vertical sync 
		rol	AccH
		out	TCNT1H,AccH
		out	TCNT1L,Acc
		ldiawt	0						;time out counter
		in	AccH,_VIDEO_SYNC_PORT_INPUT			;read external sync
		andi	AccH,(1<<_VIDEO_SYNC_VERTICAL_BIT)		;separate vertical
	_VIDEO_OUT_V_SYNC_GENLOCK_10:
		subiawt	1						;pump time out 
		breq	_VIDEO_OUT_V_SYNC_GENLOCK_20			;branch if time out 
		in	Acc,_VIDEO_SYNC_PORT_INPUT			;read external sync again
		andi	Acc,(1<<_VIDEO_SYNC_VERTICAL_BIT)		;separate vertical
		cp	Acc,AccH					;has transiction ?
		breq	_VIDEO_OUT_V_SYNC_GENLOCK_10			;no, wait
		mov	AccH,Acc					;transiction if high to low ?
		tst	Acc
		brne	_VIDEO_OUT_V_SYNC_GENLOCK_10			;no, wait
		ldi	Temp,_ON					;set external sync present
	_VIDEO_OUT_V_SYNC_GENLOCK_20:	
		;
		;performe 2 pulse of v sync 
		
		ldi	Acc,_VIDEO_OUT_LEVEL_BASE			;set level base
		sts	_VIDEO_OUT_PORT_OUTPUT,Acc
		lds	Acc,_VIDEO_OUT_TIME_ADJUST_SYNCb		;get SYNC(b) TIME
		dec	Acc
		brne	PC-1
		ldi	Acc,_VIDEO_OUT_LEVEL_SYNC			;level SYNC
		sts	_VIDEO_OUT_PORT_OUTPUT,Acc

		in	Acc,_VIDEO_SYNC_PORT_INPUT			;read external sync 
		ldi	AccH,_ODD					;get Field
		sbrs	Acc,_VIDEO_SYNC_FIELD_BIT
		ldi	AccH,_EVEN
		sts	_VIDEO_OUT_FIELD,AccH

		lds	Acc,_VIDEO_OUT_TIME_ADJUST_SYNCa		;get SYNC(a) TIME
		subi	Acc,17						;26,8 us
									;-17 because i need
									;to make little adjust
									;to interrupt routine
									;obtain correctly high
									;pulse of 4,9Us
		dec	Acc
		brne	PC-1
		ldi	Acc,_VIDEO_OUT_LEVEL_BASE			;level base
		sts	_VIDEO_OUT_PORT_OUTPUT,Acc

		ldsaw	_VIDEO_OUT_TIME_ADJUST_5			;load time adjust 5
		out	TCNT1H,AccH					;to keep precision of genlock
		out	TCNT1L,Acc
		ret


	;>--------------------------------------------------------------<
	;| OBJECT     : VIDEO_OUT					|
	;>--------------------------------------------------------------<
	;| FUNCTION   : Make Vertical Equalizing Pulse			|
	;>--------------------------------------------------------------<
	;| INPUT      :	None						|
	;| OUTPUT     :	None						|
	;| DESTROYED  :	Acc,Flags					|
	;| TIME	      :	----						|
	;>--------------------------------------------------------------<
	;| OBSERVATION:	----						|
	;+--------------------------------------------------------------+-------------------------------------------------------------------------------\
	;|																		|
	;| <-a-><------- b -------->
	;| +   +-------------------+   +-
	;| |   |                   |   |
	;| |   |                   |   | 
	;| +---+                   +---+
	;| <-------- H/2 --------->
	;|
	;|	NAME			NTSC	Hn	PAL	Hn
	;|
	;| a = Equalizing Pulse		 2,3us	11	 2,35us	
	;| b = Synchornism Pulse	29,48us	24	29,65us
	;| 
	;| Time Equation T=3+1+2+(a*3+1)+1+2+(b*3+1)+1+2+(a*3+1)+1+3+4
	;| 
	;\--------------------------------------------------------------------
	_VIDEO_OUT_EQUALIZE_PULSE:
		ldi	Acc,_VIDEO_OUT_LEVEL_SYNC			;sync level (a)
		sts	_VIDEO_OUT_PORT_OUTPUT,Acc
		lds	Acc,_VIDEO_OUT_TIME_ADJUST_EQa			;get a
		dec	Acc
		brne	PC-1
		ldi	Acc,_VIDEO_OUT_LEVEL_BASE			;base level (b)
		sts	_VIDEO_OUT_PORT_OUTPUT,Acc
		lds	Acc,_VIDEO_OUT_TIME_ADJUST_EQb			;get b
		dec	Acc
		brne	PC-1
		ldi	Acc,_VIDEO_OUT_LEVEL_SYNC			;sync level (a)
		sts	_VIDEO_OUT_PORT_OUTPUT,Acc
		lds	Acc,_VIDEO_OUT_TIME_ADJUST_EQa			;get a
		dec	Acc
		brne	PC-1
		ldi	Acc,_VIDEO_OUT_LEVEL_BASE			;base level
		sts	_VIDEO_OUT_PORT_OUTPUT,Acc
		ret

	;>--------------------------------------------------------------<
	;| OBJECT     : VIDEO_OUT					|
	;>--------------------------------------------------------------<
	;| FUNCTION   : Make Vertical Equalizing Pulse (PAL ONLY) FIRST	|
	;>--------------------------------------------------------------<
	;| INPUT      :	None						|
	;| OUTPUT     :	None						|
	;| DESTROYED  :	Acc,Flags					|
	;| TIME	      :	----						|
	;>--------------------------------------------------------------<
	;| OBSERVATION:	----						|
	;+--------------------------------------------------------------+-------------------------------------------------------------------------------\
	;|																		|
	;| <-a->
	;| +   +
	;| |   |
	;| |   |
	;| +---+
	;| <-------- H/2 --------->
	;|
	;|	NAME			NTSC	Hn	PAL	Hn
	;|
	;| a = Equalizing Pulse		 2,3us	11	 2,35us	
	;| b = Synchornism Pulse	29,48us	24	29,65us
	;| 
	;| Time Equation T=3+1+2+(a*3+1)+1+2+4
	;| 
	;\--------------------------------------------------------------------
	_VIDEO_OUT_EQUALIZE_PULSE_PAL_IN:
		ldi	Acc,_VIDEO_OUT_LEVEL_SYNC			;sync level (a)
		sts	_VIDEO_OUT_PORT_OUTPUT,Acc
		lds	Acc,_VIDEO_OUT_TIME_ADJUST_EQa			;get a
		dec	Acc
		brne	PC-1
		ldi	Acc,_VIDEO_OUT_LEVEL_BASE			;base level (b)
		sts	_VIDEO_OUT_PORT_OUTPUT,Acc
		ret

	;>--------------------------------------------------------------<
	;| OBJECT     : VIDEO_OUT					|
	;>--------------------------------------------------------------<
	;| FUNCTION   : Make Vertical Synchronism Pulse			|
	;>--------------------------------------------------------------<
	;| INPUT      :	None						|
	;| OUTPUT     :	None						|
	;| DESTROYED  :	Acc,Flags					|
	;| TIME	      :	----						|
	;>--------------------------------------------------------------<
	;| OBSERVATION:	----						|
	;+--------------------------------------------------------------+-------------------------------------------------------------------------------\
	;|																		|
	;|
	;|                      4,9uS                  4,9uS
	;| <-------- a -------><-b->
	;|    	               +---+		       +---+
	;|  		       |   |                   |   | SYNCHRONINZ PULSES
	;| 	               |   |		       |   |	
	;| +-------------------+   +-------------------+   +
	;| <------- H/2 ----------><-------- H/2 ----------> 
	;|
	;|	NAME			NTSC	Hn	PAL	Hn
	;|
	;| a = Equalizing Pulse		27,1us	11	27,3us	
	;| b = Synchornism Pulse	 4,78us	24	 4,7us
	;| 
	;| Time Equation T=3+1+2+(a*3+1)+1+2+(b*3+1)+1+2+(a*3+1)+1+3+4
	;| 
	;\--------------------------------------------------------------------
	_VIDEO_OUT_V_SYNC:
		ldi	Acc,_VIDEO_OUT_LEVEL_SYNC			;sync level (a)
		sts	_VIDEO_OUT_PORT_OUTPUT,Acc
		lds	Acc,_VIDEO_OUT_TIME_ADJUST_SYNCa		;get a
		dec	Acc
		brne	PC-1
		ldi	Acc,_VIDEO_OUT_LEVEL_BASE			;base level (b)
		sts	_VIDEO_OUT_PORT_OUTPUT,Acc
		lds	Acc,_VIDEO_OUT_TIME_ADJUST_SYNCb		;get b
		dec	Acc
		brne	PC-1
		ldi	Acc,_VIDEO_OUT_LEVEL_SYNC			;sync level (a)
		sts	_VIDEO_OUT_PORT_OUTPUT,Acc
		lds	Acc,_VIDEO_OUT_TIME_ADJUST_SYNCa		;get a
		subi	Acc,20
		dec	Acc
		brne	PC-1
		ldi	Acc,_VIDEO_OUT_LEVEL_BASE			;base level
		sts	_VIDEO_OUT_PORT_OUTPUT,Acc
		ret

	;>--------------------------------------------------------------<
	;| OBJECT     : VIDEO_OUT					|
	;>--------------------------------------------------------------<
	;| FUNCTION   : Make Vertical Synchronism Pulse			|
	;>--------------------------------------------------------------<
	;| INPUT      :	None						|
	;| OUTPUT     :	None						|
	;| DESTROYED  :	Acc,Flags					|
	;| TIME	      :	----						|
	;>--------------------------------------------------------------<
	;| OBSERVATION:	----						|
	;+--------------------------------------------------------------+-------------------------------------------------------------------------------\
	;|																		|
	;|
	;|                     
	;| <-------- a ------->
	;|    	               +
	;|  		       |
	;| 	               |
	;| +-------------------+
	;| <------- H/2 ---------->
	;|
	;|	NAME			NTSC	Hn	PAL	Hn
	;|
	;| a = Equalizing Pulse		27,1us	11	27,3us	
	;| b = Synchornism Pulse	 4,78us	24	 4,7us
	;| 
	;| Time Equation T=3+1+2+(a*3+1)+1+2+4
	;| 
	;\--------------------------------------------------------------------
	_VIDEO_OUT_V_SYNC_PAL_IN:
		ldi	Acc,_VIDEO_OUT_LEVEL_SYNC			;sync level (a)
		sts	_VIDEO_OUT_PORT_OUTPUT,Acc
		lds	Acc,_VIDEO_OUT_TIME_ADJUST_SYNCa		;get a
		subi	Acc,17						;26,8 us
									;-17 because i need
									;to make little adjust
									;to interrupt routine
									;obtain correctly high
									;pulse of 4,9Us

		dec	Acc
		brne	PC-1
		ldi	Acc,_VIDEO_OUT_LEVEL_BASE			;base level (b)
		sts	_VIDEO_OUT_PORT_OUTPUT,Acc
		ret

	;>--------------------------------------------------------------<
	;| OBJECT     : VIDEO_OUT					|
	;>--------------------------------------------------------------<
	;| FUNCTION   : Output Video information in Black and White	|
	;|		Odd field					|
	;>--------------------------------------------------------------<
	;| INPUT      :	None						|
	;| OUTPUT     :	None						|
	;| DESTROYED  :	Acc,Flags					|
	;| TIME	      :	----						|
	;>--------------------------------------------------------------<
	;| OBSERVATION:	----						|
	;+--------------------------------------------------------------+-------------------------------------------------------------------------------\
	_VIDEO_OUT_VIDEO_BW_ODD:
		lds	Acc,_VIDEO_OUT_H_POSITION			;to center on horizontal screen
		dec	Acc
		brne	PC-1
		ldsw	Z,_VIDEO_OUT_PIXEL_POINTER			;get pixel pointer
		lds	AccH,_VIDEO_OUT_LEVEL_WHITE			;get white level
		_M_VIDEO_OUT_128_PIXELS					;output 128 pixels
		stsw	_VIDEO_OUT_PIXEL_POINTER,Z			;dummy load to obtain									;correct line time with EVEN lines
	_VIDEO_OUT_VIDEO_BW_ODD_EXIT:
		ldi	Acc,_VIDEO_OUT_LEVEL_BASE			;rest in base
		sts	_VIDEO_OUT_PORT_OUTPUT,Acc
		ret

	;>--------------------------------------------------------------<
	;| OBJECT     : VIDEO_OUT					|
	;>--------------------------------------------------------------<
	;| FUNCTION   : Output Video information in Black and White	|
	;|		Even field					|
	;>--------------------------------------------------------------<
	;| INPUT      :	None						|
	;| OUTPUT     :	None						|
	;| DESTROYED  :	Acc,Flags					|
	;| TIME	      :	----						|
	;>--------------------------------------------------------------<
	;| OBSERVATION:	----						|
	;+--------------------------------------------------------------+-------------------------------------------------------------------------------\
	_VIDEO_OUT_VIDEO_BW_ODD_EVEN:
		lds	Acc,_VIDEO_OUT_H_POSITION			;to center on horizontal screen
		dec	Acc
		brne	PC-1
		ldsw	Z,_VIDEO_OUT_PIXEL_POINTER			;get pixel pointer
		lds	AccH,_VIDEO_OUT_LEVEL_WHITE			;get white level
		_M_VIDEO_OUT_128_PIXELS					;output 128 pixels
		stsw	_VIDEO_OUT_PIXEL_POINTER,Z			;store back pixel pointer
		ldi	Acc,_VIDEO_OUT_LEVEL_BASE			;rest in base
		sts	_VIDEO_OUT_PORT_OUTPUT,Acc
		ret

	;>--------------------------------------------------------------<
	;| FUNCTION   : Output Video information in 16 level Odd lines	|
	;|		96x72 pixels screen				|
	;>--------------------------------------------------------------<
	;| INPUT      :	None						|
	;| OUTPUT     :	None						|
	;| DESTROYED  :	Acc,Flags					|
	;| TIME	      :	----						|
	;>--------------------------------------------------------------<
	;| OBSERVATION:	----						|
	;+--------------------------------------------------------------+-------------------------------------------------------------------------------\
	_VIDEO_OUT_VIDEO_16L_ODD:
		lds	Acc,_VIDEO_OUT_H_POSITION			;to center on horizontal screen
		subi	Acc,8
		dec	Acc
		brne	PC-1
		ldsw	X,_VIDEO_OUT_ODD_LINE_START			;start + 24
		adiw	XL,24
		cpw	Y,X						;low start line ?
		lbrlo	_VIDEO_OUT_VIDEO_16L_ODD_EXIT			;yes, exit
		ldsw	X,_VIDEO_OUT_ODD_LINE_END			;end - 22
		sbiw	XL,22
		cpw	Y,X						;high end line ?
		lbrsh	_VIDEO_OUT_VIDEO_16L_ODD_EXIT			;yes, exit
		ldsw	Z,_VIDEO_OUT_PIXEL_POINTER			;get pixel pointer
		_M_VIDEO_OUT_96_PIXELS_16
		ldsw	Z,_VIDEO_OUT_PIXEL_POINTER			;dummy load to obtain correct
									;line time with EVEN lines
	_VIDEO_OUT_VIDEO_16L_ODD_EXIT:
		ldi	Acc,_VIDEO_OUT_LEVEL_BASE			;rest in base
		sts	_VIDEO_OUT_PORT_OUTPUT,Acc
		ret
	;>--------------------------------------------------------------<
	;| FUNCTION   : Output Video information in 16 level Even lines	|
	;|		96x72 pixels screen				|
	;>--------------------------------------------------------------<
	;| INPUT      :	None						|
	;| OUTPUT     :	None						|
	;| DESTROYED  :	Acc,Flags					|
	;| TIME	      :	----						|
	;>--------------------------------------------------------------<
	;| OBSERVATION:	----						|
	;+--------------------------------------------------------------+-------------------------------------------------------------------------------\
	_VIDEO_OUT_VIDEO_16L_EVEN:
		lds	Acc,_VIDEO_OUT_H_POSITION			;to center on horizontal screen
		subi	Acc,8
		dec	Acc
		brne	PC-1
		ldsw	X,_VIDEO_OUT_EVEN_LINE_START			;start +24
		adiw	XL,24
		cpw	Y,X						;low start line ?
		lbrlo	_VIDEO_OUT_VIDEO_16L_EVEN_EXIT			;yes, exit
		ldsw	X,_VIDEO_OUT_EVEN_LINE_END			;end - 22
		sbiw	XL,22
		cpw	Y,X						;high end line ?
		lbrsh	_VIDEO_OUT_VIDEO_16L_EVEN_EXIT			;yes, exit
		ldsw	Z,_VIDEO_OUT_PIXEL_POINTER			;get pixel pointer
		_M_VIDEO_OUT_96_PIXELS_16
		stsw	_VIDEO_OUT_PIXEL_POINTER,Z			;store back pixel pointer
	_VIDEO_OUT_VIDEO_16L_EVEN_EXIT:
		ldi	Acc,_VIDEO_OUT_LEVEL_BASE			;rest in base
		sts	_VIDEO_OUT_PORT_OUTPUT,Acc
		ret

	;>--------------------------------------------------------------<
	;| OBJECT     : VIDEO_OUT					|
	;>--------------------------------------------------------------<
	;| FUNCTION   : Output Video information in Black and White 	|
	;|		Mixed with external video			|
	;>--------------------------------------------------------------<
	;| INPUT      :	None						|
	;| OUTPUT     :	None						|
	;| DESTROYED  :	Acc,Flags					|
	;| TIME	      :	----						|
	;>--------------------------------------------------------------<
	;| OBSERVATION:	----						|
	;+--------------------------------------------------------------+-------------------------------------------------------------------------------\
	_VIDEO_OUT_VIDEO_BW_MIXED:
		lds	Acc,_VIDEO_OUT_H_POSITION			;to center on horizontal screen
		subi	Acc,4
		dec	Acc
		brne	PC-1
		ldsw	Z,_VIDEO_OUT_PIXEL_POINTER			;get pixel pointer
;		ldi	Acc,_VIDEO_OUT_LEVEL_WHITE_TOP_MIXED		;max white level when mixed
		lds	Acc,_VIDEO_OUT_LEVEL_WHITE
		sts	_VIDEO_OUT_PORT_OUTPUT,Acc			;set pixel to white
		lds	Acc,_VIDEO_MIX_PORT_OUTPUT			;make masm or and and
		andi	Acc,~(1<<_VIDEO_MIX_DIRECTION_BIT)
		mov	AccTH,Acc					;AccTH=mask AND
		ori	Acc,(1<<_VIDEO_MIX_DIRECTION_BIT)
		mov	AccT,Acc					;AccT=mask OR
		_M_VIDEO_OUT_128_PIXELS_MIXED				;output 128 pixels
		ldi	Acc,_VIDEO_OUT_LEVEL_BASE			;rest in base
		_M_VIDEO_MIX_EXTERNAL	Acc				;led external input
		stsw	_VIDEO_OUT_PIXEL_POINTER,Z			;store back pixel pointer
		ret

	;>--------------------------------------------------------------<
	;| OBJECT     : VIDEO_OUT					|
	;>--------------------------------------------------------------<
	;| FUNCTION   : Output Video information Blank line		|
	;>--------------------------------------------------------------<
	;| INPUT      :	None						|
	;| OUTPUT     :	None						|
	;| DESTROYED  :	Acc,Flags					|
	;| TIME	      :	----						|
	;>--------------------------------------------------------------<
	;| OBSERVATION:	----						|
	;+--------------------------------------------------------------+-------------------------------------------------------------------------------\
	_VIDEO_OUT_VIDEO_BW_BLANK:
		ldi	Acc,_VIDEO_OUT_LEVEL_BASE			;set BLANK LINE AS BASE 
		sts	_VIDEO_OUT_PORT_OUTPUT,Acc
		ret

	;>--------------------------------------------------------------<
	;| FUNCTION   : Output Video information in 16 level Odd lines	|
	;|		16x12 pixels used for digitalizing test purpose	|
	;>--------------------------------------------------------------<
	;| INPUT      :	None						|
	;| OUTPUT     :	None						|
	;| DESTROYED  :	Acc,Flags					|
	;| TIME	      :	----						|
	;>--------------------------------------------------------------<
	;| OBSERVATION:	----						|
	;+--------------------------------------------------------------+-------------------------------------------------------------------------------\
	_VIDEO_OUT_VIDEO_16LD_ODD:
		lds	Acc,_VIDEO_OUT_H_POSITION			;to center on horizontal screen
		subi	Acc,-15						;little adjust
		dec	Acc
		brne	PC-1
		ldsw	X,_VIDEO_OUT_ODD_LINE_START			;load start line
		ldi	AccT,12						;pixel column counter/2
		ldsw	Z,_VIDEO_OUT_PIXEL_POINTER			;get pixel pointer
		subw	Y,X						;subtrac line from start line
		;////////////////////////////////////////////////////////
		;// pixel loop time equation
		;//
		;// T=(1+(5*3-1)+10 + 1+(6*3-1)+10+1+2)*12=672 clks=42us
		;//
		;////////////////////////////////////////////////////////
	_VIDEO_OUT_VIDEO_16LD_ODD_10:
		ldi	Acc,4						;			;1
		dec	Acc						;			;1
		brne	PC-1						;			;2/1
		ld	Acc,Z						;get pixel		;2
		swap	Acc						;extract low pixel	;1
		nop										;1		
		nop										;1
		nop										;1
		andi	Acc,0x0f					;			;1
		subi	Acc,-_VIDEO_OUT_LEVEL_BLACK			;add black level	;1
		sts	_VIDEO_OUT_PORT_OUTPUT,Acc			;put on screen		;2

		ldi	Acc,5						;			;1
		dec	Acc						;			;1
		brne	PC-1						;			;2/1
		ld	Acc,Z+									;2
		nop										;1
		nop										;1
		nop										;1
		nop										;1
		andi	Acc,0x0f					;extract high pixel	;1
		subi	Acc,-_VIDEO_OUT_LEVEL_BLACK			;add black level	;1
		sts	_VIDEO_OUT_PORT_OUTPUT,Acc			;put on screen		;2
		dec	AccT						;			;1
		brne	_VIDEO_OUT_VIDEO_16LD_ODD_10			;until all done		;2/1
		andi	YL,7						;mask low bits		
									;1 pixel height=8 lines
		cpi	YL,6						;line to change
		brne	_VIDEO_OUT_VIDEO_16LD_ODD_20			;no, branch
		stsw	_VIDEO_OUT_PIXEL_POINTER,Z			;dummy load to obtain correct
		rjmp	_VIDEO_OUT_VIDEO_16LD_ODD_EXIT
	_VIDEO_OUT_VIDEO_16LD_ODD_20:
		nop							;to compensate jump
		nop
		nop
		nop
		nop
	_VIDEO_OUT_VIDEO_16LD_ODD_EXIT:
		ldi	Acc,5						;to compensate out width
		dec	Acc						;of last pixel
		brne	PC-1
		ldi	Acc,_VIDEO_OUT_LEVEL_BASE			;rest in base
		sts	_VIDEO_OUT_PORT_OUTPUT,Acc
		ret
	;>--------------------------------------------------------------<
	;| FUNCTION   : Input Video information in 2048 level EVEN lines|
	;|		24x18 pixels (area) used for digitalizing 	|
	;>--------------------------------------------------------------<
	;| INPUT      :	None						|
	;| OUTPUT     :	None						|
	;| DESTROYED  :	Acc,Flags					|
	;| TIME	      :	----						|
	;>--------------------------------------------------------------<
	;| OBSERVATION:	----						|
	;+--------------------------------------------------------------+-------------------------------------------------------------------------------\
	;|
	;|  Digitalizing area format(24x24 areas)
	;|
	;|      0   1   2   3   4   5   6   7   8   9   10  11  12  13  14  15  16  17  18  19  20  21  22  23 
	;|    +---+---+---+---+---+---+---+---+---+---+---+---+---+---+---+---+---+---+---+---+---+---+---+---+
	;|  0 |  0|  1|  2|  3|  4|  5|  6|  7|  8|  9| 10| 11| 12| 13| 14| 15| 16| 17| 18| 19| 20| 21| 22| 23|
	;|    +---+---+---+---+---+---+---+---+---+---+---+---+---+---+---+---+---+---+---+---+---+---+---+---+
	;|  1 | 24| 25| 26| 27| 28| 29| 30| 31| 32| 33| 34| 35| 36| 37| 38| 39| 40| 41| 42| 43| 44| 45| 46| 47|
	;|    +---+---+---+---+---+---+---+---+---+---+---+---+---+---+---+---+---+---+---+---+---+---+---+---+
	;|      .   .   .   .   .   .   .   .   .   .   .   .   .   .   .   .   .   .   .   .   .   .   .   . 
	;|      .   .   .   .   .   .   .   .   .   .   .   .   .   .   .   .   .   .   .   .   .   .   .   . 
	;|    +---+---+---+---+---+---+---+---+---+---+---+---+---+---+---+---+---+---+---+---+---+---+---+---+
	;| 23 |552|553|554|555|556|557|558|559|560|561|562|563|564|565|566|567|568|569|570|571|572|573|574|575|
	;|    +---+---+---+---+---+---+---+---+---+---+---+---+---+---+---+---+---+---+---+---+---+---+---+---+
	;|
	;|
	;|	AREA DETAILS
	;|
	;|	+--------------------+
	;|	|		     |
	;|	|  L  D	 D  L  D  D  |	
	;|	|		     |
	;|	|  L  D	 D  L  D  D  |	
	;|	|		     |
	;|	|  L  D	 D  L  D  D  |	
	;|	|		     |
	;|	|  L  D	 D  L  D  D  |	
	;|	+--------------------+
	;|
	;|	L = TOP LEVEL BITS (USED TO SEE IF COMPARE LINE AT TOP OF MAX VIDEO SIGNAL)
	;|	D = DOT BITS	   (USED TO CAPTURE AREA TO SEE MOVING)
	;|	MAX LEVEL PER AREA 255
	;|

	_VIDEO_OUT_INPUT_16L_EVEN:
		lds	Acc,_VIDEO_OUT_H_POSITION			;to center on horizontal screen
		subi	Acc,5						;little adjust
		dec	Acc
		brne	PC-1
		lds	Acc,_VIDEO_DIGITIZING_EVENT			;get event	
		cpi	Acc,_VIDEO_DIGITIZING_EVENT_ON_TOP		;event = digitizing on top?
		lbreq	_VIDEO_OUT_INPUT_CAPTURE			;yes, capture
;		cpi	Acc,_VIDEO_DIGITIZING_EVENT_ON_BOTTOM		;event = digitizing on bottom?
;		lbreq	_VIDEO_OUT_INPUT_CAPTURE			;yes, capture			
		ldsw	X,_VIDEO_OUT_EVEN_LINE_START			;load start line
		ldsw	Z,_VIDEO_OUT_PIXEL_POINTER_INPUT		;get pixel pointer input
		subw	Y,X						;subtrac line from start line
		;////////////////////////////////////////////////////////
		;// GET VIDEO INPUT DATA FROM ANALOG COMPARATOR
		;//
		;// pixel rate input time 
		;//
		;// T=(3+(5*4)+2+3)*24-1 =672 clks=42us
		;// (28 per area)*24
		;////////////////////////////////////////////////////////
;		ldi	Acc,_VIDEO_OUT_LEVEL_BLACK			;<-- active this code to adjust
;		sts	_VIDEO_OUT_PORT_OUTPUT,Acc			;    capture position

		ldi	Temp,24						;number of area cols
		ldi	AccT,0						;hold total accumulation per row
		ldi	AccH,1
	_VIDEO_OUT_INPUT_16L_EVEN_10:
		ld	Acc,Z						;get old value of data area
		
		sbic	ACSR,ACO					;video in top
		inc	AccT						;no increment

		clc							;to prevent previous overflow

		sbic	ACSR,ACO					;skip if dot 1 clear
		add	Acc,AccH					;else increment dot count
		brcc	PC+2						;branch if carry clear
		ldi	Acc,255						;else saturate

		sbic	ACSR,ACO					;dot 2
		add	Acc,AccH
		brcc	PC+2
		ldi	Acc,255

		sbic	ACSR,ACO					;video in top
		inc	AccT						;no increment

		sbic	ACSR,ACO					;dot 3
		add	Acc,AccH
		brcc	PC+2
		ldi	Acc,255

		sbic	ACSR,ACO					;dot 4 
		add	Acc,AccH
		brcc	PC+2
		ldi	Acc,255

		st	Z+,Acc

		dec	Temp
		brne	_VIDEO_OUT_INPUT_16L_EVEN_10

		lds	AccTH,_VIDEO_DIGITIZING_TOP_FLAG		;update top flag
		add	AccTH,AccT
		brcc	_VIDEO_OUT_INPUT_16L_EVEN_20
		ldi	AccTH,255
	_VIDEO_OUT_INPUT_16L_EVEN_20:
		sts	_VIDEO_DIGITIZING_TOP_FLAG,AccTH		;TOP_FLAG=0 if PWM>VIDEO INPUT SIGNAL

;		ldi	Acc,_VIDEO_OUT_LEVEL_BASE			;<-- active this code to adjust
;		sts	_VIDEO_OUT_PORT_OUTPUT,Acc			;    capture position
		andi	YL,7						;mask low bits		
									;1 area height=8 lines
		cpi	YL,6						;line to change
		brne	_VIDEO_OUT_INPUT_16L_EVEN_EXIT			;no, branch
		stsw	_VIDEO_OUT_PIXEL_POINTER_INPUT,Z		;update input pointer
	_VIDEO_OUT_INPUT_16L_EVEN_EXIT:
		ret
	;>--------------------------------------------------------------<
	;| FUNCTION   : Capture video diference, update old video old	|
	;|		buffer and clear new buffer to get new video 	|
	;>--------------------------------------------------------------<
	;| INPUT      :	None						|
	;| OUTPUT     :	None						|
	;| DESTROYED  :	Acc,Flags					|
	;| TIME	      :	----						|
	;>--------------------------------------------------------------<
	;| OBSERVATION:	----						|
	;+--------------------------------------------------------------+-------------------------------------------------------------------------------\
	;| PERFORMED OPERATIONS
	;|
	;|	IF DECAY>0
	;|		DIF_DATA(ROW,N)<-DIF_DATA(ROW,N)+ABS(NEW_DATA(ROW,N)-OLD_DATA(ROW,N)-DECAY
	;|		OLD_DATA(ROW,N)<-NEW_DATA(ROW,N)
	;|		NEW_DATA(ROW,N)<-0
	;|	ELSE
	;|		DIF_DATA(ROW,N)<-ABS(NEW_DATA(ROW,N)-OLD_DATA(ROW,N)
	;|		OLD_DATA(ROW,N)<-NEW_DATA(ROW,N)
	;|		NEW_DATA(ROW,N)<-0
	;|
	;|	FOR N=0..23
	;|
	_VIDEO_OUT_INPUT_CAPTURE:
		lds	AccH,_VIDEO_DIGITIZING_DECAY			;get decay rate
		tst	AccH						;Zero ?
		lbreq	_VIDEO_OUT_INPUT_CAPTURE_30			;yes, branch
		;////////////////////////
		;//
		;//  DECAY <> 0
		;//
		;////////////////////////
		ldsw	X,_VIDEO_OUT_EVEN_LINE_START			;load start line
		ldsw	Z,_VIDEO_OUT_PIXEL_POINTER_INPUT		;get pixel pointer input
		subw	Y,X						;subtrac line from start line
		andi	YL,7						;mask low bits		
									;1 area height=8 lines
		cpi	YL,0						;time to process?
		brne	_VIDEO_OUT_INPUT_CAPTURE_20			;no, branch
		movw	XL,ZL						;X=Z
		addiw	X,_VIDEO_OUT_BUFFER_INPUT_SIZE			;X-->OLD DATA
		movw	YL,ZL						;Y=Z
		addiw	Y,_VIDEO_OUT_BUFFER_INPUT_SIZE*2		;Y-->DIF DATA
		ldi	Temp,24						;temp<-number of area cols
	_VIDEO_OUT_INPUT_CAPTURE_10:
		;/////////////////////////////////////
		;// DIF_DATA(N)+=NEW_DATA(N)-OLD_DATA(N)+DECAY
		;/////////////////////////////////////
		ld	Acc,Z						;get NEW DATA
		mov	AccT,Acc					;AccT=NEW DATA 
		ld	AccH,X						;get OLD DATA
		sub	Acc,AccH					;DIF=NEW_DATA-OLD_DATA
		brpl	PC+2						;branch if positive
		neg	Acc						;else abs(DIF)
		ld	AccH,Y
		add	Acc,AccH
		brcc	PC+2
		ldi	Acc,255
		lds	AccH,_VIDEO_DIGITIZING_DECAY			;get decay rate
		sub	Acc,AccH
		brcc	PC+2
		ldi	Acc,0
		st	Y+,Acc						;store DIF
		;/////////////////////////////////////
		;// OLD_DATA(N)<-NEW_DATA(N)
		;/////////////////////////////////////
		st	X+,AccT	
		;/////////////////////////////////////
		;// NEW_DATA(N)<-0
		;/////////////////////////////////////
		ldi	AccT,0
		st	Z+,AccT
		
		dec	Temp
		brne	_VIDEO_OUT_INPUT_CAPTURE_10			;until all done
		stsw	_VIDEO_OUT_PIXEL_POINTER_INPUT,Z		;update input pointer
	_VIDEO_OUT_INPUT_CAPTURE_20:
		ret
		;////////////////////////
		;//
		;//  DECAY = 0
		;//
		;////////////////////////
	_VIDEO_OUT_INPUT_CAPTURE_30:
		ldsw	X,_VIDEO_OUT_EVEN_LINE_START			;load start line
		ldsw	Z,_VIDEO_OUT_PIXEL_POINTER_INPUT		;get pixel pointer input
		subw	Y,X						;subtrac line from start line
		andi	YL,7						;mask low bits		
									;1 area height=8 lines
		cpi	YL,0						;time to process?
		brne	_VIDEO_OUT_INPUT_CAPTURE_20			;no, branch
		movw	XL,ZL						;X=Z
		addiw	X,_VIDEO_OUT_BUFFER_INPUT_SIZE			;X-->OLD DATA
		movw	YL,ZL						;Y=Z
		addiw	Y,_VIDEO_OUT_BUFFER_INPUT_SIZE*2		;Y-->DIF DATA
		ldi	Temp,24						;temp<-number of area cols
	_VIDEO_OUT_INPUT_CAPTURE_40:
		;/////////////////////////////////////
		;// DIF_DATA(N)<-NEW_DATA(N)-OLD_DATA(N)
		;/////////////////////////////////////
		ld	Acc,Z						;get NEW DATA
		mov	AccT,Acc					;AccT=NEW DATA 
		ld	AccH,X						;get OLD DATA
		sub	Acc,AccH					;DIF=NEW_DATA-OLD_DATA
		brpl	PC+2						;branch if positive
		neg	Acc						;else abs(DIF)
		st	Y+,Acc						;store DIF
		;/////////////////////////////////////
		;// OLD_DATA(N)<-NEW_DATA(N)
		;/////////////////////////////////////
		st	X+,AccT	
		;/////////////////////////////////////
		;// NEW_DATA(N)<-0
		;/////////////////////////////////////
		ldi	AccT,0
		st	Z+,AccT
		
		dec	Temp
		brne	_VIDEO_OUT_INPUT_CAPTURE_40			;until all done
		stsw	_VIDEO_OUT_PIXEL_POINTER_INPUT,Z		;update input pointer
		ret

	;>--------------------------------------------------------------<
	;| OBJECT     : VIDEO_OUT					|
	;>--------------------------------------------------------------<
	;| FUNCTION   : Get DIGITIZING VIDEO CAPTURE STATE		|
	;>--------------------------------------------------------------<
	;| INPUT      :	None						|
	;| OUTPUT     :	_ON if has digitilized image on buffer		|
	;| DESTROYED  :	None						|
	;| TIME	      :	----						|
	;>--------------------------------------------------------------<
	;| OBSERVATION:	----						|
	;+--------------------------------------------------------------+-------------------------------------------------------------------------------\
	;|																		|
	_VIDEO_DIGITIZING_GET_STATE:
		lds	Acc,_VIDEO_DIGITIZING_EVENT			;get video digitinzing EVENT
		cpi	Acc,_VIDEO_DIGITIZING_EVENT_TO_DOWN		;EVENT=TO_DOWN?
		ldi	Acc,_OFF					;assume OFF
		brne	_VIDEO_DIGITIZING_GET_STATE_10			;no, branch
		ldi	Acc,_ON						;else CAPTURE IMAGE ON
	_VIDEO_DIGITIZING_GET_STATE_10:
		ret
	;>--------------------------------------------------------------<
	;| OBJECT     : VIDEO_OUT					|
	;>--------------------------------------------------------------<
	;| FUNCTION   : Get Capture Video Dot				|
	;>--------------------------------------------------------------<
	;| INPUT      :	XL,YL	Dot coordinates	(0..23,0..23)		|
	;| OUTPUT     :	Acc	Dot value 0..255			|
	;| DESTROYED  :	Flags						|
	;| TIME	      :	----						|
	;>--------------------------------------------------------------<
	;| OBSERVATION:	----						|
	;+--------------------------------------------------------------+-------------------------------------------------------------------------------\
	_VIDEO_DIGITIZING_GET_CAPTURE_DOT:
		push	r0
		push	r1
		pushw	X
		pushw	Y
		pushw	Z
		ldiw	Z,_VIDEO_DIGITIZING_MASK_AREAS			;check if area marked
		ldi	XH,_VIDEO_DIGITIZING_MASK_COLS
		ldi	YH,_VIDEO_DIGITIZING_MASK_ROWS
		lsr	XL						;transform 0..23 --> 0..11
		lsr	YL
		call	_RASTER_GET_BIT_XY
		cpi	Acc,_ON						;area marked ?
		brne	_VIDEO_DIGITIZING_GET_CAPTURE_DOT_10A		;no, branch
		ldi	Acc,0						;else return zero
		popw	Z
		popw	Y
		popw	X
		pop	r1
		pop	r0
		ret
	_VIDEO_DIGITIZING_GET_CAPTURE_DOT_10A:
		popw	Z
		popw	Y
		popw	X
		pop	r1
		pop	r0
		push	r0
		push	r1
		pushw	Z
		ldi	Acc,0						;assume return 0
		cpi	XL,_VIDEO_DIGITIZING_COLS			;X>max cols?
		brsh	_VIDEO_DIGITIZING_GET_CAPTURE_DOT_EXIT		;yes, exit
		cpi	YL,_VIDEO_DIGITIZING_ROWS			;Y>max cols?
		brsh	_VIDEO_DIGITIZING_GET_CAPTURE_DOT_EXIT		;yes, exit
		ldiw	Z,_VIDEO_OUT_BUFFER_DIG_CAP			;Z-->capture buffer
	_VIDEO_DIGITIZING_GET_CAPTURE_DOT_10:
		ldi	Acc,_VIDEO_DIGITIZING_COLS			;compute dot position
		mul	Acc,YL
		add	ZL,r0
		adc	ZH,r1
		add	ZL,XL
		ldi	Acc,0
		adc	ZH,Acc
		ld	Acc,Z						;get dot
	_VIDEO_DIGITIZING_GET_CAPTURE_DOT_EXIT:
		popw	Z
		pop	r1
		pop	r0
		ret
	;>--------------------------------------------------------------<
	;| OBJECT     : VIDEO_OUT					|
	;>--------------------------------------------------------------<
	;| FUNCTION   : Get Difference Video Dot			|
	;>--------------------------------------------------------------<
	;| INPUT      :	XL,YL	Dot coordiantes	(0..23,0..23)		|
	;| OUTPUT     :	Acc	Dot value 0..255			|
	;| DESTROYED  :	Flags						|
	;| TIME	      :	----						|
	;>--------------------------------------------------------------<
	;| OBSERVATION:	----						|
	;+--------------------------------------------------------------+-------------------------------------------------------------------------------\
	_VIDEO_DIGITIZING_GET_DIFFERENCE_DOT:
		push	r0
		push	r1
		pushw	X
		pushw	Y
		pushw	Z
		ldiw	Z,_VIDEO_DIGITIZING_MASK_AREAS			;check if area marked
		ldi	XH,_VIDEO_DIGITIZING_MASK_COLS
		ldi	YH,_VIDEO_DIGITIZING_MASK_ROWS
		lsr	XL						;transform 0..23 --> 0..11
		lsr	YL
		call	_RASTER_GET_BIT_XY
		cpi	Acc,_ON						;area marked ?
		brne	_VIDEO_DIGITIZING_GET_DIFFERENCE_DOT_10		;no, branch
		ldi	Acc,0						;else return zero
		popw	Z
		popw	Y
		popw	X
		pop	r1
		pop	r0
		ret
	_VIDEO_DIGITIZING_GET_DIFFERENCE_DOT_10:
		popw	Z
		popw	Y
		popw	X		
		pop	r1
		pop	r0
		push	r0
		push	r1
		pushw	Z
		ldi	Acc,0						;assume return 0
		cpi	XL,_VIDEO_DIGITIZING_COLS			;X>max cols?
		brsh	_VIDEO_DIGITIZING_GET_CAPTURE_DOT_EXIT		;yes, exit
		cpi	YL,_VIDEO_DIGITIZING_ROWS			;Y>max cols?
		brsh	_VIDEO_DIGITIZING_GET_CAPTURE_DOT_EXIT		;yes, exit
		ldiw	Z,_VIDEO_OUT_BUFFER_DIG_DIF			;Z-->difference buffer
		rjmp	_VIDEO_DIGITIZING_GET_CAPTURE_DOT_10		;get dot

	;>--------------------------------------------------------------<
	;| OBJECT     : VIDEO_OUT					|
	;>--------------------------------------------------------------<
	;| FUNCTION   : Get Difference value of video frame		|
	;|		without consider motion grid			|
	;>--------------------------------------------------------------<
	;| INPUT      : None						|
	;| OUTPUT     :	Acc	Max Dot value 0..255			|
	;| DESTROYED  :	Flags						|
	;| TIME	      :	----						|
	;>--------------------------------------------------------------<
	;| OBSERVATION:	----						|
	;+--------------------------------------------------------------+-------------------------------------------------------------------------------\
	_VIDEO_DIGITIZING_GET_FRAME_DIFFERENCE_VALUE:
		ldiw	X,_VIDEO_DIGITIZING_MASK_AREAS			;X-->Grid area pixels
		ldiw	Y,_VIDEO_OUT_BUFFER_DIG_DIF			;Y-->Diference pixels buffer
		ldiaw	_VIDEO_DIGITIZING_MASK_COLS*_VIDEO_DIGITIZING_MASK_ROWS


		pushw	X
		pushw	Z
		push	AccH
		ldiw	Z,_VIDEO_OUT_BUFFER_DIG_DIF			;Z-->difference buffer
		ldiw	X,_VIDEO_OUT_BUFFER_INPUT_SIZE
		ldi	AccH,0						;AccH=0 to get max value
	_VIDEO_DIGITIZING_GET_MAX_DIFFERENCE_DOT_10:
		ld	Acc,Z+						;get dot value
		cp	Acc,AccH					;dot > max ?
		brlo	_VIDEO_DIGITIZING_GET_MAX_DIFFERENCE_DOT_20	;no, branch 
		mov	AccH,Acc					;else max=dot
	_VIDEO_DIGITIZING_GET_MAX_DIFFERENCE_DOT_20:
		subiw	X,1
		brne	_VIDEO_DIGITIZING_GET_MAX_DIFFERENCE_DOT_10	;until read all dots
		mov	Acc,AccH					;Acc=Max dot value
		pop	AccH
		popw	Z
		popw	X
		ret

		ldiw	Z,_VIDEO_DIGITIZING_MASK_AREAS			;check if area marked
		ldi	XH,_VIDEO_DIGITIZING_MASK_COLS
		ldi	YH,_VIDEO_DIGITIZING_MASK_ROWS

	;>--------------------------------------------------------------<
	;| OBJECT     : VIDEO_OUT					|
	;>--------------------------------------------------------------<
	;| FUNCTION   : Clear Difference Video Buffer			|
	;>--------------------------------------------------------------<
	;| INPUT      : None						|
	;| OUTPUT     : None						|
	;| DESTROYED  :	Flags						|
	;| TIME	      :	----						|
	;>--------------------------------------------------------------<
	;| OBSERVATION:	----						|
	;+--------------------------------------------------------------+-------------------------------------------------------------------------------\
	_VIDEO_DIGITIZING_CLEAR_DIFFERENCE_BUFFER:
		pushw	X
		pushw	Z
		push	Acc
		ldiw	Z,_VIDEO_OUT_BUFFER_DIG_DIF			;Z-->difference buffer
		ldiw	X,_VIDEO_OUT_BUFFER_INPUT_SIZE
		ldi	Acc,0						;AccH=0 to get max value
	_VIDEO_DIGITIZING_CLEAR_DIFFERENCE_BUFFER_10:
		st	Z+,Acc						;get dot value
		subiw	X,1
		brne	_VIDEO_DIGITIZING_CLEAR_DIFFERENCE_BUFFER_10	;until read all dots clear
		pop	Acc
		popw	Z
		popw	X
		ret

	;>--------------------------------------------------------------<
	;| OBJECT     : VIDEO_OUT					|
	;>--------------------------------------------------------------<
	;| FUNCTION   : SET video system				|
	;>--------------------------------------------------------------<
	;| INPUT      :	Acc = VIDEO_NTSC,VIDEO_PAL			|
	;| OUTPUT     :	None						|
	;| DESTROYED  :	None						|
	;| TIME	      :	----						|
	;>--------------------------------------------------------------<
	;| OBSERVATION:	Interrupts are disable during initialization	|
	;+--------------------------------------------------------------+-------------------------------------------------------------------------------\
	;|																		|
	_VIDEO_OUT_SET_SYSTEM:
		pushaw					;save useds
		in	AccH,SREG			;save SREG
		cli					;disable interrupts
		push	AccH
		;///////////////////////////////////////
		;// N T S C   S Y S T E M
		;///////////////////////////////////////
		cpi	Acc,_VIDEO_OUT_NTSC		;NTSC ?
		lbrne	_VIDEO_OUT_SET_SYSTEM_00	;no, branch
		ldiaw	_VIDEO_OUT_TIMER1_DIV_NTSC	;set NTSC timer1 divisor value
		stsaw	_VIDEO_OUT_TIMER1_DIV
		ldiaw	_VIDEO_OUT_H_TIME_NTSC		;else set NTSC parameters
		stsaw	_VIDEO_OUT_H_TIME		;set H TIME
		ldiaw	_VIDEO_OUT_H_TIME_HALF_NTSC	
		stsaw	_VIDEO_OUT_H_TIME_HALF		;set H/2 TIME
                ; DEFINED BEFORE +127
                ; 5/11/2015 23:00
                ; 110 - (deu problema depois de algum tempo usando a tv da sala "pode ser apenas cabo" no monitor UNISEG funcionou ok
                ; 6/11/2015 00:27
                ;  100 na tv da sala ficou ok apos 1a programação(sob teste)
		ldiaw	_VIDEO_OUT_H_TIME_HALF_NTSC+100 ;set H/2 TIME + interrupt delay
		stsaw	_VIDEO_OUT_TIME_ADJUST_1	;set time adjust 1
		ldiaw	128				;set H TIME + interrupt delay + some adjust
		stsaw	_VIDEO_OUT_TIME_ADJUST_2	;set time adjust 2
		ldiaw	206				;H TIME + 2.2Us+interrupt delay+ some adjust line 263
		stsaw	_VIDEO_OUT_TIME_ADJUST_3	;set time adjust 3
		ldiaw	_VIDEO_OUT_H_TIME_HALF_NTSC+213	;H/2 TIME + interrupt delay + some adjust
		stsaw	_VIDEO_OUT_TIME_ADJUST_4	;load time adjust 4
		ldiaw	_VIDEO_OUT_H_TIME_NTSC-39	;H TIME -4.7us + some adjust
		stsaw	_VIDEO_OUT_TIME_ADJUST_5	;set time adjust 5
		ldiaw	119				;H TIME + some adjust
		stsaw	_VIDEO_OUT_TIME_ADJUST_6	;set time adjust 5
		ldi	Acc,11				;set H(a) time 2.2 us base
		sts	_VIDEO_OUT_TIME_ADJUST_Ha,Acc
		ldi	Acc,24				;set H(b) time 4.7 us sync
		sts	_VIDEO_OUT_TIME_ADJUST_Hb,Acc
		ldi	Acc,17				;set H(c) time 3.3 us minimum base
		sts	_VIDEO_OUT_TIME_ADJUST_Hc,Acc
		ldi	Acc,11				;set EQ(a) time 2.3 us
		sts	_VIDEO_OUT_TIME_ADJUST_EQa,Acc
		ldi	Acc,157
		sts	_VIDEO_OUT_TIME_ADJUST_EQb,Acc	;set EQ(b) time 29.45 us
		ldi	Acc,143
		sts	_VIDEO_OUT_TIME_ADJUST_SYNCa,Acc;set SYNC(a) time 26.8 us
		ldi	Acc,26
		sts	_VIDEO_OUT_TIME_ADJUST_SYNCb,Acc;set SYNC(b) time 4.7 us
		ldi	Acc,23
		sts	_VIDEO_OUT_H_POSITION,Acc	;set video start H position
		ldi	Acc,72				;interrupt compensation for NTSC
		sts	_VIDEO_OUT_INT_COMPENSATE,Acc
		ldiw	Z,(_VIDEO_TABLE_COMMANDS_NTSC*2);initialize pointer of commands
		stsw	_VIDEO_TABLE_COMMANDS_ADDR,Z
		stsw	_VIDEO_OUT_CMD_POINTER,Z
		ldiaw	_VIDEO_OUT_ODD_LINE_START_NTSC	;start line odd
		stsaw	_VIDEO_OUT_ODD_LINE_START
		ldiaw	_VIDEO_OUT_ODD_LINE_END_NTSC	;end line odd
		stsaw	_VIDEO_OUT_ODD_LINE_END
		ldiaw	_VIDEO_OUT_EVEN_LINE_START_NTSC	;start line even
		stsaw	_VIDEO_OUT_EVEN_LINE_START
		ldiaw	_VIDEO_OUT_EVEN_LINE_END_NTSC	;end line even
		stsaw	_VIDEO_OUT_EVEN_LINE_END
		rjmp	_VIDEO_OUT_SET_SYSTEM_EXIT	;exit
		;///////////////////////////////////////
		;// P A L   S Y S T E M
		;///////////////////////////////////////
	_VIDEO_OUT_SET_SYSTEM_00:
		cpi	Acc,_VIDEO_OUT_PAL		;PAL ?
		lbrne	_VIDEO_OUT_SET_SYSTEM_00	;no, branch
		ldiaw	_VIDEO_OUT_TIMER1_DIV_PAL	;set PAL timer1 divisor value
		stsaw	_VIDEO_OUT_TIMER1_DIV
		ldiaw	_VIDEO_OUT_H_TIME_PAL		;else set PAL parameters
		stsaw	_VIDEO_OUT_H_TIME		;set H TIME
		ldiaw	_VIDEO_OUT_H_TIME_HALF_PAL	
		stsaw	_VIDEO_OUT_H_TIME_HALF		;set H/2 TIME
		ldiaw   _VIDEO_OUT_H_TIME_HALF_PAL+127	;set H/2 TIME + interrupt delay
		stsaw	_VIDEO_OUT_TIME_ADJUST_1	;set time adjust 1
		ldiaw	120				;set H TIME + interrupt delay + some adjust
		stsaw	_VIDEO_OUT_TIME_ADJUST_2	;set time adjust 2
		ldiaw	212				;H TIME + 2.2Us+interrupt delay+ some adjust line 263
		stsaw	_VIDEO_OUT_TIME_ADJUST_3	;set time adjust 3
		ldiaw	_VIDEO_OUT_H_TIME_HALF_PAL+207	;H/2 TIME + interrupt delay + some adjust
		stsaw	_VIDEO_OUT_TIME_ADJUST_4	;load time adjust 4
		ldiaw	_VIDEO_OUT_H_TIME_PAL-39	;H TIME -4.7us + some adjust
		stsaw	_VIDEO_OUT_TIME_ADJUST_5	;set time adjust 5
		ldiaw	119				;H TIME + some adjust
		stsaw	_VIDEO_OUT_TIME_ADJUST_6	;set time adjust 6
		ldi	Acc,11				;set H(a) time 2.2 us base
		sts	_VIDEO_OUT_TIME_ADJUST_Ha,Acc
		ldi	Acc,24				;set H(b) time 4.7 us sync
		sts	_VIDEO_OUT_TIME_ADJUST_Hb,Acc
		ldi	Acc,20				;set H(c) time 3 us minimum base
		sts	_VIDEO_OUT_TIME_ADJUST_Hc,Acc
		ldi	Acc,11				;set EQ(a) time 2.3 us
		sts	_VIDEO_OUT_TIME_ADJUST_EQa,Acc
		ldi	Acc,158
		sts	_VIDEO_OUT_TIME_ADJUST_EQb,Acc	;set EQ(b) time 29.65 us
		ldi	Acc,146
		sts	_VIDEO_OUT_TIME_ADJUST_SYNCa,Acc;set SYNC(a) time 27,3 us
		ldi	Acc,26
		sts	_VIDEO_OUT_TIME_ADJUST_SYNCb,Acc;set SYNC(b) time 4.7 us
		ldi	Acc,21
		sts	_VIDEO_OUT_H_POSITION,Acc	;set video start H position
		ldi	Acc,72				;interrupt compensation for PAL
		sts	_VIDEO_OUT_INT_COMPENSATE,Acc
		ldiw	Z,_VIDEO_TABLE_COMMANDS_PAL*2	;initialize pointer of commands
		stsw	_VIDEO_TABLE_COMMANDS_ADDR,Z
		stsw	_VIDEO_OUT_CMD_POINTER,Z
		ldiaw	_VIDEO_OUT_ODD_LINE_START_PAL	;start line odd
		stsaw	_VIDEO_OUT_ODD_LINE_START
		ldiaw	_VIDEO_OUT_ODD_LINE_END_PAL	;end line odd
		stsaw	_VIDEO_OUT_ODD_LINE_END
		ldiaw	_VIDEO_OUT_EVEN_LINE_START_PAL	;start line even
		stsaw	_VIDEO_OUT_EVEN_LINE_START
		ldiaw	_VIDEO_OUT_EVEN_LINE_END_PAL	;end line even
		stsaw	_VIDEO_OUT_EVEN_LINE_END
		rjmp	_VIDEO_OUT_SET_SYSTEM_EXIT	;exit
	_VIDEO_OUT_SET_SYSTEM_EXIT:
		pop	AccH				;restore SREG
		out	SREG,AccH
		popaw
		ret
	;>--------------------------------------------------------------<
	;| OBJECT     : VIDEO_OUT					|
	;>--------------------------------------------------------------<
	;| FUNCTION   : GET video MODE of operation			|
	;>--------------------------------------------------------------<
	;| INPUT      :	None						|
	;| OUTPUT     :	Acc Video Mode					|
	;| DESTROYED  :	None						|
	;| TIME	      :	----						|
	;>--------------------------------------------------------------<
	;| OBSERVATION:	----						|
	;+--------------------------------------------------------------+-------------------------------------------------------------------------------\
	;|																		|
	_VIDEO_OUT_GET_MODE:
		lds	Acc,_VIDEO_OUT_MODE
		ret
	;>--------------------------------------------------------------<
	;| OBJECT     : VIDEO_OUT					|
	;>--------------------------------------------------------------<
	;| FUNCTION   : SET video MODE of operation COLD MODE		|
	;>--------------------------------------------------------------<
	;| INPUT      :	Acc = Video Mode				|
	;| OUTPUT     :	None						|
	;| DESTROYED  :	Z,AccH,Acc,Flags				|
	;| TIME	      :	----						|
	;>--------------------------------------------------------------<
	;| OBSERVATION:	Interrupts are disable during initialization	|
	;|		take care using this routines because invalid	|
	;|		screen mode cause a unpredictable results	|
	;|								|
	;|		This COLD MODE dont force verification of exter-|
	;|		nal video source present			|
	;+--------------------------------------------------------------+-------------------------------------------------------------------------------\
	;|																		|

	_VIDEO_OUT_SET_MODE_COLD:
		pushaw
		pushw	X
		pushw	Y
		pushw	Z
		in	AccH,SREG					;save SREG
		cli							;disable interrupts
		push	AccH
		rjmp	_VIDEO_OUT_SET_MODE_10

	;>--------------------------------------------------------------<
	;| OBJECT     : VIDEO_OUT					|
	;>--------------------------------------------------------------<
	;| FUNCTION   : SET video MODE of operation			|
	;>--------------------------------------------------------------<
	;| INPUT      :	Acc = Video Mode				|
	;| OUTPUT     :	None						|
	;| DESTROYED  :	Flags						|
	;| TIME	      :	----						|
	;>--------------------------------------------------------------<
	;| OBSERVATION:	Interrupts are disable during initialization	|
	;|		take care using this routines because invalid	|
	;|		screen mode cause a unpredictable results	|
	;+--------------------------------------------------------------+-------------------------------------------------------------------------------\
	;|																		|
	_VIDEO_OUT_SET_MODE:
		pushaw
		pushw	X
		pushw	Y
		pushw	Z
		in	AccH,SREG					;save SREG
		cli							;disable interrupts
		push	AccH
		;+--------------------------------------
		;| force VIDEO transiction to see video input state
		;+--------------------------------------
		ldi	AccH,_ON
		sts	_VIDEO_SYNC_EXTERNAL_CHANGE,AccH
		ldi	AccH,_OFF
		sts	_VIDEO_SYNC_EXTERNAL,AccH
	_VIDEO_OUT_SET_MODE_10:
		;+--------------------------------------
		;| inicialize VIDEO pointers and buffer
		;+--------------------------------------
		sts	_VIDEO_OUT_MODE,Acc				;set mode 
		ldsw	Z,_VIDEO_TABLE_COMMANDS_ADDR			;initialize pointer of commands
		stsw	_VIDEO_OUT_CMD_POINTER,Z
		ldiw	Z,_VIDEO_OUT_BUFFER				;initialize pixel pointer
		stsw	_VIDEO_OUT_PIXEL_POINTER,Z
		;+--------------------------------------
		;| compute initialization routine adddress
		;+--------------------------------------
		ldi	AccH,0						;AccH:Acc<<1 because address is a word size
		lsl	Acc
		rol	AccH
		ldiw	Z,_VIDEO_OUT_MODE_ADDRESS_TABLE*2		;get mode routines address
		add	ZL,Acc
		adc	ZH,AccH
		lpm	Acc,Z+						;AccH:Acc = routine address
		lpm	AccH,Z+
		movw	ZL,Acc
		ijmp							;call screen function set
	;//////////////////////////////////////
	;//
	;// ADDRESS MODE ROUTINE TABLE
	;//
	;//////////////////////////////////////
	_VIDEO_OUT_MODE_ADDRESS_TABLE:
		.DW	_VIDEO_OUT_SET_GRAPH_MODE_SCREEN_0
		.DW	_VIDEO_OUT_SET_GRAPH_MODE_SCREEN_1
		.DW	_VIDEO_OUT_SET_GRAPH_MODE_SCREEN_2
		.DW	_VIDEO_OUT_SET_GRAPH_MODE_SCREEN_3
		.DW	_VIDEO_OUT_SET_GRAPH_MODE_SCREEN_4
		.DW	_VIDEO_OUT_SET_GRAPH_MODE_SCREEN_5
		.DW	_VIDEO_OUT_SET_GRAPH_MODE_SCREEN_6
	;//////////////////////////////////////
	;//
	;// Video 128x96 Pixels 2 colors internal synchronism
	;// Video Buffer Size=(128/8)*96*log2(2)=1536
	;//////////////////////////////////////
	_VIDEO_OUT_SET_GRAPH_MODE_SCREEN_0:
		;ROTINES
		ldiaw	_VIDEO_OUT_H_SYNC_INTERNAL		
		stsaw	_VIDEO_OUT_H_SYNC_ADDR				;set address of H sync routine
		ldiaw	_VIDEO_OUT_V_SYNC
		stsaw	_VIDEO_OUT_V_SYNC_ADDR				;address of V sync routine
		ldiaw	_VIDEO_OUT_VIDEO_BW_ODD
		stsaw	_VIDEO_OUT_VIDEO_ODD_ADDR			;address of Video Odd Lines routine
		ldiaw	_VIDEO_OUT_VIDEO_BW_BLANK
		stsaw	_VIDEO_OUT_VIDEO_EVEN_ADDR			;address of Video Even Lines routine
		ldiaw	_VIDEO_OUT_VIDEO_BW_BLANK
		stsaw	_VIDEO_OUT_VIDEO_BLANK_ADDR			;address of Video Blank Lines routine
		;GRAPHICS
		ldi	Acc,_VIDEO_OUT_MAX_WIDTH/8			;set video width in bytes
		sts	_VIDEO_OUT_WIDTH,Acc
		ldi	Acc,_VIDEO_OUT_MAX_HEIGHT/2			;set video height
		sts	_VIDEO_OUT_HEIGHT,Acc
		ldi	Acc,_VIDEO_OUT_MAX_WIDTH			;set video screen width
		sts	_VIDEO_OUT_GRAPH_WIDTH,Acc
		ldi	Acc,_VIDEO_OUT_MAX_HEIGHT/2			;set video screen height
		sts	_VIDEO_OUT_GRAPH_HEIGHT,Acc
		ldi	Acc,21
		sts	_VIDEO_OUT_TEXT_COLS,Acc			;number of characters per screen width
		ldi	Acc,12
		sts	_VIDEO_OUT_TEXT_ROWS,Acc			;number of characters per screen height
		;RASTER
		lds	XL,_VIDEO_OUT_GRAPH_WIDTH
		ldi	XH,0
		lds	YL,_VIDEO_OUT_GRAPH_HEIGHT
		ldiw	Z,_VIDEO_OUT_BUFFER
		ldi	Acc,1						;pixels=1
		call	_RASTER_CREATE
		;MIX CONTROL
		_M_VIDEO_MIX_INTERNAL	Acc				;set mix to internal
	_VIDEO_OUT_SET_GRAPH_MODE_EXIT:
		pop	AccH						;restore SREG
		out	SREG,AccH
		popw	Z
		popw	Y
		popw	X
		popaw
		ret
	;//////////////////////////////////////
	;//
	;// Video 128x192 Pixels 2 colors internal synchronism
	;// Video Buffer Size=(128/8)*192*log2(2)=3072
	;//////////////////////////////////////
	_VIDEO_OUT_SET_GRAPH_MODE_SCREEN_1:
		;ROTINES
		ldiaw	_VIDEO_OUT_H_SYNC_INTERNAL		
		stsaw	_VIDEO_OUT_H_SYNC_ADDR				;set address of H sync routine
		ldiaw	_VIDEO_OUT_V_SYNC
		stsaw	_VIDEO_OUT_V_SYNC_ADDR				;address of V sync routine
		ldiaw	_VIDEO_OUT_VIDEO_BW_ODD_EVEN
		stsaw	_VIDEO_OUT_VIDEO_ODD_ADDR			;address of Video Odd Lines routine
		ldiaw	_VIDEO_OUT_VIDEO_BW_ODD_EVEN
		stsaw	_VIDEO_OUT_VIDEO_EVEN_ADDR			;address of Video Even Lines routine
		ldiaw	_VIDEO_OUT_VIDEO_BW_BLANK
		stsaw	_VIDEO_OUT_VIDEO_BLANK_ADDR			;address of Video Blank Lines routine
		;GRAPHICS
		ldi	Acc,_VIDEO_OUT_MAX_WIDTH/8			;set video width in bytes
		sts	_VIDEO_OUT_WIDTH,Acc
		ldi	Acc,_VIDEO_OUT_MAX_HEIGHT			;set video height
		sts	_VIDEO_OUT_HEIGHT,Acc
		ldi	Acc,_VIDEO_OUT_MAX_WIDTH			;set video screen width
		sts	_VIDEO_OUT_GRAPH_WIDTH,Acc
		ldi	Acc,_VIDEO_OUT_MAX_HEIGHT			;set video screen height
		sts	_VIDEO_OUT_GRAPH_HEIGHT,Acc
		ldi	Acc,21
		sts	_VIDEO_OUT_TEXT_COLS,Acc			;number of characters per screen width
		ldi	Acc,24
		sts	_VIDEO_OUT_TEXT_ROWS,Acc			;number of characters per screen height
		;RASTER
		lds	XL,_VIDEO_OUT_GRAPH_WIDTH
		ldi	XH,0
		lds	YL,_VIDEO_OUT_GRAPH_HEIGHT
		ldiw	Z,_VIDEO_OUT_BUFFER
		ldi	Acc,1						;pixels=1
		call	_RASTER_CREATE
		;MIX CONTROL
		_M_VIDEO_MIX_INTERNAL	Acc				;set mix to internal
		rjmp	_VIDEO_OUT_SET_GRAPH_MODE_EXIT


	;//////////////////////////////////////
	;//
	;// Video 128x96 Pixels 2 colors external synchronism genlock
	;// Video Buffer Size=(128/8)*96*log2(2)=1536
	;//////////////////////////////////////
	_VIDEO_OUT_SET_GRAPH_MODE_SCREEN_2:
		;ROTINES
		ldiaw	_VIDEO_OUT_H_SYNC_EXTERNAL		
		stsaw	_VIDEO_OUT_H_SYNC_ADDR				;set address of H sync routine
		ldiaw	_VIDEO_OUT_V_SYNC_GENLOCK
		stsaw	_VIDEO_OUT_V_SYNC_ADDR				;address of V sync routine
		ldiaw	_VIDEO_OUT_VIDEO_BW_MIXED
		stsaw	_VIDEO_OUT_VIDEO_ODD_ADDR			;address of Video Odd Lines routine
		ldiaw	_VIDEO_OUT_INPUT_16L_EVEN
		stsaw	_VIDEO_OUT_VIDEO_EVEN_ADDR			;address of Video Even Lines routine
		ldiaw	_VIDEO_OUT_VIDEO_BW_BLANK
		stsaw	_VIDEO_OUT_VIDEO_BLANK_ADDR			;address of Video Blank Lines routine
		;GRAPHICS
		ldi	Acc,_VIDEO_OUT_MAX_WIDTH/8			;set video width in bytes
		sts	_VIDEO_OUT_WIDTH,Acc
		ldi	Acc,_VIDEO_OUT_MAX_HEIGHT/2			;set video height
		sts	_VIDEO_OUT_HEIGHT,Acc
		ldi	Acc,_VIDEO_OUT_MAX_WIDTH			;set video screen width
		sts	_VIDEO_OUT_GRAPH_WIDTH,Acc
		ldi	Acc,_VIDEO_OUT_MAX_HEIGHT/2			;set video screen height
		sts	_VIDEO_OUT_GRAPH_HEIGHT,Acc
		ldi	Acc,21
		sts	_VIDEO_OUT_TEXT_COLS,Acc			;number of characters per screen width
		ldi	Acc,12
		sts	_VIDEO_OUT_TEXT_ROWS,Acc			;number of characters per screen height
		;RASTER
		lds	XL,_VIDEO_OUT_GRAPH_WIDTH
		ldi	XH,0
		lds	YL,_VIDEO_OUT_GRAPH_HEIGHT
		ldiw	Z,_VIDEO_OUT_BUFFER
		ldi	Acc,1						;pixels=1
		call	_RASTER_CREATE
		;MIX CONTROL
		_M_VIDEO_MIX_EXTERNAL	Acc				;set mix to external
		rjmp	_VIDEO_OUT_SET_GRAPH_MODE_EXIT
	;//////////////////////////////////////
	;//
	;// Video 128x192 Pixels 2 colors external synchronism genlock
	;// Video Buffer Size=(128/8)*192*log2(2)=3072
	;//////////////////////////////////////
	_VIDEO_OUT_SET_GRAPH_MODE_SCREEN_3:
		;ROTINES
		ldiaw	_VIDEO_OUT_H_SYNC_EXTERNAL		
		stsaw	_VIDEO_OUT_H_SYNC_ADDR				;set address of H sync routine
		ldiaw	_VIDEO_OUT_V_SYNC_GENLOCK
		stsaw	_VIDEO_OUT_V_SYNC_ADDR				;address of V sync routine
		ldiaw	_VIDEO_OUT_VIDEO_BW_MIXED
		stsaw	_VIDEO_OUT_VIDEO_ODD_ADDR			;address of Video Odd Lines routine
		ldiaw	_VIDEO_OUT_VIDEO_BW_MIXED
		stsaw	_VIDEO_OUT_VIDEO_EVEN_ADDR			;address of Video Even Lines routine
		ldiaw	_VIDEO_OUT_VIDEO_BW_BLANK
		stsaw	_VIDEO_OUT_VIDEO_BLANK_ADDR			;address of Video Blank Lines routine
		;GRAPHICS
		ldi	Acc,_VIDEO_OUT_MAX_WIDTH/8			;set video width in bytes
		sts	_VIDEO_OUT_WIDTH,Acc
		ldi	Acc,_VIDEO_OUT_MAX_HEIGHT			;set video height
		sts	_VIDEO_OUT_HEIGHT,Acc
		ldi	Acc,_VIDEO_OUT_MAX_WIDTH			;set video screen width
		sts	_VIDEO_OUT_GRAPH_WIDTH,Acc
		ldi	Acc,_VIDEO_OUT_MAX_HEIGHT			;set video screen height
		sts	_VIDEO_OUT_GRAPH_HEIGHT,Acc
		ldi	Acc,21
		sts	_VIDEO_OUT_TEXT_COLS,Acc			;number of characters per screen width
		ldi	Acc,24
		sts	_VIDEO_OUT_TEXT_ROWS,Acc			;number of characters per screen height
		;RASTER
		lds	XL,_VIDEO_OUT_GRAPH_WIDTH
		ldi	XH,0
		lds	YL,_VIDEO_OUT_GRAPH_HEIGHT
		ldiw	Z,_VIDEO_OUT_BUFFER
		ldi	Acc,1						;pixels=1
		call	_RASTER_CREATE
		;MIX CONTROL
		_M_VIDEO_MIX_EXTERNAL	Acc				;set mix to external
		rjmp	_VIDEO_OUT_SET_GRAPH_MODE_EXIT
	;//////////////////////////////////////
	;//
	;// Video 96x72 Pixels 16 colors internal synchronism
	;// Video Buffer Size=(96/8)*72*log2(16)=3456
	;//////////////////////////////////////
	_VIDEO_OUT_SET_GRAPH_MODE_SCREEN_4:
		;ROTINES
		ldiaw	_VIDEO_OUT_H_SYNC_INTERNAL		
		stsaw	_VIDEO_OUT_H_SYNC_ADDR				;set address of H sync routine
		ldiaw	_VIDEO_OUT_V_SYNC
		stsaw	_VIDEO_OUT_V_SYNC_ADDR				;address of V sync routine
		ldiaw	_VIDEO_OUT_VIDEO_16L_ODD
		stsaw	_VIDEO_OUT_VIDEO_ODD_ADDR			;address of Video Odd Lines routine
		ldiaw	_VIDEO_OUT_VIDEO_16L_EVEN
		stsaw	_VIDEO_OUT_VIDEO_EVEN_ADDR			;address of Video Even Lines routine
		ldiaw	_VIDEO_OUT_VIDEO_BW_BLANK
		stsaw	_VIDEO_OUT_VIDEO_BLANK_ADDR			;address of Video Blank Lines routine
		;GRAPHICS
		ldi	Acc,_VIDEO_OUT_MAX_WIDTH*3/8			;set video width in bytes
		sts	_VIDEO_OUT_WIDTH,Acc
		ldi	Acc,_VIDEO_OUT_MAX_HEIGHT*3/8			;set video height
		sts	_VIDEO_OUT_HEIGHT,Acc
		ldi	Acc,_VIDEO_OUT_MAX_WIDTH*3/4			;set video screen width
		sts	_VIDEO_OUT_GRAPH_WIDTH,Acc
		ldi	Acc,_VIDEO_OUT_MAX_HEIGHT*3/8			;set video screen height
		sts	_VIDEO_OUT_GRAPH_HEIGHT,Acc
		ldi	Acc,16
		sts	_VIDEO_OUT_TEXT_COLS,Acc			;number of characters per screen width
		ldi	Acc,9
		sts	_VIDEO_OUT_TEXT_ROWS,Acc			;number of characters per screen height
		;RASTER
		lds	XL,_VIDEO_OUT_GRAPH_WIDTH
		ldi	XH,0
		lds	YL,_VIDEO_OUT_GRAPH_HEIGHT
		ldiw	Z,_VIDEO_OUT_BUFFER
		ldi	Acc,4						;pixels=4
		call	_RASTER_CREATE
		;MIX CONTROL
		_M_VIDEO_MIX_INTERNAL	Acc				;set mix to internal
		rjmp	_VIDEO_OUT_SET_GRAPH_MODE_EXIT
	;//////////////////////////////////////
	;//
	;// Video 24x24 Pixels 16 colors internal synchronism
	;// Video Buffer Size=24*24*log2(16)=2304
	;//////////////////////////////////////
	_VIDEO_OUT_SET_GRAPH_MODE_SCREEN_5:
		;ROTINES
		ldiaw	_VIDEO_OUT_H_SYNC_INTERNAL
		stsaw	_VIDEO_OUT_H_SYNC_ADDR				;set address of H sync routine
		ldiaw	_VIDEO_OUT_V_SYNC
		stsaw	_VIDEO_OUT_V_SYNC_ADDR				;address of V sync routine
		ldiaw	_VIDEO_OUT_VIDEO_16LD_ODD
		stsaw	_VIDEO_OUT_VIDEO_ODD_ADDR			;address of Video Odd Lines routine
		ldiaw	_VIDEO_OUT_VIDEO_BW_BLANK
		stsaw	_VIDEO_OUT_VIDEO_EVEN_ADDR			;address of Video Even Lines routine
		ldiaw	_VIDEO_OUT_VIDEO_BW_BLANK
		stsaw	_VIDEO_OUT_VIDEO_BLANK_ADDR			;address of Video Blank Lines routine
		;GRAPHICS
		ldi	Acc,_VIDEO_OUT_MAX_WIDTH*3/32			;set video width in bytes
		sts	_VIDEO_OUT_WIDTH,Acc
		ldi	Acc,_VIDEO_OUT_MAX_HEIGHT/8			;set video height
		sts	_VIDEO_OUT_HEIGHT,Acc
		ldi	Acc,_VIDEO_OUT_MAX_WIDTH*3/16			;set video screen width
		sts	_VIDEO_OUT_GRAPH_WIDTH,Acc
		ldi	Acc,_VIDEO_OUT_MAX_HEIGHT/8			;set video screen height
		sts	_VIDEO_OUT_GRAPH_HEIGHT,Acc
		ldi	Acc,2
		sts	_VIDEO_OUT_TEXT_COLS,Acc			;number of characters per screen width
		ldi	Acc,1
		sts	_VIDEO_OUT_TEXT_ROWS,Acc			;number of characters per screen height
		;RASTER
		lds	XL,_VIDEO_OUT_GRAPH_WIDTH
		ldi	XH,0
		lds	YL,_VIDEO_OUT_GRAPH_HEIGHT
		ldiw	Z,_VIDEO_OUT_BUFFER
		ldi	Acc,4						;pixels=4
		call	_RASTER_CREATE
		;MIX CONTROL
		_M_VIDEO_MIX_INTERNAL	Acc				;set mix to internal
		rjmp	_VIDEO_OUT_SET_GRAPH_MODE_EXIT
	;//////////////////////////////////////
	;//
	;// Video 24x24 Pixels 16 colors external synchronism width video capture
	;// Video Buffer Size=24*24*log2(16)=2304
	;//////////////////////////////////////
	_VIDEO_OUT_SET_GRAPH_MODE_SCREEN_6:
		;ROTINES
		ldiaw	_VIDEO_OUT_H_SYNC_EXTERNAL
		stsaw	_VIDEO_OUT_H_SYNC_ADDR				;set address of H sync routine
		ldiaw	_VIDEO_OUT_V_SYNC_GENLOCK
		stsaw	_VIDEO_OUT_V_SYNC_ADDR				;address of V sync routine
		ldiaw	_VIDEO_OUT_VIDEO_16LD_ODD
		stsaw	_VIDEO_OUT_VIDEO_ODD_ADDR			;address of Video Odd Lines routine
		ldiaw	_VIDEO_OUT_INPUT_16L_EVEN
		stsaw	_VIDEO_OUT_VIDEO_EVEN_ADDR			;address of Video Even Lines routine
		ldiaw	_VIDEO_OUT_VIDEO_BW_BLANK
		stsaw	_VIDEO_OUT_VIDEO_BLANK_ADDR			;address of Video Blank Lines routine
		;GRAPHICS
		ldi	Acc,_VIDEO_OUT_MAX_WIDTH*3/32			;set video width in bytes
		sts	_VIDEO_OUT_WIDTH,Acc
		ldi	Acc,_VIDEO_OUT_MAX_HEIGHT/8			;set video height
		sts	_VIDEO_OUT_HEIGHT,Acc
		ldi	Acc,_VIDEO_OUT_MAX_WIDTH*3/16			;set video screen width
		sts	_VIDEO_OUT_GRAPH_WIDTH,Acc
		ldi	Acc,_VIDEO_OUT_MAX_HEIGHT/8			;set video screen height
		sts	_VIDEO_OUT_GRAPH_HEIGHT,Acc
		ldi	Acc,2
		sts	_VIDEO_OUT_TEXT_COLS,Acc			;number of characters per screen width
		ldi	Acc,1
		sts	_VIDEO_OUT_TEXT_ROWS,Acc			;number of characters per screen height
		;RASTER
		lds	XL,_VIDEO_OUT_GRAPH_WIDTH
		ldi	XH,0
		lds	YL,_VIDEO_OUT_GRAPH_HEIGHT
		ldiw	Z,_VIDEO_OUT_BUFFER
		ldi	Acc,4						;pixels=4
		call	_RASTER_CREATE
		;MIX CONTROL
		_M_VIDEO_MIX_INTERNAL	Acc				;set mix to internal
		rjmp	_VIDEO_OUT_SET_GRAPH_MODE_EXIT
	;>--------------------------------------------------------------<
	;| OBJECT     : VIDEO_OUT					|
	;>--------------------------------------------------------------<
	;| FUNCTION   : initialize VIDEO_OUT hardware			|
	;>--------------------------------------------------------------<
	;| INPUT      :	None						|
	;| OUTPUT     :	None						|
	;| DESTROYED  :	None						|
	;| TIME	      :	----						|
	;>--------------------------------------------------------------<
	;| OBSERVATION:	Interrupts are disable during initialization	|
	;+--------------------------------------------------------------+-------------------------------------------------------------------------------\
	;|																		|
	_VIDEO_OUT_INIT:
		push	Acc						;save useds
		;+--------------------------------------
		;| save SREG and disable interrupts
		;+--------------------------------------
		in	Acc,SREG					;save SREG and disable interrupts
		cli
		push	Acc
		;+--------------------------------------
		;| set VIDEO SYNC for input with pull up
		;+--------------------------------------
		sbi	_VIDEO_SYNC_PORT_OUTPUT,_VIDEO_SYNC_FIELD_BIT	;all pullup and input
		sbi	_VIDEO_SYNC_PORT_OUTPUT,_VIDEO_SYNC_COMPOSITE_BIT
		sbi	_VIDEO_SYNC_PORT_OUTPUT,_VIDEO_SYNC_VERTICAL_BIT
		
		cbi	_VIDEO_SYNC_PORT_DIR,_VIDEO_SYNC_FIELD_BIT
		cbi	_VIDEO_SYNC_PORT_DIR,_VIDEO_SYNC_COMPOSITE_BIT
		cbi	_VIDEO_SYNC_PORT_DIR,_VIDEO_SYNC_VERTICAL_BIT
		sbi	_VIDEO_SYNC_PORT_DIR,7
		;+--------------------------------------
		;| set comparator input with pull up
		;+--------------------------------------
		cbi	_VIDEO_COMP_PORT_OUTPUT,_VIDEO_COMP_R2R_BIT	;comparator pins as high impedance
		cbi	_VIDEO_COMP_PORT_OUTPUT,_VIDEO_COMP_VIDEO_BIT
		cbi	_VIDEO_COMP_PORT_OUTPUT,_VIDEO_COMP_PWM_B_BIT	;start pwm low level
		cbi	_VIDEO_COMP_PORT_DIR,_VIDEO_COMP_R2R_BIT	;comparator pins as input
		cbi	_VIDEO_COMP_PORT_DIR,_VIDEO_COMP_VIDEO_BIT
		sbi	_VIDEO_COMP_PORT_DIR,_VIDEO_COMP_PWM_B_BIT	;pwm as output
		;+--------------------------------------
		;| program TIMER3 to generate 7812,5Hz of 10bit PWM
		;| MODE 3 WGM33=0 WGM32=0 WGM31=1 WGM30=1
		;| PRESCALER 1X
		;+--------------------------------------
		ldi	Acc,(1<<WGM31)|(1<<WGM30)|(1<<COM3B1)|(0<<COM3B0);mode 3 (NORMAL FASE CORRECT PWM 10 BITS)
		sts	TCCR3A,Acc
		ldi	Acc,(0<<WGM33)|(0<<WGM32)|_TIMERM13_DIV_1	;prescaler = 1x
		sts	TCCR3B,Acc
		ldiaw	180						;force 50% of pwm at start
		sts	OCR3BH,AccH
		sts	OCR3BL,Acc
		;+--------------------------------------
		;| set video system NTSC
		;+--------------------------------------
		ldi	Acc,_VIDEO_OUT_NTSC
		rcall	_VIDEO_OUT_SET_SYSTEM
		;+--------------------------------------
		;| set video to max resolution mode 
		;+--------------------------------------
		ldi	Acc,_VIDEO_MODE_128X96X2N
		rcall	_VIDEO_OUT_SET_MODE
		;+--------------------------------------
		;| program video mix to internal video generator and enable it
		;+--------------------------------------
		lds	Acc,_VIDEO_MIX_PORT_OUTPUT			;get old state
		andi	Acc,~(1<<_VIDEO_MIX_DIRECTION_BIT)		;set to internal video generator
		andi	Acc,~(1<<_VIDEO_MIX_ENABLE_BIT)			;enable mix
		sts	_VIDEO_MIX_PORT_OUTPUT,Acc
		lds	Acc,_VIDEO_MIX_PORT_DIR				;set both bits as output
		ori	Acc,(1<<_VIDEO_MIX_DIRECTION_BIT)
		ori	Acc,(1<<_VIDEO_MIX_ENABLE_BIT)
		sts	_VIDEO_MIX_PORT_DIR,Acc
		;+--------------------------------------
		;| program TIMER1 to generate 15732,55Hz(NTSC) of interrupt
		;| MODE 4 WGM13=0 WGM12=1 WGM11=0 WGM10=0
		;| PRESCALER 1X
		;+--------------------------------------
		ldi	Acc,(0<<WGM11)|(0<<WGM10)			;mode 4 (CTC)
		out	TCCR1A,Acc
		ldi	Acc,(0<<WGM13)|(1<<WGM12)|_TIMERM13_DIV_1	;prescaler = 1x
		out	TCCR1B,Acc
		ldsaw	_VIDEO_OUT_TIMER1_DIV				;get timing for NTSC H period
		out	OCR1AH,AccH
		out	OCR1AL,Acc
		in	Acc,TIMSK					;get old status
		ori	Acc,(1<<OCIE1A)					;compare math interrupt enable
		out	TIMSK,Acc
		;_SET_HANDDLE	_HDC_OC1A_VECT,_VIDEO_OUT_PROCESS	;<--- NOT USED IN THIS PROGRAM
									;M64_HDC include file has altered
									;at position of jmp of _HDC_OC1A_VECT
									;to jump to _VIDEO_OUT_PROCESS
		;+--------------------------------------
		;| inicialize VIDEO OUTPUT and INPUT ports
		;+--------------------------------------
		ser	Acc
		sts	_VIDEO_OUT_PORT_DIR,Acc				;VIDEO OUTPUT as output
		out	_VIDEO_IN_PORT_DIR,Acc				;VIDEO INPUT as output
		;+--------------------------------------
		;| set max top value for white dots
		;+--------------------------------------
		ldi	Acc,_VIDEO_OUT_LEVEL_WHITE_TOP
		sts	_VIDEO_OUT_LEVEL_WHITE,Acc
		;+--------------------------------------
		;| set FIELD = _ODD
		;+--------------------------------------
		ldi	Acc,_ODD
		sts	_VIDEO_OUT_FIELD,Acc
		ldi	Acc,0x5a				;force first change detection of external sync
		sts	_VIDEO_SYNC_EXTERNAL_CHANGE,Acc
		;+--------------------------------------
		;| inicialize VIDEO pointers and buffer
		;+--------------------------------------
		ldiw	Z,_VIDEO_OUT_BUFFER			;initialize pixel pointer
		stsw	_VIDEO_OUT_PIXEL_POINTER,Z
		ldiw	Z,_VIDEO_OUT_BUFFER_DIG_NEW		;initialize pixel pointer for input
		stsw	_VIDEO_OUT_PIXEL_POINTER_INPUT,Z
		;
		; INITIALIZE DIGITIZING 
		;
		ldi	Acc,1					;DIR_STEP=1
		sts	_VIDEO_DIGITIZING_DIR_STEP,Acc
		ldi	Acc,1					;LO_STEP=1
		sts	_VIDEO_DIGITIZING_LO_STEP,Acc
		ldi	Acc,16
		sts	_VIDEO_DIGITIZING_HI_STEP,Acc		;HI_STEP=16
		ldi	Acc,_VIDEO_DIGITIZING_EVENT_TO_UP	;EVENT=TO_UP
		sts	_VIDEO_DIGITIZING_EVENT,Acc
		ldiaw	512					;PWM_PREP=PWM=VCC/2
		_M_VIDEO_SET_RAMP
		stsaw	_VIDEO_DIGITIZING_PWM_PREP
		ldiaw	0					;PWM_LAST=0
		stsaw	_VIDEO_DIGITIZING_PWM_LAST
		#ifndef __DEBUG_MODE__
		_M_DELAY_MILLISECONDS	100			;wait PWM ramp stabilish
		#endif
		;+-----------------
		;| RASTER INITIALIZATION
		;+-----------------
		call	_RASTER_INIT				;init raster device
		pop	Acc					;restore SREG
		out	SREG,Acc
		pop	Acc
		ret

	;////////////////////////////////////////////////////////////////
	;// 
	;// VIDEO TABLES OF COMMANDS WHAT TO DO IN EACH VIDEO LINE
	;//
	;// Table bellow format
	;//
	;// .DW	Line	; Number of current line
	;// .DW Command ; Address of current command to do
	;//
	;////////////////////////////////////////////////////////////////
	
	;/////////////////////////////////////////////////////////
	;//							//
	;//   T A B L E  L I N E S  F O R  N T S C  S Y S T E M	//
	;//							//
	;/////////////////////////////////////////////////////////
	_VIDEO_TABLE_COMMANDS_NTSC:
	
	.DW	1,_VIDEO_EQUALIZE_IN	;Video Equalizing start pulses
	.DW	2,_VIDEO_EQUALIZE	;Video Normal Equalizing pulses
	.DW	3,_VIDEO_EQUALIZE
	.DW	4,_VIDEO_SYNC_GENLOCK	;Video Vertical Synchonism and GenLock Point
	.DW	5,_VIDEO_SYNC		;Video Vertical Sync Normal
	.DW	6,_VIDEO_SYNC
	.DW	7,_VIDEO_EQUALIZE	;Video Normal Equalizing pulses
	.DW	8,_VIDEO_EQUALIZE
	.DW	9,_VIDEO_EQUALIZE_OUT	;Video Equalizing stop pulses

	;//////////////////////////
	;// Lines 10..25 Blank Lines (Black Level)
	;//////////////////////////
	.DW 	10,_VIDEO_CHECK,11,_VIDEO_BLANK,12,_VIDEO_BLANK,13,_VIDEO_BLANK,14,_VIDEO_BLANK,15,_VIDEO_BLANK,16,_VIDEO_BLANK,17,_VIDEO_BLANK
	.DW 	18,_VIDEO_BLANK,19,_VIDEO_BLANK,20,_VIDEO_BLANK,21,_VIDEO_BLANK,22,_VIDEO_BLANK,23,_VIDEO_BLANK,24,_VIDEO_BLANK,25,_VIDEO_BLANK

	;//////////////////////////
	;// Lines 26..34 Blank Lines (Black Level)
	;// Lines 35..41 Alternate Video Odd and Video Even Lines
	;//////////////////////////
	.DW 	26,_VIDEO_BLANK,27,_VIDEO_BLANK,28,_VIDEO_BLANK,29,_VIDEO_BLANK,30,_VIDEO_BLANK,31,_VIDEO_BLANK,32,_VIDEO_BLANK,33,_VIDEO_BLANK
	.DW	34,_VIDEO_BLANK,35,_VIDEO_BLANK,36,_VIDEO_BLANK,37,_VIDEO_BLANK,38,_VIDEO_BLANK,39,_VIDEO_BLANK,40,_VIDEO_BLANK
	.DW	41,_VIDEO_RASTER_ENTER	;video raster start

	;///////////////////////////
	;// Lines 42..57 Alternate Video Odd and Video Even Lines
	;//////////////////////////
	.DW	 42,_VIDEO_EVEN_LINE, 43,_VIDEO_ODD_LINE, 44,_VIDEO_EVEN_LINE, 45,_VIDEO_ODD_LINE,46,_VIDEO_EVEN_LINE, 47,_VIDEO_ODD_LINE, 48,_VIDEO_EVEN_LINE, 49,_VIDEO_ODD_LINE
	.DW	 50,_VIDEO_EVEN_LINE, 51,_VIDEO_ODD_LINE, 52,_VIDEO_EVEN_LINE, 53,_VIDEO_ODD_LINE,54,_VIDEO_EVEN_LINE, 55,_VIDEO_ODD_LINE, 56,_VIDEO_EVEN_LINE, 57,_VIDEO_ODD_LINE

	;//////////////////////////
	;// Lines 58..73 Alternate Video Odd and Video Even Lines
	;//////////////////////////
	.DW	 58,_VIDEO_EVEN_LINE, 59,_VIDEO_ODD_LINE, 60,_VIDEO_EVEN_LINE, 61,_VIDEO_ODD_LINE, 62,_VIDEO_EVEN_LINE, 63,_VIDEO_ODD_LINE, 64,_VIDEO_EVEN_LINE, 65,_VIDEO_ODD_LINE
	.DW	 66,_VIDEO_EVEN_LINE, 67,_VIDEO_ODD_LINE, 68,_VIDEO_EVEN_LINE, 69,_VIDEO_ODD_LINE, 70,_VIDEO_EVEN_LINE, 71,_VIDEO_ODD_LINE, 72,_VIDEO_EVEN_LINE, 73,_VIDEO_ODD_LINE

	;//////////////////////////
	;// Lines 74..89 Alternate Video Odd and Video Even Lines
	;//////////////////////////
	.DW	 74,_VIDEO_EVEN_LINE, 75,_VIDEO_ODD_LINE, 76,_VIDEO_EVEN_LINE, 77,_VIDEO_ODD_LINE, 78,_VIDEO_EVEN_LINE, 79,_VIDEO_ODD_LINE, 80,_VIDEO_EVEN_LINE, 81,_VIDEO_ODD_LINE
	.DW	 82,_VIDEO_EVEN_LINE, 83,_VIDEO_ODD_LINE, 84,_VIDEO_EVEN_LINE, 85,_VIDEO_ODD_LINE, 86,_VIDEO_EVEN_LINE, 87,_VIDEO_ODD_LINE, 88,_VIDEO_EVEN_LINE, 89,_VIDEO_ODD_LINE

	;//////////////////////////
	;// Lines 90..105 Alternate Video Odd and Video Even Lines
	;//////////////////////////
	.DW	 90,_VIDEO_EVEN_LINE, 91,_VIDEO_ODD_LINE, 92,_VIDEO_EVEN_LINE, 93,_VIDEO_ODD_LINE, 94,_VIDEO_EVEN_LINE, 95,_VIDEO_ODD_LINE, 96,_VIDEO_EVEN_LINE, 97,_VIDEO_ODD_LINE
	.DW	 98,_VIDEO_EVEN_LINE, 99,_VIDEO_ODD_LINE,100,_VIDEO_EVEN_LINE,101,_VIDEO_ODD_LINE,102,_VIDEO_EVEN_LINE,103,_VIDEO_ODD_LINE,104,_VIDEO_EVEN_LINE,105,_VIDEO_ODD_LINE

	;//////////////////////////
	;// Lines 106..121 Alternate Video Odd and Video Even Lines
	;//////////////////////////
	.DW	106,_VIDEO_EVEN_LINE,107,_VIDEO_ODD_LINE,108,_VIDEO_EVEN_LINE,109,_VIDEO_ODD_LINE,110,_VIDEO_EVEN_LINE,111,_VIDEO_ODD_LINE,112,_VIDEO_EVEN_LINE,113,_VIDEO_ODD_LINE
	.DW	114,_VIDEO_EVEN_LINE,115,_VIDEO_ODD_LINE,116,_VIDEO_EVEN_LINE,117,_VIDEO_ODD_LINE,118,_VIDEO_EVEN_LINE,119,_VIDEO_ODD_LINE,120,_VIDEO_EVEN_LINE,121,_VIDEO_ODD_LINE

	;//////////////////////////
	;// Lines 122..137 Alternate Video Odd and Video Even Lines
	;//////////////////////////
	.DW	122,_VIDEO_EVEN_LINE,123,_VIDEO_ODD_LINE,124,_VIDEO_EVEN_LINE,125,_VIDEO_ODD_LINE,126,_VIDEO_EVEN_LINE,127,_VIDEO_ODD_LINE,128,_VIDEO_EVEN_LINE,129,_VIDEO_ODD_LINE
	.DW	130,_VIDEO_EVEN_LINE,131,_VIDEO_ODD_LINE,132,_VIDEO_EVEN_LINE,133,_VIDEO_ODD_LINE,134,_VIDEO_EVEN_LINE,135,_VIDEO_ODD_LINE,136,_VIDEO_EVEN_LINE,137,_VIDEO_ODD_LINE

	;//////////////////////////
	;// Lines 138..153 Alternate Video Odd and Video Even Lines
	;//////////////////////////
	.DW	138,_VIDEO_EVEN_LINE,139,_VIDEO_ODD_LINE,140,_VIDEO_EVEN_LINE,141,_VIDEO_ODD_LINE,142,_VIDEO_EVEN_LINE,143,_VIDEO_ODD_LINE,144,_VIDEO_EVEN_LINE,145,_VIDEO_ODD_LINE
	.DW	146,_VIDEO_EVEN_LINE,147,_VIDEO_ODD_LINE,148,_VIDEO_EVEN_LINE,149,_VIDEO_ODD_LINE,150,_VIDEO_EVEN_LINE,151,_VIDEO_ODD_LINE,152,_VIDEO_EVEN_LINE,153,_VIDEO_ODD_LINE

	;//////////////////////////
	;// Lines 154..169 Alternate Video Odd and Video Even Lines
	;//////////////////////////
	.DW	154,_VIDEO_EVEN_LINE,155,_VIDEO_ODD_LINE,156,_VIDEO_EVEN_LINE,157,_VIDEO_ODD_LINE,158,_VIDEO_EVEN_LINE,159,_VIDEO_ODD_LINE,160,_VIDEO_EVEN_LINE,161,_VIDEO_ODD_LINE
	.DW	162,_VIDEO_EVEN_LINE,163,_VIDEO_ODD_LINE,164,_VIDEO_EVEN_LINE,165,_VIDEO_ODD_LINE,166,_VIDEO_EVEN_LINE,167,_VIDEO_ODD_LINE,168,_VIDEO_EVEN_LINE,169,_VIDEO_ODD_LINE

	;//////////////////////////
	;// Lines 170..185 Alternate Video Odd and Video Even Lines
	;//////////////////////////
	.DW	170,_VIDEO_EVEN_LINE,171,_VIDEO_ODD_LINE,172,_VIDEO_EVEN_LINE,173,_VIDEO_ODD_LINE,174,_VIDEO_EVEN_LINE,175,_VIDEO_ODD_LINE,176,_VIDEO_EVEN_LINE,177,_VIDEO_ODD_LINE
	.DW	178,_VIDEO_EVEN_LINE,179,_VIDEO_ODD_LINE,180,_VIDEO_EVEN_LINE,181,_VIDEO_ODD_LINE,182,_VIDEO_EVEN_LINE,183,_VIDEO_ODD_LINE,184,_VIDEO_EVEN_LINE,185,_VIDEO_ODD_LINE

	;//////////////////////////
	;// Lines 186..201 Alternate Video Odd and Video Even Lines
	;//////////////////////////
	.DW	186,_VIDEO_EVEN_LINE,187,_VIDEO_ODD_LINE,188,_VIDEO_EVEN_LINE,189,_VIDEO_ODD_LINE,190,_VIDEO_EVEN_LINE,191,_VIDEO_ODD_LINE,192,_VIDEO_EVEN_LINE,193,_VIDEO_ODD_LINE
	.DW	194,_VIDEO_EVEN_LINE,195,_VIDEO_ODD_LINE,196,_VIDEO_EVEN_LINE,197,_VIDEO_ODD_LINE,198,_VIDEO_EVEN_LINE,199,_VIDEO_ODD_LINE,200,_VIDEO_EVEN_LINE,201,_VIDEO_ODD_LINE

	;//////////////////////////
	;// Lines 202..217 Alternate Video Odd and Video Even Lines
	;//////////////////////////
	.DW	202,_VIDEO_EVEN_LINE,203,_VIDEO_ODD_LINE,204,_VIDEO_EVEN_LINE,205,_VIDEO_ODD_LINE,206,_VIDEO_EVEN_LINE,207,_VIDEO_ODD_LINE,208,_VIDEO_EVEN_LINE,209,_VIDEO_ODD_LINE
	.DW	210,_VIDEO_EVEN_LINE,211,_VIDEO_ODD_LINE,212,_VIDEO_EVEN_LINE,213,_VIDEO_ODD_LINE,214,_VIDEO_EVEN_LINE,215,_VIDEO_ODD_LINE,216,_VIDEO_EVEN_LINE,217,_VIDEO_ODD_LINE

	;//////////////////////////
	;// Lines 218..233 Alternate Video Odd and Video Even Lines
	;//////////////////////////
	.DW	218,_VIDEO_EVEN_LINE,219,_VIDEO_ODD_LINE,220,_VIDEO_EVEN_LINE,221,_VIDEO_ODD_LINE,222,_VIDEO_EVEN_LINE,223,_VIDEO_ODD_LINE,224,_VIDEO_EVEN_LINE,225,_VIDEO_ODD_LINE
	.DW	226,_VIDEO_EVEN_LINE,227,_VIDEO_ODD_LINE,228,_VIDEO_EVEN_LINE,229,_VIDEO_ODD_LINE,230,_VIDEO_EVEN_LINE,231,_VIDEO_ODD_LINE,232,_VIDEO_EVEN_LINE,233,_VIDEO_ODD_LINE

	;//////////////////////////
	;// Lines 234..249 Alternate Video Odd and Video Even Lines
	;//////////////////////////
	.DW	234,_VIDEO_DIGITIZING	;video digitizing process #################################
	;.DW	234,_VIDEO_EVEN_LINE
	.DW	235,_VIDEO_RASTER_EXIT	;video raster exit
	.DW	236,_VIDEO_BLANK,237,_VIDEO_BLANK,238,_VIDEO_BLANK,239,_VIDEO_BLANK,240,_VIDEO_BLANK,241,_VIDEO_BLANK
	.DW	242,_VIDEO_BLANK,243,_VIDEO_BLANK,244,_VIDEO_BLANK,245,_VIDEO_BLANK,246,_VIDEO_BLANK,247,_VIDEO_BLANK,248,_VIDEO_BLANK,249,_VIDEO_BLANK

	;//////////////////////////
	;// Lines 250..261 Alternate Video Odd and Video Even Lines
	;//////////////////////////
	.DW	250,_VIDEO_BLANK,251,_VIDEO_BLANK,252,_VIDEO_BLANK,253,_VIDEO_BLANK,254,_VIDEO_BLANK,255,_VIDEO_BLANK,256,_VIDEO_BLANK,257,_VIDEO_BLANK
	.DW	258,_VIDEO_BLANK,259,_VIDEO_BLANK,260,_VIDEO_BLANK,261,_VIDEO_BLANK

	;//////////////////////////
	;// Finish Line = 262 if Field = Odd
	;// Finish Line = 263 if Field = Even
	//////////////////////////
	
	.DW	262,_VIDEO_262_LINE_FINISH
	.DW	263,_VIDEO_263_LINE_FINISH

	;/////////////////////////////////////////////////////////
	;//							//
	;//   T A B L E  L I N E S  F O R  P A L  S Y S T E M	//
	;//							//
	;/////////////////////////////////////////////////////////
	_VIDEO_TABLE_COMMANDS_PAL:
	
	.DW	1,_VIDEO_EQUALIZE_IN_PAL;Video Equalizing start pulses
	.DW	2,_VIDEO_EQUALIZE	;Video Normal Equalizing pulses
	.DW	3,_VIDEO_EQUALIZE
	.DW	4,_VIDEO_SYNC_GENLOCK	;Video Vertical Synchonism and GenLock Point
	.DW	5,_VIDEO_SYNC_IN_PAL	;Video Vertical Sync Normal start PAL
	.DW	6,_VIDEO_SYNC
	.DW	7,_VIDEO_EQUALIZE_OUT_PAL ;Video Normal Equalizing pulses stop PAL
	.DW	8,_VIDEO_EQUALIZE
	.DW	9,_VIDEO_EQUALIZE_OUT	;Video Equalizing stop pulses

	;//////////////////////////
	;// Lines 10..25 Blank Lines (Black Level)
	;//////////////////////////
	.DW 	10,_VIDEO_CHECK,11,_VIDEO_BLANK,12,_VIDEO_BLANK,13,_VIDEO_BLANK,14,_VIDEO_BLANK,15,_VIDEO_BLANK,16,_VIDEO_BLANK,17,_VIDEO_BLANK
	.DW 	18,_VIDEO_BLANK,19,_VIDEO_BLANK,20,_VIDEO_BLANK,21,_VIDEO_BLANK,22,_VIDEO_BLANK,23,_VIDEO_BLANK,24,_VIDEO_BLANK,25,_VIDEO_BLANK

	;//////////////////////////
	;// Lines 26..34 Blank Lines (Black Level)
	;//////////////////////////
	.DW 	26,_VIDEO_BLANK,27,_VIDEO_BLANK,28,_VIDEO_BLANK,29,_VIDEO_BLANK,30,_VIDEO_BLANK,31,_VIDEO_BLANK,32,_VIDEO_BLANK,33,_VIDEO_BLANK
	.DW	34,_VIDEO_BLANK,35,_VIDEO_BLANK,36,_VIDEO_BLANK,37,_VIDEO_BLANK,38,_VIDEO_BLANK,39,_VIDEO_BLANK,40,_VIDEO_BLANK,41,_VIDEO_BLANK

	;///////////////////////////
	;// Lines 42..57 Blank Lines (Black Level)
	;//////////////////////////
	.DW	 42,_VIDEO_BLANK, 43,_VIDEO_BLANK, 44,_VIDEO_BLANK, 45,_VIDEO_BLANK,46,_VIDEO_BLANK, 47,_VIDEO_BLANK, 48,_VIDEO_BLANK, 49,_VIDEO_BLANK
	.DW	 50,_VIDEO_BLANK, 51,_VIDEO_BLANK, 52,_VIDEO_BLANK, 53,_VIDEO_BLANK,54,_VIDEO_BLANK, 55,_VIDEO_BLANK, 56,_VIDEO_BLANK, 57,_VIDEO_BLANK

	;//////////////////////////
	;// Lines 58..73 Blank Lines (Black Level)
	;//////////////////////////
	.DW	 58,_VIDEO_BLANK, 59,_VIDEO_BLANK, 60,_VIDEO_BLANK, 61,_VIDEO_BLANK, 62,_VIDEO_BLANK, 63,_VIDEO_BLANK, 64,_VIDEO_BLANK, 65,_VIDEO_BLANK
	.DW	 66,_VIDEO_BLANK, 67,_VIDEO_BLANK, 68,_VIDEO_BLANK, 69,_VIDEO_BLANK, 70,_VIDEO_BLANK, 71,_VIDEO_BLANK, 72,_VIDEO_BLANK
	.DW	 73,_VIDEO_RASTER_ENTER	;video raster start

	;//////////////////////////
	;// Lines 74..89  Alternate Video Odd and Video Even Lines
	;//////////////////////////
	.DW	 74,_VIDEO_EVEN_LINE, 75,_VIDEO_ODD_LINE, 76,_VIDEO_EVEN_LINE, 77,_VIDEO_ODD_LINE, 78,_VIDEO_EVEN_LINE, 79,_VIDEO_ODD_LINE, 80,_VIDEO_EVEN_LINE, 81,_VIDEO_ODD_LINE
	.DW	 82,_VIDEO_EVEN_LINE, 83,_VIDEO_ODD_LINE, 84,_VIDEO_EVEN_LINE, 85,_VIDEO_ODD_LINE, 86,_VIDEO_EVEN_LINE, 87,_VIDEO_ODD_LINE, 88,_VIDEO_EVEN_LINE, 89,_VIDEO_ODD_LINE

	;//////////////////////////
	;// Lines 90..105  Alternate Video Odd and Video Even Lines
	;//////////////////////////
	.DW	 90,_VIDEO_EVEN_LINE, 91,_VIDEO_ODD_LINE, 92,_VIDEO_EVEN_LINE, 93,_VIDEO_ODD_LINE, 94,_VIDEO_EVEN_LINE, 95,_VIDEO_ODD_LINE, 96,_VIDEO_EVEN_LINE, 97,_VIDEO_ODD_LINE
	.DW	 98,_VIDEO_EVEN_LINE, 99,_VIDEO_ODD_LINE,100,_VIDEO_EVEN_LINE,101,_VIDEO_ODD_LINE,102,_VIDEO_EVEN_LINE,103,_VIDEO_ODD_LINE,104,_VIDEO_EVEN_LINE,105,_VIDEO_ODD_LINE

	;//////////////////////////
	;// Lines 106..121 Alternate Video Odd and Video Even Lines
	;//////////////////////////
	.DW	106,_VIDEO_EVEN_LINE,107,_VIDEO_ODD_LINE,108,_VIDEO_EVEN_LINE,109,_VIDEO_ODD_LINE,110,_VIDEO_EVEN_LINE,111,_VIDEO_ODD_LINE,112,_VIDEO_EVEN_LINE,113,_VIDEO_ODD_LINE
	.DW	114,_VIDEO_EVEN_LINE,115,_VIDEO_ODD_LINE,116,_VIDEO_EVEN_LINE,117,_VIDEO_ODD_LINE,118,_VIDEO_EVEN_LINE,119,_VIDEO_ODD_LINE,120,_VIDEO_EVEN_LINE,121,_VIDEO_ODD_LINE

	;//////////////////////////
	;// Lines 122..137 Alternate Video Odd and Video Even Lines
	;//////////////////////////
	.DW	122,_VIDEO_EVEN_LINE,123,_VIDEO_ODD_LINE,124,_VIDEO_EVEN_LINE,125,_VIDEO_ODD_LINE,126,_VIDEO_EVEN_LINE,127,_VIDEO_ODD_LINE,128,_VIDEO_EVEN_LINE,129,_VIDEO_ODD_LINE
	.DW	130,_VIDEO_EVEN_LINE,131,_VIDEO_ODD_LINE,132,_VIDEO_EVEN_LINE,133,_VIDEO_ODD_LINE,134,_VIDEO_EVEN_LINE,135,_VIDEO_ODD_LINE,136,_VIDEO_EVEN_LINE,137,_VIDEO_ODD_LINE

	;//////////////////////////
	;// Lines 138..153 Alternate Video Odd and Video Even Lines
	;//////////////////////////
	.DW	138,_VIDEO_EVEN_LINE,139,_VIDEO_ODD_LINE,140,_VIDEO_EVEN_LINE,141,_VIDEO_ODD_LINE,142,_VIDEO_EVEN_LINE,143,_VIDEO_ODD_LINE,144,_VIDEO_EVEN_LINE,145,_VIDEO_ODD_LINE
	.DW	146,_VIDEO_EVEN_LINE,147,_VIDEO_ODD_LINE,148,_VIDEO_EVEN_LINE,149,_VIDEO_ODD_LINE,150,_VIDEO_EVEN_LINE,151,_VIDEO_ODD_LINE,152,_VIDEO_EVEN_LINE,153,_VIDEO_ODD_LINE

	;//////////////////////////
	;// Lines 154..169 Alternate Video Odd and Video Even Lines
	;//////////////////////////
	.DW	154,_VIDEO_EVEN_LINE,155,_VIDEO_ODD_LINE,156,_VIDEO_EVEN_LINE,157,_VIDEO_ODD_LINE,158,_VIDEO_EVEN_LINE,159,_VIDEO_ODD_LINE,160,_VIDEO_EVEN_LINE,161,_VIDEO_ODD_LINE
	.DW	162,_VIDEO_EVEN_LINE,163,_VIDEO_ODD_LINE,164,_VIDEO_EVEN_LINE,165,_VIDEO_ODD_LINE,166,_VIDEO_EVEN_LINE,167,_VIDEO_ODD_LINE,168,_VIDEO_EVEN_LINE,169,_VIDEO_ODD_LINE

	;//////////////////////////
	;// Lines 170..185 Alternate Video Odd and Video Even Lines
	;//////////////////////////
	.DW	170,_VIDEO_EVEN_LINE,171,_VIDEO_ODD_LINE,172,_VIDEO_EVEN_LINE,173,_VIDEO_ODD_LINE,174,_VIDEO_EVEN_LINE,175,_VIDEO_ODD_LINE,176,_VIDEO_EVEN_LINE,177,_VIDEO_ODD_LINE
	.DW	178,_VIDEO_EVEN_LINE,179,_VIDEO_ODD_LINE,180,_VIDEO_EVEN_LINE,181,_VIDEO_ODD_LINE,182,_VIDEO_EVEN_LINE,183,_VIDEO_ODD_LINE,184,_VIDEO_EVEN_LINE,185,_VIDEO_ODD_LINE

	;//////////////////////////
	;// Lines 186..201 Alternate Video Odd and Video Even Lines
	;//////////////////////////
	.DW	186,_VIDEO_EVEN_LINE,187,_VIDEO_ODD_LINE,188,_VIDEO_EVEN_LINE,189,_VIDEO_ODD_LINE,190,_VIDEO_EVEN_LINE,191,_VIDEO_ODD_LINE,192,_VIDEO_EVEN_LINE,193,_VIDEO_ODD_LINE
	.DW	194,_VIDEO_EVEN_LINE,195,_VIDEO_ODD_LINE,196,_VIDEO_EVEN_LINE,197,_VIDEO_ODD_LINE,198,_VIDEO_EVEN_LINE,199,_VIDEO_ODD_LINE,200,_VIDEO_EVEN_LINE,201,_VIDEO_ODD_LINE

	;//////////////////////////
	;// Lines 202..217 Alternate Video Odd and Video Even Lines
	;//////////////////////////
	.DW	202,_VIDEO_EVEN_LINE,203,_VIDEO_ODD_LINE,204,_VIDEO_EVEN_LINE,205,_VIDEO_ODD_LINE,206,_VIDEO_EVEN_LINE,207,_VIDEO_ODD_LINE,208,_VIDEO_EVEN_LINE,209,_VIDEO_ODD_LINE
	.DW	210,_VIDEO_EVEN_LINE,211,_VIDEO_ODD_LINE,212,_VIDEO_EVEN_LINE,213,_VIDEO_ODD_LINE,214,_VIDEO_EVEN_LINE,215,_VIDEO_ODD_LINE,216,_VIDEO_EVEN_LINE,217,_VIDEO_ODD_LINE

	;//////////////////////////
	;// Lines 218..233 Alternate Video Odd and Video Even Lines
	;//////////////////////////
	.DW	218,_VIDEO_EVEN_LINE,219,_VIDEO_ODD_LINE,220,_VIDEO_EVEN_LINE,221,_VIDEO_ODD_LINE,222,_VIDEO_EVEN_LINE,223,_VIDEO_ODD_LINE,224,_VIDEO_EVEN_LINE,225,_VIDEO_ODD_LINE
	.DW	226,_VIDEO_EVEN_LINE,227,_VIDEO_ODD_LINE,228,_VIDEO_EVEN_LINE,229,_VIDEO_ODD_LINE,230,_VIDEO_EVEN_LINE,231,_VIDEO_ODD_LINE,232,_VIDEO_EVEN_LINE,233,_VIDEO_ODD_LINE

	;//////////////////////////
	;// Lines 234..249 Alternate Video Odd and Video Even Lines
	;//////////////////////////
	.DW	234,_VIDEO_EVEN_LINE,235,_VIDEO_ODD_LINE,236,_VIDEO_EVEN_LINE,237,_VIDEO_ODD_LINE,238,_VIDEO_EVEN_LINE,239,_VIDEO_ODD_LINE,240,_VIDEO_EVEN_LINE,241,_VIDEO_ODD_LINE
	.DW	242,_VIDEO_EVEN_LINE,243,_VIDEO_ODD_LINE,244,_VIDEO_EVEN_LINE,245,_VIDEO_ODD_LINE,246,_VIDEO_EVEN_LINE,247,_VIDEO_ODD_LINE,248,_VIDEO_EVEN_LINE,249,_VIDEO_ODD_LINE

	;//////////////////////////
	;// Lines 250..265 Alternate Video Odd and Video Even Lines
	;//////////////////////////
	.DW	250,_VIDEO_EVEN_LINE,251,_VIDEO_ODD_LINE,252,_VIDEO_EVEN_LINE,253,_VIDEO_ODD_LINE,254,_VIDEO_EVEN_LINE,255,_VIDEO_ODD_LINE,256,_VIDEO_EVEN_LINE,257,_VIDEO_ODD_LINE
	.DW	258,_VIDEO_EVEN_LINE,259,_VIDEO_ODD_LINE,260,_VIDEO_EVEN_LINE,261,_VIDEO_ODD_LINE,262,_VIDEO_EVEN_LINE,263,_VIDEO_ODD_LINE,264,_VIDEO_EVEN_LINE,265,_VIDEO_ODD_LINE

	;//////////////////////////
	;// Lines 266..282 blank lines
	;//////////////////////////
	.DW	266,_VIDEO_DIGITIZING		;digitizing process
	.DW	267,_VIDEO_RASTER_EXIT		;video raster imagem end
	.DW	268,_VIDEO_BLANK,269,_VIDEO_BLANK,270,_VIDEO_BLANK,271,_VIDEO_BLANK,272,_VIDEO_BLANK,273,_VIDEO_BLANK
	.DW	274,_VIDEO_BLANK,275,_VIDEO_BLANK,276,_VIDEO_BLANK,277,_VIDEO_BLANK,278,_VIDEO_BLANK,279,_VIDEO_BLANK,280,_VIDEO_BLANK,281,_VIDEO_BLANK

	;//////////////////////////
	;// Lines 283..298 blank lines
	;//////////////////////////
	.DW	283,_VIDEO_BLANK,284,_VIDEO_BLANK,285,_VIDEO_BLANK,286,_VIDEO_BLANK,287,_VIDEO_BLANK,288,_VIDEO_BLANK,289,_VIDEO_BLANK,290,_VIDEO_BLANK
	.DW	291,_VIDEO_BLANK,292,_VIDEO_BLANK,293,_VIDEO_BLANK,294,_VIDEO_BLANK,295,_VIDEO_BLANK,296,_VIDEO_BLANK,297,_VIDEO_BLANK,298,_VIDEO_BLANK

	;//////////////////////////
	;// Lines 299..298 blank lines
	;//////////////////////////
	.DW	299,_VIDEO_BLANK,300,_VIDEO_BLANK,301,_VIDEO_BLANK,302,_VIDEO_BLANK,303,_VIDEO_BLANK,304,_VIDEO_BLANK,305,_VIDEO_BLANK,306,_VIDEO_BLANK
	.DW	307,_VIDEO_BLANK,308,_VIDEO_BLANK,309,_VIDEO_BLANK,310,_VIDEO_BLANK,311,_VIDEO_BLANK,312,_VIDEO_BLANK,313,_VIDEO_BLANK
	
	;//////////////////////////
	;// Finish Line = 312 if Field = Odd
	;// Finish Line = 313 if Field = Even
	//////////////////////////
	
	.DW	314,_VIDEO_312_LINE_FINISH
	.DW	315,_VIDEO_313_LINE_FINISH

	;>--------------------------------------------------------------<
	;| OBJECT     : VIDEO_OUT					|
	;>--------------------------------------------------------------<
	;| FUNCTION   : process VIDEO interrupt to perform a composite	|
	;|		video output following NTSC M standard		|
	;>--------------------------------------------------------------<
	;| INPUT      :	None						|
	;| OUTPUT     :	None						|
	;| DESTROYED  :	None						|
	;| TIME	      :	----						|
	;>--------------------------------------------------------------<
	;| OBSERVATION: ---						|
	;+--------------------------------------------------------------+-------------------------------------------------------------------------------\
	;|																		|
	
	_VIDEO_OUT_PROCESS:
		push	Acc					;save Acc
		push	Temp
		in	Acc,SREG				;save SREG
		pushaw						;save useds
		pushawt
		pushw	X
		pushw	Y
		pushw	Z					;from vector interrupt entry point until here
								;code take 29~32 clocks T= 1,626 us	

	;/--------------------------------------------------------------\
	;| PUMP COMMAND POINTER TO GET COMMAND ADDRESS AND JUMP TO IT	|
	;| THIS TAKE 24 CLOCKS T=1,5 us					|
	;\--------------------------------------------------------------/

		ldsw	Z,_VIDEO_OUT_CMD_POINTER		;get pointer of line commands
		lpm	YL,Z+					;Y=Line Number
		lpm	YH,Z+
		lpm	Acc,Z+					;AccH:Acc=command address
		lpm	AccH,Z+
		stsw	_VIDEO_OUT_CMD_POINTER,Z		;store back pointer
		movw	ZL,Acc					;Z--> command address
		ijmp						;jump to routine
								;from vector interrupt entry point until here

								;code take 53~56 clocks T= 1,626 us

	;////////////////////////////////////////////////////////////////
	;//
	;// VIDEO RASTER SET ENTER STATE
	;//
	;////////////////////////////////////////////////////////////////
	_VIDEO_RASTER_ENTER:
		ldsw	Z,_VIDEO_OUT_H_SYNC_ADDR		;get H sync routine address
		icall						;call
		ldsw	Z,_VIDEO_OUT_VIDEO_BLANK_ADDR		;get Video Blank routine address
		icall						;call
		ldi	Acc,_ON					;set in video raster area
		sts	_VIDEO_RASTER_AREA,Acc
		rjmp	_VIDEO_OUT_PROCESS_EXIT			;exit
	;////////////////////////////////////////////////////////////////
	;//
	;// VIDEO RASTER SET EXIT STATE
	;//
	;////////////////////////////////////////////////////////////////
	_VIDEO_RASTER_EXIT:
		ldsw	Z,_VIDEO_OUT_H_SYNC_ADDR		;get H sync routine address
		icall						;call
		ldsw	Z,_VIDEO_OUT_VIDEO_BLANK_ADDR		;get Video Blank routine address
		icall						;call
		ldi	Acc,_OFF				;set out video raster area
		sts	_VIDEO_RASTER_AREA,Acc
		ldi	Acc,0
		sts	_VIDEO_DIGITIZING_TOP_FLAG,Acc		;VIDEO TOP_FLAG=0
		rjmp	_VIDEO_OUT_PROCESS_EXIT			;exit		
	;////////////////////////////////////////////////////////////////
	;//
	;// VIDEO CHECK IF EXTENAL PRESENT 
	;//
	;////////////////////////////////////////////////////////////////
	_VIDEO_CHECK:
		ldsw	Z,_VIDEO_OUT_H_SYNC_ADDR		;get H sync routine address
		icall						;call
		lds	AccH,_VIDEO_SYNC_EXTERNAL_LAST		;get last sync field value
		in	Acc,_VIDEO_SYNC_PORT_INPUT		;read external sync 
		andi	Acc,(1<<_VIDEO_SYNC_FIELD_BIT)		;see transiction of field
		cp	Acc,AccH				;has transiction ?
		breq	_VIDEO_CHECK_10				;no, branch
		sts	_VIDEO_SYNC_EXTERNAL_LAST,Acc		;else update last value of field
		lds	Acc,_VIDEO_SYNC_EXTERNAL_COUNT		;pump sync count to up
		subi	Acc,-2
		cpi	Acc,_VIDEO_SYNC_EXTERNAL_COUNT_MAX	;max reach ?
		brlo	_VIDEO_CHECK_30				;no, branch
		ldi	Acc,_ON					;set external sync present
		sts	_VIDEO_SYNC_EXTERNAL,Acc
		ldi	Acc,_VIDEO_SYNC_EXTERNAL_COUNT_MAX	;else set to max
		rjmp	_VIDEO_CHECK_30				;exit
	_VIDEO_CHECK_10:
		lds	Acc,_VIDEO_SYNC_EXTERNAL_COUNT		;pump sync count to down
		tst	Acc					;zero ?
		breq	_VIDEO_CHECK_20				;yes, branch
		dec	Acc					;pump down
		rjmp	_VIDEO_CHECK_30
	_VIDEO_CHECK_20:
		ldi	Acc,_OFF				;set external sync not present
		sts	_VIDEO_SYNC_EXTERNAL,Acc
		rjmp	_VIDEO_CHECK_40
	_VIDEO_CHECK_30:	
		sts	_VIDEO_SYNC_EXTERNAL_COUNT,Acc		;store back
		;///////////////////////////////////////////////
		;// CHANGE SYNCRONISM TYPE ACCORDING EXTERNAL
		;// SYNC PRESENT OR NOT AND SCREEN MODE IS GENLOCKED
		;///////////////////////////////////////////////
	_VIDEO_CHECK_40:
		lds	AccH,_VIDEO_SYNC_EXTERNAL_CHANGE	;see if has external video change(present or not)
		lds	Acc,_VIDEO_SYNC_EXTERNAL		;get actual external video state
		cp	Acc,AccH				;different ?
		lbreq	_VIDEO_OUT_PROCESS_EXIT			;no, exit
		sts	_VIDEO_SYNC_EXTERNAL_CHANGE,Acc		;update this change 
		mov	Temp,Acc				;save this change in TEMP too
		lds	Acc,_VIDEO_OUT_MODE			;get video mode
		;///////////////////////////////////////////////
		;// MODE 128X96X2G
		;///////////////////////////////////////////////
		cpi	Acc,_VIDEO_MODE_128x96x2g		;genlock mode ?
		brne	_VIDEO_CHECK_70				;yes, branch 
		cpi	Temp,_ON				;external sync present ?
		brne	_VIDEO_CHECK_60				;no, branch
		lds	Acc,_VIDEO_OUT_MODE			;save actual mode
		push	Acc
		ldi	Acc,_VIDEO_MODE_128x96x2g		;set with genlock
		call	_VIDEO_OUT_SET_MODE_COLD		;set mode cold mode
		pop	Acc					;restore mode
		sts	_VIDEO_OUT_MODE,Acc
		rjmp	_VIDEO_OUT_PROCESS_EXIT
	_VIDEO_CHECK_60:
		lds	Acc,_VIDEO_OUT_MODE			;save actual mode
		push	Acc
		ldi	Acc,_VIDEO_MODE_128x96x2n		;set internal sync
		call	_VIDEO_OUT_SET_MODE_COLD		;set mode cold mode
		pop	Acc					;restore mode
		sts	_VIDEO_OUT_MODE,Acc
		rjmp	_VIDEO_OUT_PROCESS_EXIT
	_VIDEO_CHECK_70:
		;///////////////////////////////////////////////
		;// MODE 128X192X2G
		;///////////////////////////////////////////////
		cpi	Acc,_VIDEO_MODE_128x192x2g		;genlock mode ?
		brne	_VIDEO_CHECK_90				;yes, branch 
		cpi	Temp,_ON				;external sync present ?
		brne	_VIDEO_CHECK_80				;no, branch
		lds	Acc,_VIDEO_OUT_MODE			;save actual mode
		push	Acc
		ldi	Acc,_VIDEO_MODE_128x192x2g		;set with genlock
		call	_VIDEO_OUT_SET_MODE_COLD		;set mode mode
		pop	Acc					;restore mode
		sts	_VIDEO_OUT_MODE,Acc
		rjmp	_VIDEO_OUT_PROCESS_EXIT
	_VIDEO_CHECK_80:
		lds	Acc,_VIDEO_OUT_MODE			;save actual mode
		push	Acc
		ldi	Acc,_VIDEO_MODE_128x192x2n		;set internal sync
		call	_VIDEO_OUT_SET_MODE_COLD		;set mode cold mode
		pop	Acc					;restore mode
		sts	_VIDEO_OUT_MODE,Acc
	_VIDEO_CHECK_90:
		rjmp	_VIDEO_OUT_PROCESS_EXIT

	;////////////////////////////////////////////////////////////////
	;//
	;// VIDEO EQUALIZING PULSES INPUT ROUTINE PROCESS ( FOR PAL )
	;//
	;////////////////////////////////////////////////////////////////
	_VIDEO_EQUALIZE_IN_PAL:
		call	_VIDEO_OUT_EQUALIZE_PULSE_PAL_IN	;only one pulse
		ldiaw	_VIDEO_OUT_H_TIME_HALF_PAL+100		;program to generate h/2 time+adjust
		out	TCNT1H,AccH
		out	TCNT1L,Acc
		rjmp	_VIDEO_EQUALIZE_IN_10			;do the same as NTSC
	;////////////////////////////////////////////////////////////////
	;//
	;// VIDEO EQUALIZING PULSES INPUT ROUTINE PROCESS
	;//
	;////////////////////////////////////////////////////////////////
	_VIDEO_EQUALIZE_IN:
		call	_VIDEO_OUT_EQUALIZE_PULSE		;make equalizing pulse
		;////////////////////////////////////////////////
		;// SWAP FIELD
		;////////////////////////////////////////////////
	_VIDEO_EQUALIZE_IN_10:
		lds	Acc,_VIDEO_OUT_FIELD			;swap field
		cpi	Acc,_ODD				;odd ?
		brne	_VIDEO_EQUALIZE_IN_20			;no, branch
		ldi	Acc,_EVEN				;else set even
		rjmp	_VIDEO_EQUALIZE_IN_30
	_VIDEO_EQUALIZE_IN_20:
		ldi	Acc,_ODD				;assume odd
	_VIDEO_EQUALIZE_IN_30:
		sts	_VIDEO_OUT_FIELD,Acc			;update
		;////////////////////////////////////////////////
		;// PUMP CPU LED
		;////////////////////////////////////////////////
		lds	Acc,_VIDEO_OUT_CPU_CT			;blink cpu led
		inc	Acc
		cpi	Acc,_VIDEO_OUT_CPU_LED_CT_MAX		;time to change?
		brlo	_VIDEO_EQUALIZE_IN_40			;no, branch
		lds	Acc,_CPULED_PORT_OUTPUT
		ldi	AccH,(1<<_CPULED_LED_BIT)
		eor	Acc,AccH
		sts	_CPULED_PORT_OUTPUT,Acc
		clr	Acc
	_VIDEO_EQUALIZE_IN_40:
		sts	_VIDEO_OUT_CPU_CT,Acc
		;////////////////////////////////////////////////
		;// RESET VIDEO POINTER FOR INPUT AND OUTPUT PIXELS
		;////////////////////////////////////////////////
		ldiw	Z,_VIDEO_OUT_BUFFER			;initialize pixel pointer
		stsw	_VIDEO_OUT_PIXEL_POINTER,Z
		ldiw	Z,_VIDEO_OUT_BUFFER_DIG_NEW		;initialize pixel pointer input
		stsw	_VIDEO_OUT_PIXEL_POINTER_INPUT,Z
		rjmp	_VIDEO_OUT_PROCESS_EXIT

	;////////////////////////////////////////////////////////////////
	;//
	;// VIDEO EQULIZING PULSES ROUTINE PROCESS
	;//
	;////////////////////////////////////////////////////////////////
	_VIDEO_EQUALIZE:
		call 	_VIDEO_OUT_EQUALIZE_PULSE			;make equalizing pulse
		rjmp	_VIDEO_OUT_PROCESS_EXIT
	;////////////////////////////////////////////////////////////////
	;//
	;// VIDEO SYNC GENLOCK ROUTINE PROCESS
	;//
	;////////////////////////////////////////////////////////////////
	_VIDEO_SYNC_GENLOCK:
		ldsw	Z,_VIDEO_OUT_V_SYNC_ADDR		;get Vertical sync Address
		icall						;call
		rjmp	_VIDEO_OUT_PROCESS_EXIT			;exit routine
	;////////////////////////////////////////////////////////////////
	;//
	;// VIDEO VERTICAL SYNCHRONISM ROUTINE PROCESS
	;//
	;////////////////////////////////////////////////////////////////
	_VIDEO_SYNC:
		call 	_VIDEO_OUT_V_SYNC				;make v sync
		rjmp	_VIDEO_OUT_PROCESS_EXIT
	;////////////////////////////////////////////////////////////////
	;//
	;// VIDEO VERTICAL SYNCHRONISM ROUTINE PROCESS PAL
	;//
	;////////////////////////////////////////////////////////////////
	_VIDEO_SYNC_IN_PAL:
		call _VIDEO_OUT_V_SYNC_PAL_IN			;make v sync
		ldiaw	_VIDEO_OUT_H_TIME_PAL-50		;program to generate h-4.7us time+adjust
		out	TCNT1H,AccH
		out	TCNT1L,Acc
		rjmp	_VIDEO_OUT_PROCESS_EXIT
	;////////////////////////////////////////////////////////////////
	;//
	;// VIDEO EQUALIZING PULSES OUTPUT ROUTINE PROCESS ( FOR PAL )
	;//
	;////////////////////////////////////////////////////////////////
	_VIDEO_EQUALIZE_OUT_PAL:
		call	_VIDEO_OUT_EQUALIZE_PULSE_PAL_IN	;only one pulse
		ldiaw	_VIDEO_OUT_H_TIME_HALF_PAL+100		;program to generate h/2 time+adjust
		out	TCNT1H,AccH
		out	TCNT1L,Acc
		rjmp	_VIDEO_OUT_PROCESS_EXIT
	;////////////////////////////////////////////////////////////////
	;//
	;// VIDEO EQUALIZING PULSES OUTPUT ROUTINE PROCESS
	;//
	;////////////////////////////////////////////////////////////////
	_VIDEO_EQUALIZE_OUT:
		call _VIDEO_OUT_EQUALIZE_PULSE			;make equalizing pulse
		ldiawt	-32					;assume litte adjust when screen genlocked
								;this adjust in needed to put next horizontal
								;sync in middle to get sync correctly
		lds	Acc,_VIDEO_OUT_MODE			;get mode
		cpi	Acc,_VIDEO_MODE_128x96x2g		;genlock mode 1?
		breq	_VIDEO_EQUALIZE_OUT_10			;yes, branch
		cpi	Acc,_VIDEO_MODE_128x192x2g		;genlock mode 2?
		breq	_VIDEO_EQUALIZE_OUT_10			;yes, branch
		cpi	Acc,_VIDEO_MODE_24X24X16d		;genlock mode 6?
		breq	_VIDEO_EQUALIZE_OUT_10			;yes, branch
		ldiawt	0					;little time adjust when screen genlock
		rjmp	_VIDEO_EQUALIZE_OUT_20
	_VIDEO_EQUALIZE_OUT_10:
		lds	Acc,_VIDEO_SYNC_EXTERNAL		;external sync present ?
		cpi	Acc,_ON
		breq	_VIDEO_EQUALIZE_OUT_20			;yes, branch
		ldiawt	0					;else no little adjust
	_VIDEO_EQUALIZE_OUT_20:
		lds	Acc,_VIDEO_OUT_FIELD			;Field = odd?
		cpi	Acc,_ODD
		brne	_VIDEO_EQUALIZE_OUT_30			;no, branch
		ldsaw	_VIDEO_OUT_TIME_ADJUST_1		;load time adjust 1
		rjmp	_VIDEO_EQUALIZE_OUT_40
	_VIDEO_EQUALIZE_OUT_30:
		ldsaw	_VIDEO_OUT_TIME_ADJUST_2		;load time adjust 2
	_VIDEO_EQUALIZE_OUT_40:
		;
		;program timer to generate appropriate time
		;
		;the above values load into AccH:Acc is about
		;current TCNT1 count counting from start interrupt 
		;vector routine until exit of _M_VIDEO_EQUALIZING_PULSES
		;plus some adjust
		;
		add	Acc,AccT				;add adjust
		adc	AccH,AccTH
		out	TCNT1H,AccH				;exit according field
		out	TCNT1L,Acc

		rjmp	_VIDEO_OUT_PROCESS_EXIT
	;////////////////////////////////////////////////////////////////
	;//
	;// VIDEO BLANK ROUTINE PROCESS
	;//
	;////////////////////////////////////////////////////////////////
	_VIDEO_BLANK:
		ldsw	Z,_VIDEO_OUT_H_SYNC_ADDR		;get H sync routine address
		icall						;call
		ldsw	Z,_VIDEO_OUT_VIDEO_BLANK_ADDR		;get Video Blank routine address
		icall						;call
		rjmp	_VIDEO_OUT_PROCESS_EXIT			;exit
	;////////////////////////////////////////////////////////////////
	;//
	;// VIDEO ODD LINE ROUTINE PROCESS
	;//
	;////////////////////////////////////////////////////////////////
	_VIDEO_ODD_LINE:
		ldsw	Z,_VIDEO_OUT_H_SYNC_ADDR		;get H sync routine address
		icall						;call
		ldsw	Z,_VIDEO_OUT_VIDEO_ODD_ADDR		;get Video Odd Lines routine address
		icall						;call
		rjmp	_VIDEO_OUT_PROCESS_EXIT
	;////////////////////////////////////////////////////////////////
	;//
	;// VIDEO EVEN LINE ROUTINE PROCESS
	;//
	;////////////////////////////////////////////////////////////////
	_VIDEO_EVEN_LINE:
		ldsw	Z,_VIDEO_OUT_H_SYNC_ADDR		;get H sync routine address
		icall						;call
		ldsw	Z,_VIDEO_OUT_VIDEO_EVEN_ADDR		;get Video Even Lines routine address
		icall						;call
		rjmp	_VIDEO_OUT_PROCESS_EXIT			;exit
	;////////////////////////////////////////////////////////////////
	;//
	;// VIDEO EVEN LINE FINISH PROCEDURES ROUTINE PROCESS
	;// (262 for NTSC)(FULL H LINE)
	;////////////////////////////////////////////////////////////////
	_VIDEO_262_LINE_FINISH:
		ldsw	Z,_VIDEO_OUT_H_SYNC_ADDR		;get H sync routine address
		icall						;call
		lds	Acc,_VIDEO_OUT_FIELD			;Field=odd?
		cpi	Acc,_ODD
		lbreq	_VIDEO_OUT_PROCESS_EXIT			;yes, make sync and exit
		ldsaw	_VIDEO_OUT_TIME_ADJUST_3		;load time adjust 3
		out	TCNT1H,AccH
		out	TCNT1L,Acc
		ldsw	Z,_VIDEO_TABLE_COMMANDS_ADDR		;initialize pointer of commands
		stsw	_VIDEO_OUT_CMD_POINTER,Z
		rjmp	_VIDEO_OUT_PROCESS_EXIT
	;////////////////////////////////////////////////////////////////
	;//
	;// VIDEO EVEN LINE FINISH PROCEDURES ROUTINE PROCESS
	;// (263 for NTSC)(HALF H LINE)
	;////////////////////////////////////////////////////////////////
	_VIDEO_263_LINE_FINISH:
		ldsw	Z,_VIDEO_OUT_H_SYNC_ADDR		;get H sync routine address
		icall						;call
		ldsaw	_VIDEO_OUT_TIME_ADJUST_4		;load time adjust 4
		out	TCNT1H,AccH
		out	TCNT1L,Acc
		ldsw	Z,_VIDEO_TABLE_COMMANDS_ADDR		;initialize pointer of commands
		stsw	_VIDEO_OUT_CMD_POINTER,Z
		rjmp	_VIDEO_OUT_PROCESS_EXIT
	;////////////////////////////////////////////////////////////////
	;//
	;// VIDEO EVEN LINE FINISH PROCEDURES ROUTINE PROCESS
	;// (312 for PAL)(FULL H LINE)
	;////////////////////////////////////////////////////////////////
	_VIDEO_312_LINE_FINISH:		
		ldsw	Z,_VIDEO_OUT_H_SYNC_ADDR		;get H sync routine address
		icall						;call
		rjmp	_VIDEO_OUT_PROCESS_EXIT
	;////////////////////////////////////////////////////////////////
	;//
	;// VIDEO EVEN LINE FINISH PROCEDURES ROUTINE PROCESS
	;// (313 for PAL)(HALF H LINE)
	;////////////////////////////////////////////////////////////////
	_VIDEO_313_LINE_FINISH:
		ldsw	Z,_VIDEO_OUT_H_SYNC_ADDR		;get H sync routine address
		icall						;call
		ldsawt	_VIDEO_OUT_TIME_ADJUST_3		;load time adjust 4
		lds	Acc,_VIDEO_OUT_FIELD			;Field=ODD?
		cpi	Acc,_ODD
		breq	_VIDEO_313_LINE_FINISH_10		;yes, make sync and exit
		ldsawt	_VIDEO_OUT_TIME_ADJUST_4		;load time adjust 4
	_VIDEO_313_LINE_FINISH_10:
		out	TCNT1H,AccTH
		out	TCNT1L,AccT
		ldsw	Z,_VIDEO_TABLE_COMMANDS_ADDR		;initialize pointer of commands
		stsw	_VIDEO_OUT_CMD_POINTER,Z
		rjmp	_VIDEO_OUT_PROCESS_EXIT
	;////////////////////////////////////////////////////////////////
	;//
	;// VIDEO DIGITIZING EVENTS CONTROL 
	;//
	;////////////////////////////////////////////////////////////////
	_VIDEO_DIGITIZING:
		ldsw	Z,_VIDEO_OUT_H_SYNC_ADDR		;get H sync routine address
		icall						;call
		;///////////////////////////////
		;///
		;/// SELECT VIDEO EVENT
		;///
		;///////////////////////////////
		lds	Acc,_VIDEO_DIGITIZING_EVENT			;get digitizing EVENT
		cpi	Acc,_VIDEO_DIGITIZING_EVENT_TO_UP		;EVENT=TO_UP
		breq	_VIDEO_DIGITIZING_PROCESS_TO_UP			;yes, branch
		cpi	Acc,_VIDEO_DIGITIZING_EVENT_ON_TOP		;EVENT=ON_TOP
		breq	_VIDEO_DIGITIZING_PROCESS_ON_TOP		;yes, branch
		cpi	Acc,_VIDEO_DIGITIZING_EVENT_TO_DOWN		;EVENT=TO_DOWN
		breq	_VIDEO_DIGITIZING_PROCESS_TO_DOWN		;yes, branch
		rjmp	_VIDEO_OUT_PROCESS_EXIT
		;///////////////////////////////
		;///
		;/// EVENT=DIGITIZING TO UP
		;///
		;///////////////////////////////
	_VIDEO_DIGITIZING_PROCESS_TO_UP:
		ldsaw	_VIDEO_DIGITIZING_PWM_PREP		;PWM_PREP+=HI_STEP
		lds	AccT,_VIDEO_DIGITIZING_HI_STEP
		add	Acc,AccT
		ldi	AccT,0
		adc	AccH,AccT
		stsaw	_VIDEO_DIGITIZING_PWM_PREP
		lds	AccT,_VIDEO_DIGITIZING_LO_STEP		;da_PWM<-PWM_PREP+LO_STEP
		add	Acc,AccT
		ldi	AccT,0
		adc	AccH,AccT
		_M_VIDEO_SET_RAMP				;set da_PWM
		lds	Acc,_VIDEO_DIGITIZING_TOP_FLAG		;da_PWM reach TOP VIDEO?
		tst	Acc
		brne	_VIDEO_DIGITIZING_PROCESS_TO_UP_10	;no, branch
		ldi	Acc,_VIDEO_DIGITIZING_EVENT_ON_TOP	;EVENT<-ON_TOP
		sts	_VIDEO_DIGITIZING_EVENT,Acc
	_VIDEO_DIGITIZING_PROCESS_TO_UP_10:
		rjmp	_VIDEO_OUT_PROCESS_EXIT
		;///////////////////////////////
		;///
		;/// EVENT=DIGITIZING ON TOP(SET PWM RAMP TO H SYNC POST BASE)
		;///
		;///////////////////////////////
	_VIDEO_DIGITIZING_PROCESS_ON_TOP:
		rcall	_VIDEO_DIGITIZING_UPDATE_STEPS		;COMPUTE NEW STEPS
		ldiaw	_VIDEO_DIGITIZING_PWM_LAST		;RAMP<-BOTTOM
		addiaw	(_VIDEO_COMP_HSYNC_VOLTAGE*_VIDEO_COMP_TOP*2)/(5000*3) ;add hsync_level*2/3
		_M_VIDEO_SET_RAMP
		ldi	Acc,_VIDEO_DIGITIZING_EVENT_TO_DOWN	;EVENT<-TO_DOWN
		sts	_VIDEO_DIGITIZING_EVENT,Acc
		rjmp	_VIDEO_OUT_PROCESS_EXIT
		;///////////////////////////////
		;///
		;/// EVENT=DIGITIZING TO DOWN(ADJUST H SYNC POST BASE)
		;///
		;///////////////////////////////
	_VIDEO_DIGITIZING_PROCESS_TO_DOWN:
		lds	Acc,_VIDEO_DIGITIZING_BOTTOM_FLAG	;get bottom flag
		cpi	Acc,_ON					;bellow bottom ?
		brne	_VIDEO_DIGITIZING_PROCESS_TO_DOWN_40	;no, branch
		ldi	Acc,_VIDEO_DIGITIZING_EVENT_TO_UP	;set EVENT=TO_TOP
		sts	_VIDEO_DIGITIZING_EVENT,Acc
		_M_VIDEO_GET_RAMP				;BOTTOM=RAMP
		stsaw	_VIDEO_DIGITIZING_PWM_LAST
		stsaw	_VIDEO_DIGITIZING_PWM_PREP
		rjmp	_VIDEO_OUT_PROCESS_EXIT
	_VIDEO_DIGITIZING_PROCESS_TO_DOWN_40:
		_M_VIDEO_GET_RAMP				;RAMP=RAMP-STEP  (integer and fractionary parts)
		addiaw	_VIDEO_COMP_MIN_STEP
		cpiaw	(_VIDEO_COMP_TOP*3)/4			;sature if ramp>(max*3/4)
		brlo	_VIDEO_DIGITIZING_PROCESS_TO_DOWN_50	;no, branch
		ldiaw	(_VIDEO_COMP_TOP*3)/4			;else saturate
	_VIDEO_DIGITIZING_PROCESS_TO_DOWN_50:
		_M_VIDEO_SET_RAMP				;set RAMP new value		
		rjmp	_VIDEO_OUT_PROCESS_EXIT
		;///////////////////////////////
		;///
		;/// UPDATE HI_STEP AND LO_STEP
		;///
		;/// HI_STEP<-ABS(PWM-PWM_LAST)/16
		;/// PWM_LAST<-PWM
		;/// IF HI_STEP<=0 HI_STEP<-1
		;/// IF LO_STEP>HI_STEP LO_STEP<-HI_STEP
		;/// LO_STEP+=DIR_STEP
		;/// IF LO_STEP>HI_STEP
		;///	LO_STEP<-HI_STEP
		;///	DIR_STEP=-DIR_STEP
		;/// ELSE
		;///	IF LO_STEP<0
		;///	   LO_STEP<=0
		;///	   DIR_STEP=-DIR_STEP
		;///	ENDIF
		;/// ENDIF
		;///////////////////////////////
	_VIDEO_DIGITIZING_UPDATE_STEPS:
		_M_VIDEO_GET_RAMP				;get da_PWM
		ldsawt	_VIDEO_DIGITIZING_PWM_LAST		;abs(PWM-PWM_LAST)
		sub	Acc,AccT
		sbc	AccH,AccTH
		lsr	AccH					;ABS(PWM-PWM_LAST)/16
		ror	Acc
		lsr	AccH
		ror	Acc
		lsr	AccH
		ror	Acc
		lsr	AccH
		ror	Acc
		cpi	Acc,1					;HI_STEP<1?
		brge	_VIDEO_DIGITIZING_UPDATE_STEPS_20	;yes, branch
		ldi	Acc,1					;else HI_STEP<-1
	_VIDEO_DIGITIZING_UPDATE_STEPS_20:
		sts	_VIDEO_DIGITIZING_HI_STEP,Acc		;HI_STEP=ABS(PWM-PWM_LAST)/16+1
		mov	AccT,Acc				;AccT=HI_STEP
		lds	Acc,_VIDEO_DIGITIZING_LO_STEP		;get LO_STEP
		lds	AccH,_VIDEO_DIGITIZING_DIR_STEP		;get DIR_STEP
		add	Acc,AccH				;LO_STEP+=DIR_STEP
		cp	Acc,AccT				;LO_STEP>HI_STEP?
		brlo	_VIDEO_DIGITIZING_UPDATE_STEPS_30	;no, branch
		sts	_VIDEO_DIGITIZING_LO_STEP,AccT		;LO_STEP<-HI_STEP
		neg	AccH					;DIR_STEP=-DIR_STEP
		sts	_VIDEO_DIGITIZING_DIR_STEP,AccH
		ret
	_VIDEO_DIGITIZING_UPDATE_STEPS_30:
		cpi	Acc,0					;LO_STEP<1?
		brpl	_VIDEO_DIGITIZING_UPDATE_STEPS_40	;no, branch
		sts	_VIDEO_DIGITIZING_LO_STEP,Acc		;LO_STEP<-0
		neg	AccH					;DIR_STEP=-DIR_STEP
		sts	_VIDEO_DIGITIZING_DIR_STEP,AccH
	_VIDEO_DIGITIZING_UPDATE_STEPS_40:
		ret
	;////////////////////////////////////////////////////////////////
	;//
	;// VIDEO PROCESS EXIT
	;//
	;////////////////////////////////////////////////////////////////
	_VIDEO_OUT_PROCESS_EXIT:	
		popw	Z					;time to exit form interrupt routine
		popw	Y					;take 30 clocks T= 1,875 us
		popw	X
		popawt
		popaw						;restore SREG
		out	SREG,Acc
		pop	Temp
		pop	Acc					;restore Acc
		reti						;end process, return from interrupt

	;>--------------------------------------------------------------<
	;| OBJECT     : VIDEO_OUT					|
	;>--------------------------------------------------------------<
	;| FUNCTION   : Set Digitizing Decay value			|
	;>--------------------------------------------------------------<
	;| INPUT      : Acc Decay value					|
	;| OUTPUT     :	None						|
	;| DESTROYED  :	Flags						|
	;| TIME	      :	None						|
	;>--------------------------------------------------------------<
	;| OBSERVATION: ---						|
	;+--------------------------------------------------------------+-------------------------------------------------------------------------------\
	;|
	_VIDEO_DIGITIZING_SET_DECAY:
		sts	_VIDEO_DIGITIZING_DECAY,Acc
		ret
	;>--------------------------------------------------------------<
	;| OBJECT     : VIDEO_OUT					|
	;>--------------------------------------------------------------<
	;| FUNCTION   : Set Digitizing sensibility value		|
	;>--------------------------------------------------------------<
	;| INPUT      : Acc sensibility value				|
	;| OUTPUT     :	None						|
	;| DESTROYED  :	Flags						|
	;| TIME	      :	None						|
	;>--------------------------------------------------------------<
	;| OBSERVATION: ---						|
	;+--------------------------------------------------------------+-------------------------------------------------------------------------------\
	;|
	_VIDEO_DIGITIZING_SET_SENSIBILITY:
		sts	_VIDEO_DIGITIZING_SENSIBILITY,Acc
		ret
	;>--------------------------------------------------------------<
	;| OBJECT     : VIDEO_OUT					|
	;>--------------------------------------------------------------<
	;| FUNCTION   : Get Digitizing sensibility value		|
	;>--------------------------------------------------------------<
	;| INPUT      : None						|
	;| OUTPUT     :	Acc Sensibility value				|
	;| DESTROYED  :	Flags						|
	;| TIME	      :	None						|
	;>--------------------------------------------------------------<
	;| OBSERVATION: ---						|
	;+--------------------------------------------------------------+-------------------------------------------------------------------------------\
	;|
	_VIDEO_DIGITIZING_GET_SENSIBILITY:
		lds	Acc,_VIDEO_DIGITIZING_SENSIBILITY
		ret

	;>--------------------------------------------------------------<
	;| OBJECT     : VIDEO_OUT					|
	;>--------------------------------------------------------------<
	;| FUNCTION   : Get external synchronism video state		|
	;>--------------------------------------------------------------<
	;| INPUT      : None						|
	;| OUTPUT     :	Acc _ON if external,present			|
	;|		   _OFF if internal,not present			|
	;| DESTROYED  :	None						|
	;| TIME	      :	None						|
	;>--------------------------------------------------------------<
	;| OBSERVATION:	---						|
	;+--------------------------------------------------------------+-------------------------------------------------------------------------------\
	;|																		|	
	_VIDEO_OUT_GET_SYNC_STATE:
		lds	Acc,_VIDEO_SYNC_EXTERNAL
		ret


	;>--------------------------------------------------------------<
	;| OBJECT     : VIDEO_OUT					|
	;>--------------------------------------------------------------<
	;| FUNCTION   : Set video out white level			|
	;>--------------------------------------------------------------<
	;| INPUT      : Acc white level					|
	;| OUTPUT     :	None						|
	;| DESTROYED  :	None						|
	;| TIME	      :	None						|
	;>--------------------------------------------------------------<
	;| OBSERVATION:	if forneced level low black level, black is 	|
	;|		assumed, else if level > max white level 	|
	;|		max white level is assumed			|
	;+--------------------------------------------------------------+-------------------------------------------------------------------------------\
	;|																		|	
	_VIDEO_OUT_SET_WHITE_LEVEL:
		push	Acc
		cpi	Acc,_VIDEO_OUT_LEVEL_BLACK		;level < black level ?
		brsh	_VIDEO_OUT_SET_WHITE_LEVEL_10		;no,branch
		ldi	Acc,_VIDEO_OUT_LEVEL_BLACK		;else set white level=black level
		rjmp	_VIDEO_OUT_SET_WHITE_LEVEL_20
	_VIDEO_OUT_SET_WHITE_LEVEL_10:
		cpi	Acc,_VIDEO_OUT_LEVEL_WHITE_TOP		;level > white top ?
		brlo	_VIDEO_OUT_SET_WHITE_LEVEL_20		;no, branch
		ldi	Acc,_VIDEO_OUT_LEVEL_WHITE_TOP		;else set white leve=white top
	_VIDEO_OUT_SET_WHITE_LEVEL_20:
		sts	_VIDEO_OUT_LEVEL_WHITE,Acc
		pop	Acc
		ret
	;>--------------------------------------------------------------<
	;| OBJECT     : VIDEO_OUT					|
	;>--------------------------------------------------------------<
	;| FUNCTION   : Get video out white level			|
	;>--------------------------------------------------------------<
	;| INPUT      : None						|
	;| OUTPUT     :	Acc white level					|
	;| DESTROYED  :	None						|
	;| TIME	      :	None						|
	;>--------------------------------------------------------------<
	;| OBSERVATION:	---						|
	;+--------------------------------------------------------------+-------------------------------------------------------------------------------\
	;|																		|	
	_VIDEO_OUT_GET_WHITE_LEVEL:
		lds	Acc,_VIDEO_OUT_LEVEL_WHITE		;get white level
		ret

	;>--------------------------------------------------------------<
	;| OBJECT     : VIDEO_OUT					|
	;>--------------------------------------------------------------<
	;| FUNCTION   : Clear screen					|		
	;>--------------------------------------------------------------<
	;| INPUT      : None						|
	;| OUTPUT     :	None						|
	;| DESTROYED  :	None						|
	;| TIME	      :	None						|
	;>--------------------------------------------------------------<
	;| OBSERVATION:	---						|
	;+--------------------------------------------------------------+-------------------------------------------------------------------------------\
	;|																		|	
	_VIDEO_OUT_CLS:
		call	_RASTER_CLEAR
		ret

	;>--------------------------------------------------------------<
	;| OBJECT     : VIDEO_OUT					|
	;>--------------------------------------------------------------<
	;| FUNCTION   : Set pixel					|		
	;>--------------------------------------------------------------<
	;| INPUT      : X,Y coordinates					|
	;|		Acc Color					|
	;| OUTPUT     :	None						|
	;| DESTROYED  :	None						|
	;| TIME	      :	None						|
	;>--------------------------------------------------------------<
	;| OBSERVATION:	---						|
	;+--------------------------------------------------------------+-------------------------------------------------------------------------------\
	;|																		|	
	_DISP_PSET:
	_VIDEO_OUT_SET_PIXEL:
		push	r0
		push	r1
		call	_RASTER_SET_PIXEL
		pop	r1
		pop	r0
		ret
	;>--------------------------------------------------------------<
	;| OBJECT     : VIDEO_OUT					|
	;>--------------------------------------------------------------<
	;| FUNCTION   : Synchronize if vertical sync			|		
	;>--------------------------------------------------------------<
	;| INPUT      : None						|
	;| OUTPUT     :	None						|
	;| DESTROYED  :	None						|
	;| TIME	      :	None						|
	;>--------------------------------------------------------------<
	;| OBSERVATION:	---						|
	;+--------------------------------------------------------------+-------------------------------------------------------------------------------\
	;|								
	_VIDEO_OUT_SYNC_WITH_VERTICAL:
		#ifdef __DEBUG_MODE__
			ret
		#endif
		push	Acc
		in	Acc,SREG
		pushaw
		lds	AccH,_VIDEO_RASTER_AREA			;get video area state
	_VIDEO_OUT_SYNC_WITH_VERTICAL_10:
		lds	Acc,_VIDEO_RASTER_AREA			;again
		cp	Acc,AccH				;video raster area changed?
		breq	_VIDEO_OUT_SYNC_WITH_VERTICAL_10	;no, wait
		mov	AccH,Acc				;actualize 
		cpi	Acc,_OFF				;in vertical sync area?
		brne	_VIDEO_OUT_SYNC_WITH_VERTICAL_10	;wait
		popaw
		out	SREG,Acc
		pop	Acc
		ret
        ;>--------------------------------------------------------------<
	;| OBJECT     : VIDEO_OUT					|
	;>--------------------------------------------------------------<
	;| FUNCTION   : Get Video Width in pixels			|		
	;>--------------------------------------------------------------<
	;| INPUT      : None						|
	;| OUTPUT     :	Acc Video width in pixels       		|
	;| DESTROYED  :	None						|
	;| TIME	      :	None						|
	;>--------------------------------------------------------------<
	;| OBSERVATION:	---						|
	;+--------------------------------------------------------------+-------------------------------------------------------------------------------\
	;|								
        _VIDEO_OUT_GET_WIDTH:
                lds     Acc,_VIDEO_OUT_GRAPH_WIDTH              ;get video width
                ret
        ;>--------------------------------------------------------------<
	;| OBJECT     : VIDEO_OUT					|
	;>--------------------------------------------------------------<
	;| FUNCTION   : Get Video Height in pixels			|		
	;>--------------------------------------------------------------<
	;| INPUT      : None						|
	;| OUTPUT     :	Acc Video height in pixels       		|
	;| DESTROYED  :	None						|
	;| TIME	      :	None						|
	;>--------------------------------------------------------------<
	;| OBSERVATION:	---						|
	;+--------------------------------------------------------------+-------------------------------------------------------------------------------\
	;|								
        _VIDEO_OUT_GET_HEIGHT:
                lds     Acc,_VIDEO_OUT_GRAPH_HEIGHT              ;get video width
                ret