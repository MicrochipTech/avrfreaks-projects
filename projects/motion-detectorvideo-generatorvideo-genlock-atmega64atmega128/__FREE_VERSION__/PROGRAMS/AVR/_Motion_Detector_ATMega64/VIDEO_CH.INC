;+-----------------------------------------------------------------------+
;| ASCII VIDEO CHARACTERS TABLE                                          |
;| CHARACTERS 0..127 NORMAL CHARACTERS TABLE                             |
;| CHARACTERS 128..255 USE CODE PAGE 858(CP 858,IBM 858, OEM 858) IS A   |
;| CODE PAGE TO BE USED UNDER MS-DOS TO WRITE WESTERN EUROPEAN LANGUAGES |
;| WARNING WHEN VIEW THIS FILE UNDER WINDOWS CHARACTERS 128..255 WILL    |
;| APPEAR WRONG                                                          |
;+-----------------------------------------------------------------------+

_VIDEO_OUT_CHARACTERS:

;+-----------------+
;| ASCII(032)=' '  |
;+-----------------+
      .DB 0b00000000,0b00000000
      .DB 0b00000000,0b00000000
      .DB 0b00000000,0b00000000
      .DB 0b00000000,0b00000000
;+-----------------+
;| ASCII(033)='!'  |
;+-----------------+
      .DB 0b00011000,0b00111100
      .DB 0b00111100,0b00011000
      .DB 0b00011000,0b00000000
      .DB 0b00011000,0b00000000
;+-----------------+
;| ASCII(034)='"'  |
;+-----------------+
      .DB 0b01101100,0b00100100
      .DB 0b00100100,0b00000000
      .DB 0b00000000,0b00000000
      .DB 0b00000000,0b00000000
;+-----------------+
;| ASCII(035)='#'  |
;+-----------------+
      .DB 0b01101100,0b01101100
      .DB 0b11111110,0b01101100
      .DB 0b11111110,0b01101100
      .DB 0b01101100,0b00000000
;+-----------------+
;| ASCII(036)='$'  |
;+-----------------+
      .DB 0b00010000,0b01111100
      .DB 0b11010000,0b01111100
      .DB 0b00010110,0b11111100
      .DB 0b00010000,0b00000000
;+-----------------+
;| ASCII(037)='%'  |
;+-----------------+
      .DB 0b00000000,0b01100110
      .DB 0b10101100,0b11011000
      .DB 0b00110110,0b01101010
      .DB 0b11001100,0b00000000
;+-----------------+
;| ASCII(038)='&'  |
;+-----------------+
      .DB 0b00111000,0b01001100
      .DB 0b00111000,0b01111000
      .DB 0b11001110,0b11001100
      .DB 0b01111010,0b00000000
;+-----------------+
;| ASCII(039)='''  |
;+-----------------+
      .DB 0b00110000,0b00010000
      .DB 0b00100000,0b00000000
      .DB 0b00000000,0b00000000
      .DB 0b00000000,0b00000000
;+-----------------+
;| ASCII(040)='('  |
;+-----------------+
      .DB 0b00011000,0b00110000
      .DB 0b01100000,0b01100000
      .DB 0b01100000,0b00110000
      .DB 0b00011000,0b00000000
;+-----------------+
;| ASCII(041)=')'  |
;+-----------------+
      .DB 0b01100000,0b00110000
      .DB 0b00011000,0b00011000
      .DB 0b00011000,0b00110000
      .DB 0b01100000,0b00000000
;+-----------------+
;| ASCII(042)='*'  |
;+-----------------+
      .DB 0b00000000,0b01100110
      .DB 0b00111100,0b11111111
      .DB 0b00111100,0b01100110
      .DB 0b00000000,0b00000000
;+-----------------+
;| ASCII(043)='+'  |
;+-----------------+
      .DB 0b00000000,0b00110000
      .DB 0b00110000,0b11111100
      .DB 0b00110000,0b00110000
      .DB 0b00000000,0b00000000
;+-----------------+
;| ASCII(044)=','  |
;+-----------------+
      .DB 0b00000000,0b00000000
      .DB 0b00000000,0b00000000
      .DB 0b00000000,0b00110000
      .DB 0b00010000,0b00100000
;+-----------------+
;| ASCII(045)='-'  |
;+-----------------+
      .DB 0b00000000,0b00000000
      .DB 0b00000000,0b11111100
      .DB 0b00000000,0b00000000
      .DB 0b00000000,0b00000000
;+-----------------+
;| ASCII(046)='.'  |
;+-----------------+
      .DB 0b00000000,0b00000000
      .DB 0b00000000,0b00000000
      .DB 0b00000000,0b00000000
      .DB 0b00110000,0b00000000
;+-----------------+
;| ASCII(047)='/'  |
;+-----------------+
      .DB 0b00000010,0b00000110
      .DB 0b00001100,0b00011000
      .DB 0b00110000,0b01100000
      .DB 0b11000000,0b00000000
;+-----------------+
;| ASCII(048)='0'  |
;+-----------------+
      .DB 0b01111100,0b11001110
      .DB 0b11011110,0b11110110
      .DB 0b11100110,0b11100110
      .DB 0b01111100,0b00000000
;+-----------------+
;| ASCII(049)='1'  |
;+-----------------+
      .DB 0b00011000,0b00111000
      .DB 0b01111000,0b00011000
      .DB 0b00011000,0b00011000
      .DB 0b01111110,0b00000000
;+-----------------+
;| ASCII(050)='2'  |
;+-----------------+
      .DB 0b01111100,0b11000110
      .DB 0b00000110,0b00011100
      .DB 0b01110000,0b11000110
      .DB 0b11111110,0b00000000
;+-----------------+
;| ASCII(051)='3'  |
;+-----------------+
      .DB 0b01111100,0b11000110
      .DB 0b00000110,0b00111100
      .DB 0b00000110,0b11000110
      .DB 0b01111100,0b00000000
;+-----------------+
;| ASCII(052)='4'  |
;+-----------------+
      .DB 0b00011100,0b00111100
      .DB 0b01101100,0b11001100
      .DB 0b11111110,0b00001100
      .DB 0b00011110,0b00000000
;+-----------------+
;| ASCII(053)='5'  |
;+-----------------+
      .DB 0b11111110,0b11000000
      .DB 0b11111100,0b00000110
      .DB 0b00000110,0b11000110
      .DB 0b01111100,0b00000000
;+-----------------+
;| ASCII(054)='6'  |
;+-----------------+
      .DB 0b01111100,0b11000110
      .DB 0b11000000,0b11111100
      .DB 0b11000110,0b11000110
      .DB 0b01111100,0b00000000
;+-----------------+
;| ASCII(055)='7'  |
;+-----------------+
      .DB 0b11111110,0b11000110
      .DB 0b00001100,0b00011000
      .DB 0b00110000,0b00110000
      .DB 0b00110000,0b00000000
;+-----------------+
;| ASCII(056)='8'  |
;+-----------------+
      .DB 0b01111100,0b11000110
      .DB 0b11000110,0b01111100
      .DB 0b11000110,0b11000110
      .DB 0b01111100,0b00000000
;+-----------------+
;| ASCII(057)='9'  |
;+-----------------+
      .DB 0b01111100,0b11000110
      .DB 0b11000110,0b01111110
      .DB 0b00000110,0b11000110
      .DB 0b01111100,0b00000000
;+-----------------+
;| ASCII(058)=':'  |
;+-----------------+
      .DB 0b00000000,0b00110000
      .DB 0b00000000,0b00000000
      .DB 0b00000000,0b00110000
      .DB 0b00000000,0b00000000
;+-----------------+
;| ASCII(059)=';'  |
;+-----------------+
      .DB 0b00000000,0b00110000
      .DB 0b00000000,0b00000000
      .DB 0b00000000,0b00110000
      .DB 0b00010000,0b00100000
;+-----------------+
;| ASCII(060)='<'  |
;+-----------------+
      .DB 0b00001100,0b00011000
      .DB 0b00110000,0b01100000
      .DB 0b00110000,0b00011000
      .DB 0b00001100,0b00000000
;+-----------------+
;| ASCII(061)='='  |
;+-----------------+
      .DB 0b00000000,0b00000000
      .DB 0b01111110,0b00000000
      .DB 0b00000000,0b01111110
      .DB 0b00000000,0b00000000
;+-----------------+
;| ASCII(062)='>'  |
;+-----------------+
      .DB 0b01100000,0b00110000
      .DB 0b00011000,0b00001100
      .DB 0b00011000,0b00110000
      .DB 0b01100000,0b00000000
;+-----------------+
;| ASCII(063)='?'  |
;+-----------------+
      .DB 0b01111000,0b11001100
      .DB 0b00001100,0b00011000
      .DB 0b00110000,0b00000000
      .DB 0b00110000,0b00000000
;+-----------------+
;| ASCII(064)='@'  |
;+-----------------+
      .DB 0b01111100,0b10000010
      .DB 0b10011110,0b10100110
      .DB 0b10011110,0b10000000
      .DB 0b01111100,0b00000000
;+-----------------+
;| ASCII(065)='A'  |
;+-----------------+
      .DB 0b01111100,0b11000110
      .DB 0b11000110,0b11111110
      .DB 0b11000110,0b11000110
      .DB 0b11000110,0b00000000
;+-----------------+
;| ASCII(066)='B'  |
;+-----------------+
      .DB 0b11111100,0b01100110
      .DB 0b01100110,0b01111100
      .DB 0b01100110,0b01100110
      .DB 0b11111100,0b00000000
;+-----------------+
;| ASCII(067)='C'  |
;+-----------------+
      .DB 0b01111100,0b11000110
      .DB 0b11000000,0b11000000
      .DB 0b11000000,0b11000110
      .DB 0b01111100,0b00000000
;+-----------------+
;| ASCII(068)='D'  |
;+-----------------+
      .DB 0b11111100,0b01100110
      .DB 0b01100110,0b01100110
      .DB 0b01100110,0b01100110
      .DB 0b11111100,0b00000000
;+-----------------+
;| ASCII(069)='E'  |
;+-----------------+
      .DB 0b11111110,0b01100010
      .DB 0b01101000,0b01111000
      .DB 0b01101000,0b01100010
      .DB 0b11111110,0b00000000
;+-----------------+
;| ASCII(070)='F'  |
;+-----------------+
      .DB 0b11111110,0b01100010
      .DB 0b01101000,0b01111000
      .DB 0b01101000,0b01100000
      .DB 0b11110000,0b00000000
;+-----------------+
;| ASCII(071)='G'  |
;+-----------------+
      .DB 0b01111100,0b11000110
      .DB 0b11000110,0b11000000
      .DB 0b11001110,0b11000110
      .DB 0b01111110,0b00000000
;+-----------------+
;| ASCII(072)='H'  |
;+-----------------+
      .DB 0b11000110,0b11000110
      .DB 0b11000110,0b11111110
      .DB 0b11000110,0b11000110
      .DB 0b11000110,0b00000000
;+-----------------+
;| ASCII(073)='I'  |
;+-----------------+
      .DB 0b00111100,0b00011000
      .DB 0b00011000,0b00011000
      .DB 0b00011000,0b00011000
      .DB 0b00111100,0b00000000
;+-----------------+
;| ASCII(074)='J'  |
;+-----------------+
      .DB 0b00011110,0b00001100
      .DB 0b00001100,0b00001100
      .DB 0b11001100,0b11001100
      .DB 0b01111000,0b00000000
;+-----------------+
;| ASCII(075)='K'  |
;+-----------------+
      .DB 0b11100110,0b01100110
      .DB 0b01101100,0b01111000
      .DB 0b01101100,0b01100110
      .DB 0b11100110,0b00000000
;+-----------------+
;| ASCII(076)='L'  |
;+-----------------+
      .DB 0b11110000,0b01100000
      .DB 0b01100000,0b01100000
      .DB 0b01100010,0b01100110
      .DB 0b11111110,0b00000000
;+-----------------+
;| ASCII(077)='M'  |
;+-----------------+
      .DB 0b10000010,0b11000110
      .DB 0b11101110,0b11111110
      .DB 0b11010110,0b11000110
      .DB 0b11000110,0b00000000
;+-----------------+
;| ASCII(078)='N'  |
;+-----------------+
      .DB 0b11000110,0b11100110
      .DB 0b11110110,0b11011110
      .DB 0b11001110,0b11000110
      .DB 0b11000110,0b00000000
;+-----------------+
;| ASCII(079)='O'  |
;+-----------------+
      .DB 0b01111100,0b11000110
      .DB 0b11000110,0b11000110
      .DB 0b11000110,0b11000110
      .DB 0b01111100,0b00000000
;+-----------------+
;| ASCII(080)='P'  |
;+-----------------+
      .DB 0b11111100,0b01100110
      .DB 0b01100110,0b01111100
      .DB 0b01100000,0b01100000
      .DB 0b11110000,0b00000000
;+-----------------+
;| ASCII(081)='Q'  |
;+-----------------+
      .DB 0b01111100,0b11000110
      .DB 0b11000110,0b11000110
      .DB 0b11010110,0b11011110
      .DB 0b01111100,0b00000110
;+-----------------+
;| ASCII(082)='R'  |
;+-----------------+
      .DB 0b11111100,0b01100110
      .DB 0b01100110,0b01111100
      .DB 0b01100110,0b01100110
      .DB 0b11100110,0b00000000
;+-----------------+
;| ASCII(083)='S'  |
;+-----------------+
      .DB 0b01111100,0b11000110
      .DB 0b11000000,0b01111100
      .DB 0b00000110,0b11000110
      .DB 0b01111100,0b00000000
;+-----------------+
;| ASCII(084)='T'  |
;+-----------------+
      .DB 0b01111110,0b01011010
      .DB 0b01011010,0b00011000
      .DB 0b00011000,0b00011000
      .DB 0b00111100,0b00000000
;+-----------------+
;| ASCII(085)='U'  |
;+-----------------+
      .DB 0b11000110,0b11000110
      .DB 0b11000110,0b11000110
      .DB 0b11000110,0b11000110
      .DB 0b01111100,0b00000000
;+-----------------+
;| ASCII(086)='V'  |
;+-----------------+
      .DB 0b11000110,0b11000110
      .DB 0b11000110,0b11000110
      .DB 0b01101100,0b00111000
      .DB 0b00010000,0b00000000
;+-----------------+
;| ASCII(087)='W'  |
;+-----------------+
      .DB 0b11000110,0b11000110
      .DB 0b11010110,0b11111110
      .DB 0b11101110,0b11000110
      .DB 0b10000010,0b00000000
;+-----------------+
;| ASCII(088)='X'  |
;+-----------------+
      .DB 0b11000110,0b01101100
      .DB 0b00111000,0b00111000
      .DB 0b00111000,0b01101100
      .DB 0b11000110,0b00000000
;+-----------------+
;| ASCII(089)='Y'  |
;+-----------------+
      .DB 0b01100110,0b01100110
      .DB 0b01100110,0b00111100
      .DB 0b00011000,0b00011000
      .DB 0b00111100,0b00000000
;+-----------------+
;| ASCII(090)='Z'  |
;+-----------------+
      .DB 0b11111110,0b11000110
      .DB 0b10001100,0b00011000
      .DB 0b00110010,0b01100110
      .DB 0b11111110,0b00000000
;+-----------------+
;| ASCII(091)='['  |
;+-----------------+
      .DB 0b01111000,0b01100000
      .DB 0b01100000,0b01100000
      .DB 0b01100000,0b01100000
      .DB 0b01111000,0b00000000
;+-----------------+
;| ASCII(092)='\'  |
;+-----------------+
      .DB 0b11000000,0b01100000
      .DB 0b00110000,0b00011000
      .DB 0b00001100,0b00000110
      .DB 0b00000010,0b00000000
;+-----------------+
;| ASCII(093)=']'  |
;+-----------------+
      .DB 0b01111000,0b00011000
      .DB 0b00011000,0b00011000
      .DB 0b00011000,0b00011000
      .DB 0b01111000,0b00000000
;+-----------------+
;| ASCII(094)='^'  |
;+-----------------+
      .DB 0b00010000,0b00111000
      .DB 0b01101100,0b11000110
      .DB 0b00000000,0b00000000
      .DB 0b00000000,0b00000000
;+-----------------+
;| ASCII(095)='_'  |
;+-----------------+
      .DB 0b00000000,0b00000000
      .DB 0b00000000,0b00000000
      .DB 0b00000000,0b00000000
      .DB 0b00000000,0b11111111
;+-----------------+
;| ASCII(096)='`'  |
;+-----------------+
      .DB 0b00110000,0b00100000
      .DB 0b00010000,0b00000000
      .DB 0b00000000,0b00000000
      .DB 0b00000000,0b00000000
;+-----------------+
;| ASCII(097)='a'  |
;+-----------------+
      .DB 0b00000000,0b00000000
      .DB 0b01111000,0b00001100
      .DB 0b01111100,0b11001100
      .DB 0b01110110,0b00000000
;+-----------------+
;| ASCII(098)='b'  |
;+-----------------+
      .DB 0b11100000,0b01100000
      .DB 0b01100000,0b01111100
      .DB 0b01100110,0b01100110
      .DB 0b01111100,0b00000000
;+-----------------+
;| ASCII(099)='c'  |
;+-----------------+
      .DB 0b00000000,0b00000000
      .DB 0b01111100,0b11000110
      .DB 0b11000000,0b11000110
      .DB 0b01111100,0b00000000
;+-----------------+
;| ASCII(100)='d'  |
;+-----------------+
      .DB 0b00011100,0b00001100
      .DB 0b00001100,0b01111100
      .DB 0b11001100,0b11001100
      .DB 0b01110110,0b00000000
;+-----------------+
;| ASCII(101)='e'  |
;+-----------------+
      .DB 0b00000000,0b00000000
      .DB 0b01111100,0b11000110
      .DB 0b11111110,0b11000000
      .DB 0b01111100,0b00000000
;+-----------------+
;| ASCII(102)='f'  |
;+-----------------+
      .DB 0b00011100,0b00110110
      .DB 0b00110000,0b01111000
      .DB 0b00110000,0b00110000
      .DB 0b01111000,0b00000000
;+-----------------+
;| ASCII(103)='g'  |
;+-----------------+
      .DB 0b00000000,0b00000000
      .DB 0b01110110,0b11001100
      .DB 0b11001100,0b01111100
      .DB 0b00001100,0b01111000
;+-----------------+
;| ASCII(104)='h'  |
;+-----------------+
      .DB 0b11100000,0b01100000
      .DB 0b01101100,0b01110110
      .DB 0b01100110,0b01100110
      .DB 0b11100110,0b00000000
;+-----------------+
;| ASCII(105)='i'  |
;+-----------------+
      .DB 0b00011000,0b00000000
      .DB 0b00111000,0b00011000
      .DB 0b00011000,0b00011000
      .DB 0b00111100,0b00000000
;+-----------------+
;| ASCII(106)='j'  |
;+-----------------+
      .DB 0b00000000,0b00001100
      .DB 0b00000000,0b00011100
      .DB 0b00001100,0b00001100
      .DB 0b11001100,0b01111000
;+-----------------+
;| ASCII(107)='k'  |
;+-----------------+
      .DB 0b11100000,0b01100000
      .DB 0b01100110,0b01101100
      .DB 0b01111000,0b01101100
      .DB 0b11100110,0b00000000
;+-----------------+
;| ASCII(108)='l'  |
;+-----------------+
      .DB 0b00111000,0b00011000
      .DB 0b00011000,0b00011000
      .DB 0b00011000,0b00011000
      .DB 0b00111100,0b00000000
;+-----------------+
;| ASCII(109)='m'  |
;+-----------------+
      .DB 0b00000000,0b00000000
      .DB 0b11001100,0b11111110
      .DB 0b11010110,0b11010110
      .DB 0b11010110,0b00000000
;+-----------------+
;| ASCII(110)='n'  |
;+-----------------+
      .DB 0b00000000,0b00000000
      .DB 0b11011100,0b01100110
      .DB 0b01100110,0b01100110
      .DB 0b01100110,0b00000000
;+-----------------+
;| ASCII(111)='o'  |
;+-----------------+
      .DB 0b00000000,0b00000000
      .DB 0b01111100,0b11000110
      .DB 0b11000110,0b11000110
      .DB 0b01111100,0b00000000
;+-----------------+
;| ASCII(112)='p'  |
;+-----------------+
      .DB 0b00000000,0b00000000
      .DB 0b11011100,0b01100110
      .DB 0b01100110,0b01111100
      .DB 0b01100000,0b11110000
;+-----------------+
;| ASCII(113)='q'  |
;+-----------------+
      .DB 0b00000000,0b00000000
      .DB 0b01111100,0b11001100
      .DB 0b11001100,0b01111100
      .DB 0b00001100,0b00011110
;+-----------------+
;| ASCII(114)='r'  |
;+-----------------+
      .DB 0b00000000,0b00000000
      .DB 0b11011110,0b01110110
      .DB 0b01100000,0b01100000
      .DB 0b11110000,0b00000000
;+-----------------+
;| ASCII(115)='s'  |
;+-----------------+
      .DB 0b00000000,0b00000000
      .DB 0b01111100,0b11000000
      .DB 0b01111100,0b00000110
      .DB 0b01111100,0b00000000
;+-----------------+
;| ASCII(116)='t'  |
;+-----------------+
      .DB 0b00010000,0b00110000
      .DB 0b11111100,0b00110000
      .DB 0b00110000,0b00110100
      .DB 0b00011000,0b00000000
;+-----------------+
;| ASCII(117)='u'  |
;+-----------------+
      .DB 0b00000000,0b00000000
      .DB 0b11001100,0b11001100
      .DB 0b11001100,0b11001100
      .DB 0b01110110,0b00000000
;+-----------------+
;| ASCII(118)='v'  |
;+-----------------+
      .DB 0b00000000,0b00000000
      .DB 0b11000110,0b11000110
      .DB 0b01101100,0b00111000
      .DB 0b00010000,0b00000000
;+-----------------+
;| ASCII(119)='w'  |
;+-----------------+
      .DB 0b00000000,0b00000000
      .DB 0b11000110,0b11010110
      .DB 0b11010110,0b11111110
      .DB 0b01101100,0b00000000
;+-----------------+
;| ASCII(120)='x'  |
;+-----------------+
      .DB 0b00000000,0b00000000
      .DB 0b11000110,0b01101100
      .DB 0b00111000,0b01101100
      .DB 0b11000110,0b00000000
;+-----------------+
;| ASCII(121)='y'  |
;+-----------------+
      .DB 0b00000000,0b00000000
      .DB 0b11001100,0b11001100
      .DB 0b11001100,0b01111100
      .DB 0b00001100,0b11111000
;+-----------------+
;| ASCII(122)='z'  |
;+-----------------+
      .DB 0b00000000,0b00000000
      .DB 0b11111100,0b10011000
      .DB 0b00110000,0b01100100
      .DB 0b11111100,0b00000000
;+-----------------+
;| ASCII(123)='{'  |
;+-----------------+
      .DB 0b00001110,0b00011000
      .DB 0b00011000,0b00110000
      .DB 0b00011000,0b00011000
      .DB 0b00001110,0b00000000
;+-----------------+
;| ASCII(124)='|'  |
;+-----------------+
      .DB 0b00011000,0b00011000
      .DB 0b00011000,0b00000000
      .DB 0b00011000,0b00011000
      .DB 0b00011000,0b00000000
;+-----------------+
;| ASCII(125)='}'  |
;+-----------------+
      .DB 0b11100000,0b00110000
      .DB 0b00110000,0b00011000
      .DB 0b00110000,0b00110000
      .DB 0b11100000,0b00000000
;+-----------------+
;| ASCII(126)='~'  |
;+-----------------+
      .DB 0b01110110,0b11011100
      .DB 0b00000000,0b00000000
      .DB 0b00000000,0b00000000
      .DB 0b00000000,0b00000000
;+-----------------+
;| ASCII(127)=''  |
;+-----------------+
      .DB 0b00000000,0b00010000
      .DB 0b00111000,0b01101100
      .DB 0b11000110,0b11000110
      .DB 0b11111110,0b00000000
;+-----------------+
;| ASCII(128)='€'  |
;+-----------------+
      .DB 0b01111100,0b11000110
      .DB 0b11000000,0b11000000
      .DB 0b11000110,0b01111100
      .DB 0b00011000,0b01110000
;+-----------------+
;| ASCII(129)='�'  |
;+-----------------+
      .DB 0b11001100,0b00000000
      .DB 0b11001100,0b11001100
      .DB 0b11001100,0b11001100
      .DB 0b01110110,0b00000000
;+-----------------+
;| ASCII(130)='‚'  |
;+-----------------+
      .DB 0b00001110,0b00010000
      .DB 0b01111100,0b11000110
      .DB 0b11111110,0b11000000
      .DB 0b01111100,0b00000000
;+-----------------+
;| ASCII(131)='ƒ'  |
;+-----------------+
      .DB 0b01111100,0b10000010
      .DB 0b00111000,0b00001100
      .DB 0b01111100,0b11001100
      .DB 0b01110110,0b00000000
;+-----------------+
;| ASCII(132)='„'  |
;+-----------------+
      .DB 0b11001100,0b00000000
      .DB 0b01111000,0b00001100
      .DB 0b01111100,0b11001100
      .DB 0b01110110,0b00000000
;+-----------------+
;| ASCII(133)='…'  |
;+-----------------+
      .DB 0b11100000,0b00010000
      .DB 0b01111000,0b00001100
      .DB 0b01111100,0b11001100
      .DB 0b01110110,0b00000000
;+-----------------+
;| ASCII(134)='†'  |
;+-----------------+
      .DB 0b00110000,0b00110000
      .DB 0b01111000,0b00001100
      .DB 0b01111100,0b11001100
      .DB 0b01110110,0b00000000
;+-----------------+
;| ASCII(135)='‡'  |
;+-----------------+
      .DB 0b00000000,0b00000000
      .DB 0b01111100,0b11000000
      .DB 0b11000000,0b01111100
      .DB 0b00011000,0b01110000
;+-----------------+
;| ASCII(136)='ˆ'  |
;+-----------------+
      .DB 0b01111100,0b10000010
      .DB 0b01111100,0b11000110
      .DB 0b11111110,0b11000000
      .DB 0b01111100,0b00000000
;+-----------------+
;| ASCII(137)='‰'  |
;+-----------------+
      .DB 0b11000110,0b00000000
      .DB 0b01111100,0b11000110
      .DB 0b11111110,0b11000000
      .DB 0b01111100,0b00000000
;+-----------------+
;| ASCII(138)='Š'  |
;+-----------------+
      .DB 0b11100000,0b00010000
      .DB 0b01111100,0b11000110
      .DB 0b11111110,0b11000000
      .DB 0b01111100,0b00000000
;+-----------------+
;| ASCII(139)='‹'  |
;+-----------------+
      .DB 0b01100110,0b00000000
      .DB 0b00111000,0b00011000
      .DB 0b00011000,0b00011000
      .DB 0b00111100,0b00000000
;+-----------------+
;| ASCII(140)='Œ'  |
;+-----------------+
      .DB 0b01111100,0b10000010
      .DB 0b00111000,0b00011000
      .DB 0b00011000,0b00011000
      .DB 0b00111100,0b00000000
;+-----------------+
;| ASCII(141)='�'  |
;+-----------------+
      .DB 0b11100000,0b00010000
      .DB 0b00111000,0b00011000
      .DB 0b00011000,0b00011000
      .DB 0b00111100,0b00000000
;+-----------------+
;| ASCII(142)='Ž'  |
;+-----------------+
      .DB 0b11000110,0b00000000
      .DB 0b01111100,0b11000110
      .DB 0b11111110,0b11000110
      .DB 0b11000110,0b00000000
;+-----------------+
;| ASCII(143)='�'  |
;+-----------------+
      .DB 0b00111000,0b00111000
      .DB 0b01111100,0b11000110
      .DB 0b11111110,0b11000110
      .DB 0b11000110,0b00000000
;+-----------------+
;| ASCII(144)='�'  |
;+-----------------+
      .DB 0b00001110,0b00010000
      .DB 0b11111110,0b01100000
      .DB 0b01111000,0b01100000
      .DB 0b11111110,0b00000000
;+-----------------+
;| ASCII(145)='‘'  |
;+-----------------+
      .DB 0b00000000,0b00000000
      .DB 0b01111100,0b00010010
      .DB 0b01111110,0b11010000
      .DB 0b01111110,0b00000000
;+-----------------+
;| ASCII(146)='’'  |
;+-----------------+
      .DB 0b01111110,0b11001000
      .DB 0b11001000,0b11111110
      .DB 0b11001000,0b11001000
      .DB 0b11001110,0b00000000
;+-----------------+
;| ASCII(147)='“'  |
;+-----------------+
      .DB 0b01111100,0b10000010
      .DB 0b01111100,0b11000110
      .DB 0b11000110,0b11000110
      .DB 0b01111100,0b00000000
;+-----------------+
;| ASCII(148)='”'  |
;+-----------------+
      .DB 0b11000110,0b00000000
      .DB 0b01111100,0b11000110
      .DB 0b11000110,0b11000110
      .DB 0b01111100,0b00000000
;+-----------------+
;| ASCII(149)='•'  |
;+-----------------+
      .DB 0b11100000,0b00010000
      .DB 0b01111100,0b11000110
      .DB 0b11000110,0b11000110
      .DB 0b01111100,0b00000000
;+-----------------+
;| ASCII(150)='–'  |
;+-----------------+
      .DB 0b01111100,0b10000010
      .DB 0b11001100,0b11001100
      .DB 0b11001100,0b11001100
      .DB 0b01110110,0b00000000
;+-----------------+
;| ASCII(151)='—'  |
;+-----------------+
      .DB 0b11100000,0b00010000
      .DB 0b11001100,0b11001100
      .DB 0b11001100,0b11001100
      .DB 0b01110110,0b00000000
;+-----------------+
;| ASCII(152)='˜'  |
;+-----------------+
      .DB 0b11001100,0b00000000
      .DB 0b11001100,0b11001100
      .DB 0b11001100,0b01111100
      .DB 0b00001100,0b11111000
;+-----------------+
;| ASCII(153)='™'  |
;+-----------------+
      .DB 0b11000110,0b01111100
      .DB 0b11000110,0b11000110
      .DB 0b11000110,0b11000110
      .DB 0b01111100,0b00000000
;+-----------------+
;| ASCII(154)='š'  |
;+-----------------+
      .DB 0b11000110,0b00000000
      .DB 0b11000110,0b11000110
      .DB 0b11000110,0b11000110
      .DB 0b01111100,0b00000000
;+-----------------+
;| ASCII(155)='›'  |
;+-----------------+
      .DB 0b00011000,0b01111100
      .DB 0b11010110,0b11010000
      .DB 0b11010110,0b01111100
      .DB 0b00011000,0b00000000
;+-----------------+
;| ASCII(156)='œ'  |
;+-----------------+
      .DB 0b00111000,0b01101100
      .DB 0b01100000,0b11110000
      .DB 0b01100000,0b11110010
      .DB 0b11011100,0b00000000
;+-----------------+
;| ASCII(157)='�'  |
;+-----------------+
      .DB 0b01100110,0b00111100
      .DB 0b00011000,0b01111110
      .DB 0b00011000,0b01111110
      .DB 0b00011000,0b00000000
;+-----------------+
;| ASCII(158)='ž'  |
;+-----------------+
      .DB 0b11111000,0b11001100
      .DB 0b11111000,0b11000100
      .DB 0b11001100,0b11011110
      .DB 0b11001100,0b00000110
;+-----------------+
;| ASCII(159)='Ÿ'  |
;+-----------------+
      .DB 0b00001110,0b00011011
      .DB 0b00011000,0b00111100
      .DB 0b00011000,0b00011000
      .DB 0b11011000,0b01110000
;+-----------------+
;| ASCII(160)=' '  |
;+-----------------+
      .DB 0b00001110,0b00010000
      .DB 0b01111000,0b00001100
      .DB 0b01111100,0b11001100
      .DB 0b01110110,0b00000000
;+-----------------+
;| ASCII(161)='¡'  |
;+-----------------+
      .DB 0b00001110,0b00010000
      .DB 0b00111000,0b00011000
      .DB 0b00011000,0b00011000
      .DB 0b00111100,0b00000000
;+-----------------+
;| ASCII(162)='¢'  |
;+-----------------+
      .DB 0b00001110,0b00010000
      .DB 0b01111100,0b11000110
      .DB 0b11000110,0b11000110
      .DB 0b01111100,0b00000000
;+-----------------+
;| ASCII(163)='£'  |
;+-----------------+
      .DB 0b00001110,0b00010000
      .DB 0b11001100,0b11001100
      .DB 0b11001100,0b11001100
      .DB 0b01110110,0b00000000
;+-----------------+
;| ASCII(164)='¤'  |
;+-----------------+
      .DB 0b01100110,0b10011000
      .DB 0b11011100,0b01100110
      .DB 0b01100110,0b01100110
      .DB 0b01100110,0b00000000
;+-----------------+
;| ASCII(165)='¥'  |
;+-----------------+
      .DB 0b01100110,0b10011000
      .DB 0b11100110,0b11110110
      .DB 0b11011110,0b11001110
      .DB 0b11000110,0b00000000
;+-----------------+
;| ASCII(166)='¦'  |
;+-----------------+
      .DB 0b00111000,0b00001100
      .DB 0b00111100,0b00110100
      .DB 0b00000000,0b01111110
      .DB 0b00000000,0b00000000
;+-----------------+
;| ASCII(167)='§'  |
;+-----------------+
      .DB 0b00111000,0b01101100
      .DB 0b01101100,0b00111000
      .DB 0b00000000,0b01111100
      .DB 0b00000000,0b00000000
;+-----------------+
;| ASCII(168)='¨'  |
;+-----------------+
      .DB 0b00110000,0b00000000
      .DB 0b00110000,0b01100000
      .DB 0b11000110,0b11000110
      .DB 0b01111100,0b00000000
;+-----------------+
;| ASCII(169)='©'  |
;+-----------------+
      .DB 0b00000000,0b00000000
      .DB 0b00000000,0b11111100
      .DB 0b11000000,0b11000000
      .DB 0b00000000,0b00000000
;+-----------------+
;| ASCII(170)='ª'  |
;+-----------------+
      .DB 0b00000000,0b00000000
      .DB 0b00000000,0b11111100
      .DB 0b00001100,0b00001100
      .DB 0b00000000,0b00000000
;+-----------------+
;| ASCII(171)='«'  |
;+-----------------+
      .DB 0b11000000,0b11001000
      .DB 0b11010000,0b11111110
      .DB 0b01000110,0b10001100
      .DB 0b00011110,0b00000000
;+-----------------+
;| ASCII(172)='¬'  |
;+-----------------+
      .DB 0b11000000,0b11001000
      .DB 0b11010000,0b11101100
      .DB 0b01011100,0b10111110
      .DB 0b00001100,0b00000000
;+-----------------+
;| ASCII(173)='­'  |
;+-----------------+
      .DB 0b00011000,0b00000000
      .DB 0b00011000,0b00011000
      .DB 0b00111100,0b00111100
      .DB 0b00011000,0b00000000
;+-----------------+
;| ASCII(174)='®'  |
;+-----------------+
      .DB 0b00000000,0b00110110
      .DB 0b01101100,0b11011000
      .DB 0b01101100,0b00110110
      .DB 0b00000000,0b00000000
;+-----------------+
;| ASCII(175)='¯'  |
;+-----------------+
      .DB 0b00000000,0b11011000
      .DB 0b01101100,0b00110110
      .DB 0b01101100,0b11011000
      .DB 0b00000000,0b00000000
;+-----------------+
;| ASCII(176)='°'  |
;+-----------------+
      .DB 0b00100010,0b10001000
      .DB 0b00100010,0b10001000
      .DB 0b00100010,0b10001000
      .DB 0b00100010,0b10001000
;+-----------------+
;| ASCII(177)='±'  |
;+-----------------+
      .DB 0b01010101,0b10101010
      .DB 0b01010101,0b10101010
      .DB 0b01010101,0b10101010
      .DB 0b01010101,0b10101010
;+-----------------+
;| ASCII(178)='²'  |
;+-----------------+
      .DB 0b11011011,0b01110111
      .DB 0b11011011,0b11101110
      .DB 0b11011011,0b01110111
      .DB 0b11011011,0b11101110
;+-----------------+
;| ASCII(179)='³'  |
;+-----------------+
      .DB 0b00011000,0b00011000
      .DB 0b00011000,0b00011000
      .DB 0b00011000,0b00011000
      .DB 0b00011000,0b00011000
;+-----------------+
;| ASCII(180)='´'  |
;+-----------------+
      .DB 0b00011000,0b00011000
      .DB 0b00011000,0b00011000
      .DB 0b11111000,0b00011000
      .DB 0b00011000,0b00011000
;+-----------------+
;| ASCII(181)='µ'  |
;+-----------------+
      .DB 0b00011000,0b00011000
      .DB 0b11111000,0b00011000
      .DB 0b11111000,0b00011000
      .DB 0b00011000,0b00011000
;+-----------------+
;| ASCII(182)='¶'  |
;+-----------------+
      .DB 0b00110110,0b00110110
      .DB 0b00110110,0b00110110
      .DB 0b11110110,0b00110110
      .DB 0b00110110,0b00110110
;+-----------------+
;| ASCII(183)='·'  |
;+-----------------+
      .DB 0b00000000,0b00000000
      .DB 0b00000000,0b00000000
      .DB 0b11111110,0b00110110
      .DB 0b00110110,0b00110110
;+-----------------+
;| ASCII(184)='¸'  |
;+-----------------+
      .DB 0b00000000,0b00000000
      .DB 0b11111000,0b00011000
      .DB 0b11111000,0b00011000
      .DB 0b00011000,0b00011000
;+-----------------+
;| ASCII(185)='¹'  |
;+-----------------+
      .DB 0b00110110,0b00110110
      .DB 0b11110110,0b00000110
      .DB 0b11110110,0b00110110
      .DB 0b00110110,0b00110110
;+-----------------+
;| ASCII(186)='º'  |
;+-----------------+
      .DB 0b00110110,0b00110110
      .DB 0b00110110,0b00110110
      .DB 0b00110110,0b00110110
      .DB 0b00110110,0b00110110
;+-----------------+
;| ASCII(187)='»'  |
;+-----------------+
      .DB 0b00000000,0b00000000
      .DB 0b11111110,0b00000110
      .DB 0b11110110,0b00110110
      .DB 0b00110110,0b00110110
;+-----------------+
;| ASCII(188)='¼'  |
;+-----------------+
      .DB 0b00110110,0b00110110
      .DB 0b11110110,0b00000110
      .DB 0b11111110,0b00000000
      .DB 0b00000000,0b00000000
;+-----------------+
;| ASCII(189)='½'  |
;+-----------------+
      .DB 0b00110110,0b00110110
      .DB 0b00110110,0b00110110
      .DB 0b11111110,0b00000000
      .DB 0b00000000,0b00000000
;+-----------------+
;| ASCII(190)='¾'  |
;+-----------------+
      .DB 0b00011000,0b00011000
      .DB 0b11111000,0b00011000
      .DB 0b11111000,0b00000000
      .DB 0b00000000,0b00000000
;+-----------------+
;| ASCII(191)='¿'  |
;+-----------------+
      .DB 0b00000000,0b00000000
      .DB 0b00000000,0b00000000
      .DB 0b11111000,0b00011000
      .DB 0b00011000,0b00011000
;+-----------------+
;| ASCII(192)='À'  |
;+-----------------+
      .DB 0b00011000,0b00011000
      .DB 0b00011000,0b00011000
      .DB 0b00011111,0b00000000
      .DB 0b00000000,0b00000000
;+-----------------+
;| ASCII(193)='Á'  |
;+-----------------+
      .DB 0b00011000,0b00011000
      .DB 0b00011000,0b00011000
      .DB 0b11111111,0b00000000
      .DB 0b00000000,0b00000000
;+-----------------+
;| ASCII(194)='Â'  |
;+-----------------+
      .DB 0b00000000,0b00000000
      .DB 0b00000000,0b00000000
      .DB 0b11111111,0b00011000
      .DB 0b00011000,0b00011000
;+-----------------+
;| ASCII(195)='Ã'  |
;+-----------------+
      .DB 0b00011000,0b00011000
      .DB 0b00011000,0b00011000
      .DB 0b00011111,0b00011000
      .DB 0b00011000,0b00011000
;+-----------------+
;| ASCII(196)='Ä'  |
;+-----------------+
      .DB 0b00000000,0b00000000
      .DB 0b00000000,0b00000000
      .DB 0b11111111,0b00000000
      .DB 0b00000000,0b00000000
;+-----------------+
;| ASCII(197)='Å'  |
;+-----------------+
      .DB 0b00011000,0b00011000
      .DB 0b00011000,0b00011000
      .DB 0b11111111,0b00011000
      .DB 0b00011000,0b00011000
;+-----------------+
;| ASCII(198)='Æ'  |
;+-----------------+
      .DB 0b00011000,0b00011000
      .DB 0b00011111,0b00011000
      .DB 0b00011111,0b00011000
      .DB 0b00011000,0b00011000
;+-----------------+
;| ASCII(199)='Ç'  |
;+-----------------+
      .DB 0b00110110,0b00110110
      .DB 0b00110110,0b00110110
      .DB 0b00110111,0b00110110
      .DB 0b00110110,0b00110110
;+-----------------+
;| ASCII(200)='È'  |
;+-----------------+
      .DB 0b00110110,0b00110110
      .DB 0b00110111,0b00110000
      .DB 0b00111111,0b00000000
      .DB 0b00000000,0b00000000
;+-----------------+
;| ASCII(201)='É'  |
;+-----------------+
      .DB 0b00000000,0b00000000
      .DB 0b00111111,0b00110000
      .DB 0b00110111,0b00110110
      .DB 0b00110110,0b00110110
;+-----------------+
;| ASCII(202)='Ê'  |
;+-----------------+
      .DB 0b00110110,0b00110110
      .DB 0b11110111,0b00000000
      .DB 0b11111111,0b00000000
      .DB 0b00000000,0b00000000
;+-----------------+
;| ASCII(203)='Ë'  |
;+-----------------+
      .DB 0b00000000,0b00000000
      .DB 0b11111111,0b00000000
      .DB 0b11110111,0b00110110
      .DB 0b00110110,0b00110110
;+-----------------+
;| ASCII(204)='Ì'  |
;+-----------------+
      .DB 0b00110110,0b00110110
      .DB 0b00110111,0b00110000
      .DB 0b00110111,0b00110110
      .DB 0b00110110,0b00110110
;+-----------------+
;| ASCII(205)='Í'  |
;+-----------------+
      .DB 0b00000000,0b00000000
      .DB 0b11111111,0b00000000
      .DB 0b11111111,0b00000000
      .DB 0b00000000,0b00000000
;+-----------------+
;| ASCII(206)='Î'  |
;+-----------------+
      .DB 0b00110110,0b00110110
      .DB 0b11110111,0b00000000
      .DB 0b11110111,0b00110110
      .DB 0b00110110,0b00110110
;+-----------------+
;| ASCII(207)='Ï'  |
;+-----------------+
      .DB 0b00011000,0b00011000
      .DB 0b11111111,0b00000000
      .DB 0b11111111,0b00000000
      .DB 0b00000000,0b00000000
;+-----------------+
;| ASCII(208)='Ð'  |
;+-----------------+
      .DB 0b00110110,0b00110110
      .DB 0b00110110,0b00110110
      .DB 0b11111111,0b00000000
      .DB 0b00000000,0b00000000
;+-----------------+
;| ASCII(209)='Ñ'  |
;+-----------------+
      .DB 0b00000000,0b00000000
      .DB 0b11111111,0b00000000
      .DB 0b11111111,0b00011000
      .DB 0b00011000,0b00011000
;+-----------------+
;| ASCII(210)='Ò'  |
;+-----------------+
      .DB 0b00000000,0b00000000
      .DB 0b00000000,0b00000000
      .DB 0b11111111,0b00110110
      .DB 0b00110110,0b00110110
;+-----------------+
;| ASCII(211)='Ó'  |
;+-----------------+
      .DB 0b00110110,0b00110110
      .DB 0b00110110,0b00110110
      .DB 0b00111111,0b00000000
      .DB 0b00000000,0b00000000
;+-----------------+
;| ASCII(212)='Ô'  |
;+-----------------+
      .DB 0b00011000,0b00011000
      .DB 0b00011111,0b00011000
      .DB 0b00011111,0b00000000
      .DB 0b00000000,0b00000000
;+-----------------+
;| ASCII(213)='Õ'  |
;+-----------------+
      .DB 0b00000000,0b00000000
      .DB 0b00011111,0b00011000
      .DB 0b00011111,0b00011000
      .DB 0b00011000,0b00011000
;+-----------------+
;| ASCII(214)='Ö'  |
;+-----------------+
      .DB 0b00000000,0b00000000
      .DB 0b00000000,0b00000000
      .DB 0b00111111,0b00110110
      .DB 0b00110110,0b00110110
;+-----------------+
;| ASCII(215)='×'  |
;+-----------------+
      .DB 0b00110110,0b00110110
      .DB 0b00110110,0b00110110
      .DB 0b11111111,0b00110110
      .DB 0b00110110,0b00110110
;+-----------------+
;| ASCII(216)='Ø'  |
;+-----------------+
      .DB 0b00011000,0b00011000
      .DB 0b11111111,0b00011000
      .DB 0b11111111,0b00011000
      .DB 0b00011000,0b00011000
;+-----------------+
;| ASCII(217)='Ù'  |
;+-----------------+
      .DB 0b00011000,0b00011000
      .DB 0b00011000,0b00011000
      .DB 0b11111000,0b00000000
      .DB 0b00000000,0b00000000
;+-----------------+
;| ASCII(218)='Ú'  |
;+-----------------+
      .DB 0b00000000,0b00000000
      .DB 0b00000000,0b00000000
      .DB 0b00011111,0b00011000
      .DB 0b00011000,0b00011000
;+-----------------+
;| ASCII(219)='Û'  |
;+-----------------+
      .DB 0b11111111,0b11111111
      .DB 0b11111111,0b11111111
      .DB 0b11111111,0b11111111
      .DB 0b11111111,0b11111111
;+-----------------+
;| ASCII(220)='Ü'  |
;+-----------------+
      .DB 0b00000000,0b00000000
      .DB 0b00000000,0b00000000
      .DB 0b11111111,0b11111111
      .DB 0b11111111,0b11111111
;+-----------------+
;| ASCII(221)='Ý'  |
;+-----------------+
      .DB 0b11110000,0b11110000
      .DB 0b11110000,0b11110000
      .DB 0b11110000,0b11110000
      .DB 0b11110000,0b11110000
;+-----------------+
;| ASCII(222)='Þ'  |
;+-----------------+
      .DB 0b00001111,0b00001111
      .DB 0b00001111,0b00001111
      .DB 0b00001111,0b00001111
      .DB 0b00001111,0b00001111
;+-----------------+
;| ASCII(223)='ß'  |
;+-----------------+
      .DB 0b11111111,0b11111111
      .DB 0b11111111,0b11111111
      .DB 0b00000000,0b00000000
      .DB 0b00000000,0b00000000
;+-----------------+
;| ASCII(224)='à'  |
;+-----------------+
      .DB 0b00000000,0b00000000
      .DB 0b01110100,0b11001100
      .DB 0b11001000,0b11011100
      .DB 0b01110110,0b00000000
;+-----------------+
;| ASCII(225)='á'  |
;+-----------------+
      .DB 0b01111000,0b11001100
      .DB 0b11011000,0b11001100
      .DB 0b11000110,0b11000110
      .DB 0b11011100,0b01000000
;+-----------------+
;| ASCII(226)='â'  |
;+-----------------+
      .DB 0b11111110,0b01100010
      .DB 0b01100000,0b01100000
      .DB 0b01100000,0b01100000
      .DB 0b11110000,0b00000000
;+-----------------+
;| ASCII(227)='ã'  |
;+-----------------+
      .DB 0b00000000,0b00000010
      .DB 0b01111110,0b11101100
      .DB 0b01101100,0b01101100
      .DB 0b01001000,0b00000000
;+-----------------+
;| ASCII(228)='ä'  |
;+-----------------+
      .DB 0b11111110,0b01100010
      .DB 0b00110000,0b00011000
      .DB 0b00110000,0b01100010
      .DB 0b11111110,0b00000000
;+-----------------+
;| ASCII(229)='å'  |
;+-----------------+
      .DB 0b00000000,0b00000000
      .DB 0b01111110,0b11010000
      .DB 0b11001000,0b11001000
      .DB 0b01110000,0b00000000
;+-----------------+
;| ASCII(230)='æ'  |
;+-----------------+
      .DB 0b00000000,0b00000000
      .DB 0b11001100,0b11001100
      .DB 0b11001100,0b11001100
      .DB 0b11111000,0b10000000
;+-----------------+
;| ASCII(231)='ç'  |
;+-----------------+
      .DB 0b00000000,0b00000000
      .DB 0b01111110,0b11011000
      .DB 0b00011000,0b00011000
      .DB 0b00010000,0b00000000
;+-----------------+
;| ASCII(232)='è'  |
;+-----------------+
      .DB 0b00111000,0b00010000
      .DB 0b01111100,0b11010110
      .DB 0b11010110,0b01111100
      .DB 0b00010000,0b00111000
;+-----------------+
;| ASCII(233)='é'  |
;+-----------------+
      .DB 0b01111100,0b11000110
      .DB 0b11000110,0b11111110
      .DB 0b11000110,0b11000110
      .DB 0b01111100,0b00000000
;+-----------------+
;| ASCII(234)='ê'  |
;+-----------------+
      .DB 0b01111100,0b11000110
      .DB 0b11000110,0b11000110
      .DB 0b01101100,0b00101000
      .DB 0b11101110,0b00000000
;+-----------------+
;| ASCII(235)='ë'  |
;+-----------------+
      .DB 0b00111100,0b00100010
      .DB 0b00011000,0b01111100
      .DB 0b11001100,0b11001100
      .DB 0b01111000,0b00000000
;+-----------------+
;| ASCII(236)='ì'  |
;+-----------------+
      .DB 0b00000000,0b00000000
      .DB 0b01100110,0b10011001
      .DB 0b10011001,0b01100110
      .DB 0b00000000,0b00000000
;+-----------------+
;| ASCII(237)='í'  |
;+-----------------+
      .DB 0b00000000,0b00000110
      .DB 0b01111100,0b10011110
      .DB 0b11110010,0b01111100
      .DB 0b11000000,0b00000000
;+-----------------+
;| ASCII(238)='î'  |
;+-----------------+
      .DB 0b00000000,0b00000000
      .DB 0b01111100,0b11000000
      .DB 0b11111000,0b11000000
      .DB 0b01111100,0b00000000
;+-----------------+
;| ASCII(239)='ï'  |
;+-----------------+
      .DB 0b00000000,0b01111100
      .DB 0b11000110,0b11000110
      .DB 0b11000110,0b11000110
      .DB 0b11000110,0b00000000
;+-----------------+
;| ASCII(240)='ð'  |
;+-----------------+
      .DB 0b00000000,0b11111110
      .DB 0b00000000,0b11111110
      .DB 0b00000000,0b11111110
      .DB 0b00000000,0b00000000
;+-----------------+
;| ASCII(241)='ñ'  |
;+-----------------+
      .DB 0b00011000,0b00011000
      .DB 0b01111110,0b00011000
      .DB 0b00011000,0b00000000
      .DB 0b01111110,0b00000000
;+-----------------+
;| ASCII(242)='ò'  |
;+-----------------+
      .DB 0b00110000,0b00011000
      .DB 0b00001100,0b00011000
      .DB 0b00110000,0b00000000
      .DB 0b01111100,0b00000000
;+-----------------+
;| ASCII(243)='ó'  |
;+-----------------+
      .DB 0b00011000,0b00110000
      .DB 0b01100000,0b00110000
      .DB 0b00011000,0b00000000
      .DB 0b01111100,0b00000000
;+-----------------+
;| ASCII(244)='ô'  |
;+-----------------+
      .DB 0b00001110,0b00011011
      .DB 0b00011011,0b00011000
      .DB 0b00011000,0b00011000
      .DB 0b00011000,0b00011000
;+-----------------+
;| ASCII(245)='õ'  |
;+-----------------+
      .DB 0b00011000,0b00011000
      .DB 0b00011000,0b00011000
      .DB 0b00011000,0b11011000
      .DB 0b11011000,0b01110000
;+-----------------+
;| ASCII(246)='ö'  |
;+-----------------+
      .DB 0b00000000,0b00011000
      .DB 0b00000000,0b01111110
      .DB 0b00000000,0b00011000
      .DB 0b00000000,0b00000000
;+-----------------+
;| ASCII(247)='÷'  |
;+-----------------+
      .DB 0b00000000,0b01110110
      .DB 0b11011100,0b00000000
      .DB 0b01110110,0b11011100
      .DB 0b00000000,0b00000000
;+-----------------+
;| ASCII(248)='ø'  |
;+-----------------+
      .DB 0b00111000,0b01101100
      .DB 0b00111000,0b00000000
      .DB 0b00000000,0b00000000
      .DB 0b00000000,0b00000000
;+-----------------+
;| ASCII(249)='ù'  |
;+-----------------+
      .DB 0b00000000,0b00000000
      .DB 0b00000000,0b00011000
      .DB 0b00011000,0b00000000
      .DB 0b00000000,0b00000000
;+-----------------+
;| ASCII(250)='ú'  |
;+-----------------+
      .DB 0b00000000,0b00000000
      .DB 0b00000000,0b00000000
      .DB 0b00011000,0b00000000
      .DB 0b00000000,0b00000000
;+-----------------+
;| ASCII(251)='û'  |
;+-----------------+
      .DB 0b00001111,0b00001100
      .DB 0b00001100,0b00001100
      .DB 0b11101100,0b01101100
      .DB 0b00111100,0b00000000
;+-----------------+
;| ASCII(252)='ü'  |
;+-----------------+
      .DB 0b11011000,0b01101100
      .DB 0b01101100,0b01101100
      .DB 0b00000000,0b00000000
      .DB 0b00000000,0b00000000
;+-----------------+
;| ASCII(253)='ý'  |
;+-----------------+
      .DB 0b11110000,0b00110000
      .DB 0b11000000,0b11110000
      .DB 0b00000000,0b00000000
      .DB 0b00000000,0b00000000
;+-----------------+
;| ASCII(254)='þ'  |
;+-----------------+
      .DB 0b00000000,0b00000000
      .DB 0b00111100,0b00111100
      .DB 0b00111100,0b00111100
      .DB 0b00000000,0b00000000
;+-----------------+
;| ASCII(255)='ÿ'  |
;+-----------------+
      .DB 0b00000000,0b00000000
      .DB 0b00000000,0b00000000
      .DB 0b00000000,0b00000000
      .DB 0b00000000,0b00000000
