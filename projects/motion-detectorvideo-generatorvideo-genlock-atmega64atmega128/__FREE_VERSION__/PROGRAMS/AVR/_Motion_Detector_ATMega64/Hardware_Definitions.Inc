;			 _   _               _                        
;			| | | |             | |                       
;			| |_| | __ _ _ __ __| |_      ____ _ _ __ ___ 
;			|  _  |/ _` | '__/ _` \ \ /\ / / _` | '__/ _ \
;			| | | | (_| | | | (_| |\ V  V / (_| | | |  __/
;			\_| |_/\__,_|_|  \__,_| \_/\_/ \__,_|_|  \___|
;                                              
;                                              
;			______      __ _       _ _   _                 
;			|  _  \    / _(_)     (_) | (_)                
;			| | | |___| |_ _ _ __  _| |_ _  ___  _ __  ___ 
;			| | | / _ \  _| | '_ \| | __| |/ _ \| '_ \/ __|
;			| |/ /  __/ | | | | | | | |_| | (_) | | | \__ \
;			|___/ \___|_| |_|_| |_|_|\__|_|\___/|_| |_|___/
;
 

; 	 ____________________________________________________________________________________________
;	|////////////////////////////////////////////////////////////////////////////////////////////|
;	|///|											|////|
;	|///| PROJECT	 : Motion Detector ATMEGA64						|////|
;	|///| VERSION	 : 1.20									|////|
;	|///| PROGRAMMER : JOÃO DARTAGNAN ANTUNES OLIVEIRA				   	|////|
;	|///| DATE 	 : Dezember, 6 of 2006 (00:06)						|////|
;	|///| DESCRIPTION: This project has 2 conectors BNC, 1 for Video input and another      |////|
;	|///|		   for output, 1 Relay output Normally Open and NOrmally closed,	|////|
;	|///| 		   communication port RS485 and TX and RX leds, 1 expansion port and 1  |////|
;	|///|		   ISP for device programming.						|////|
;	|///| OBJETIVE:	   This program had developed for Motion detection sensor using a       |////|
;	|///| 		   standard NTSC(60Hz) or PAL(50Hz) color or BW composite video input	|////|
;	|///| 		   for digitizing, genloking, and video generation for capturing motion |////|
;	|///| 		   of pattern in video frame with a grid of 24x24 size, eath cell grid  |////|
;	|///| 		   has capabilities to measure motion in scale of 8bits, those motion	|////|
;	|///| 		   can be advised to user using a Relay or RS484 line.			|////|
;	|///| 											|////|
;	|///| OBSERVATION: This software run only AVRMega family chips				|////|
;	|///|___________________________________________________________________________________|////|
;-------|////////////////////////////////////////////////////////////////////////////////////////////|
;	>--------------------------------------------------------------------------------------------<
        ;+--------------------------------------------------------------------------------+              
        ;|João D´Artagnan A. Oliveira Programmer and Author; 				  |
        ;|										  |
        ;| All rights reserved.								  |
        ;|										  |
        ;|   Redistribution and use in source and binary forms, with or without		  |
        ;|  modification, are permitted provided that the following conditions are met:	  |
        ;|										  |
        ;|   * Redistributions of source code must retain the above copyright		  |
        ;|     notice, this list of conditions and the following disclaimer.		  |
        ;|										  |
        ;|   THIS SOFTWARE IS PROVIDED BY THE COPYRIGHT HOLDERS AND CONTRIBUTORS "AS IS"  |
        ;|   AND ANY EXPRESS OR IMPLIED WARRANTIES, INCLUDING, BUT NOT LIMITED TO, THE    |
        ;|   IMPLIED WARRANTIES OF MERCHANTABILITY AND FITNESS FOR A PARTICULAR PURPOSE   |
        ;|   ARE DISCLAIMED. IN NO EVENT SHALL THE COPYRIGHT OWNER OR CONTRIBUTORS BE     |
        ;|   LIABLE FOR ANY DIRECT, INDIRECT, INCIDENTAL, SPECIAL, EXEMPLARY, OR	  |
        ;|   CONSEQUENTIAL DAMAGES (INCLUDING, BUT NOT LIMITED TO, PROCUREMENT OF	  |
        ;|   SUBSTITUTE GOODS OR SERVICES; LOSS OF USE, DATA, OR PROFITS; OR BUSINESS	  |
        ;|   INTERRUPTION) HOWEVER CAUSED AND ON ANY THEORY OF LIABILITY, WHETHER IN	  |
        ;|   CONTRACT, STRICT LIABILITY, OR TORT (INCLUDING NEGLIGENCE OR OTHERWISE)	  |
        ;|   ARISING IN ANY WAY OUT OF THE USE OF THIS SOFTWARE, EVEN IF ADVISED OF THE   |
        ;|   POSSIBILITY OF SUCH DAMAGE.						  |
        ;|										  |
        ;|   Brasília, Brazil November 30,2015 	06:28 am				  |
        ;+--------------------------------------------------------------------------------+
;	>---------------------------------------------------------------------------------<
;-------|										  |
;	|   		H A R D W A R E  D E F I N I T I O N S  &  R O U T I N E S	  |
;	| 										  |
; 	 ---------------------------------------------------------------------------------


;+------------------------------------------------------------------------------------------+
;|  			      A  T  M  E  G  A   1 2 8				    	    |
;+------------------------------------------------------------------------------------------+
;|//////////////////////////////////[  P  O  R  T  -  A  ]\\\\\\\\\\\\\\\\\\\\\\\\\\\\\\\\\\|
;+-------+-------------+------------------------------------------------+-------------------+
;| P I N | B I T       | D E F I N I T I O N 				| D I R E C T I O N |
;+-------+-------------+------------------------------------------------+-------------------+
;|  51	 | 0-AD0       | BUST GATE (LM1881)				| INPUT PULL UP	    |
;+-------+-------------+------------------------------------------------+-------------------+
;|  50	 | 1-AD1       | FRAME (LM1881)					| INPUT	PULL UP	    |
;+-------+-------------+------------------------------------------------+-------------------+
;|  49	 | 2-AD2       | COMPOSITE (LM1881)				| INPUT	PULL UP	    |
;+-------+-------------+------------------------------------------------+-------------------+
;|  48	 | 3-AD3       | VERTICAL (LM1881)				| INPUT	PULL UP	    |
;+-------+-------------+------------------------------------------------+-------------------+
;|  47	 | 4-AD4       | NOT USED					| INPUT	HI Z	    |
;+-------+-------------+------------------------------------------------+-------------------+
;|  46	 | 5-AD5       | NOT USED					| INPUT HI Z	    |
;+-------+-------------+------------------------------------------------+-------------------+
;|  45	 | 6-AD6       | EXPANSION PIN 12				| INPUT/OUTPUT	    |
;+-------+-------------+------------------------------------------------+-------------------+
;|  44	 | 7-AD7       | EXPANSION PIN 13			        | INPUT/OUTPUT	    |
;+-------+-------------+------------------------------------------------+-------------------+
;|//////////////////////////////////[  P  O  R  T  -  B  ]\\\\\\\\\\\\\\\\\\\\\\\\\\\\\\\\\\|
;+-------+-------------+------------------------------------------------+-------------------+
;| P I N | B I T       | D E F I N I T I O N 				| D I R E C T I O N |
;+-------+-------------+------------------------------------------------+-------------------+
;|  10	 | 0-SS        | EXPANSION PIN 2				| INPUT/OUTPUT	    |
;+-------+-------------+------------------------------------------------+-------------------+
;|  11	 | 1-SCK       | EXPANSION PIN 3				| INPUT/OUTPUT	    |
;+-------+-------------+------------------------------------------------+-------------------+
;|  12	 | 2-MOSI      | EXPANSION BIN 4				| INPUT/OUTPUT	    |
;+-------+-------------+------------------------------------------------+-------------------+
;|  13	 | 3-MISO      | EXPANSION PIN 5				| INPUT/OUTPUT	    |
;+-------+-------------+------------------------------------------------+-------------------+
;|  14	 | 4-OC0       | EXPANSION PIN 6				| INPUT/OUTPUT	    |
;+-------+-------------+------------------------------------------------+-------------------+
;|  15	 | 5-OC1A      | EXPANSION PIN 7				| INPUT/OUTPUT	    |
;+-------+-------------+------------------------------------------------+-------------------+
;|  16	 | 6-OC1B      | EXPANSION PIN 8				| INPUT/OUTPUT	    |
;+-------+-------------+------------------------------------------------+-------------------+
;|  17	 | 7-OC2/OC1C  | EXPANSION PIN 9				| INPUT/OUTPUT	    |
;+-------+-------------+------------------------------------------------+-------------------+
;|//////////////////////////////////[  P  O  R  T  -  C  ]\\\\\\\\\\\\\\\\\\\\\\\\\\\\\\\\\\|
;+-------+-------------+------------------------------------------------+-------------------+
;| P I N | B I T       | D E F I N I T I O N 				| D I R E C T I O N |
;+-------+-------------+------------------------------------------------+-------------------+
;|  35	 | 0-A8        | VIDEO DAC INPUT RESISTOR 22K			| OUTPUT	    |
;+-------+-------------+------------------------------------------------+-------------------+
;|  36	 | 1-A9        | VIDEO DAC INPUT RESISTOR 10K			| OUTPUT	    |
;+-------+-------------+------------------------------------------------+-------------------+
;|  37	 | 2-A10       | VIDEO DAC INPUT RESISTOR 4K7			| OUTPUT	    |
;+-------+-------------+------------------------------------------------+-------------------+
;|  38	 | 3-A11       | VIDEO DAC INPUT RESISTOR 2K2			| OUTPUT	    |
;+-------+-------------+------------------------------------------------+-------------------+
;|  39	 | 4-A12       | VIDEO DAC INPUT RESISTOR 1K   			| OUTPUT	    |
;+-------+-------------+------------------------------------------------+-------------------+
;|  40	 | 5-A13       | NOT USED					| INPUT HI Z	    |
;+-------+-------------+------------------------------------------------+-------------------+
;|  41	 | 6-A14       | NOT USED					| INPUT HI Z	    |
;+-------+-------------+------------------------------------------------+-------------------+
;|  42	 | 7-A15       | NOT USED					| INPUT	HI Z	    |
;+-------+-------------+------------------------------------------------+-------------------+
;|//////////////////////////////////[  P  O  R  T  -  D  ]\\\\\\\\\\\\\\\\\\\\\\\\\\\\\\\\\\|
;+-------+-------------+------------------------------------------------+-------------------+
;| P I N | B I T       | D E F I N I T I O N 				| D I R E C T I O N |
;+-------+-------------+------------------------------------------------+-------------------+
;|  25	 | 0-SCL/INT0  | NOT USED 					| INPUT	HI Z	    |
;+-------+-------------+------------------------------------------------+-------------------+
;|  26	 | 1-SDA/INT1  | KEY SWITCH CH1 (ENTER) ACTIVATE LOW		| INPUT PULL UP	    |
;+-------+-------------+------------------------------------------------+-------------------+
;|  27	 | 2-RXD1/INT2 | COMM RECEIVER 					| INPUT		    |
;+-------+-------------+------------------------------------------------+-------------------+
;|  28	 | 3-TXD1/INT3 | COMM TRANSMITTER				| OUTPUT	    |
;+-------+-------------+------------------------------------------------+-------------------+
;|  29	 | 4-IC1       | KEY SWITCH CH2 (UP) ACTIVATE LOW		| INPUT PULL UP	    |
;+-------+-------------+------------------------------------------------+-------------------+
;|  30	 | 5-XCK1      | KEY SWITCH CH3 (DOWN) ACTIVATE LOW		| INPUT PULL UP	    | 
;+-------+-------------+------------------------------------------------+-------------------+
;|  31	 | 6-T1        | KEY SWITCH CH4 (LEFT) ACTIVATE LOW		| INPUT PULL UP	    |
;+-------+-------------+------------------------------------------------+-------------------+
;|  32	 | 7-T2        | KEY SWITCH CH5 (RIGHT) ACTIVATE LOW		| INPUT PULL UP	    |
;+-------+-------------+------------------------------------------------+-------------------+
;|//////////////////////////////////[  P  O  R  T  -  E  ]\\\\\\\\\\\\\\\\\\\\\\\\\\\\\\\\\\|
;+-------+-------------+------------------------------------------------+-------------------+
;| P I N | B I T       | D E F I N I T I O N 				| D I R E C T I O N |
;+-------+-------------+------------------------------------------------+-------------------+
;|   2	 | 0-RXD0/PDI  | SPI MOSI					| INPUT		    |
;+-------+-------------+------------------------------------------------+-------------------+
;|   3	 | 1-TXD0/PDO  | SPI MISO					| OUTPUT	    |
;+-------+-------------+------------------------------------------------+-------------------+
;|   4	 | 2-XCK0/AIN0 | 2X AMPLIFIED VIDEO INPUT			| INPUT HI Z	    |
;+-------+-------------+------------------------------------------------+-------------------+
;|   5	 | 3-OC3A/AIN1 | VIDEO DAC INPUT  				| INPUT HI Z	    |
;+-------+-------------+------------------------------------------------+-------------------+
;|   6	 | 4-OC3B/INT4 | EXPANSION PIN 10				| INPUT/OUTPUT	    |
;+-------+-------------+------------------------------------------------+-------------------+
;|   7	 | 5-OC3C/INT5 | EXPANSION PIN 11			 	| INPUT/OUTPUT	    |
;+-------+-------------+------------------------------------------------+-------------------+
;|   8	 | 6-T3/INT6   | KEY SWITCH (CONFIG MODE) ACTIVATE LOW		| INPUT PULL UP	    |
;+-------+-------------+------------------------------------------------+-------------------+
;|   9	 | 7-IC3/INT7  | NOT USED					| INPUT HI Z	    |
;+-------+-------------+------------------------------------------------+-------------------+
;|/////////////////////////////////[  P  O  R  T  -  F  ]\\\\\\\\\\\\\\\\\\\\\\\\\\\\\\\\\\\|
;+-------+-------------+------------------------------------------------+-------------------+
;| P I N | B I T       | D E F I N I T I O N 				| D I R E C T I O N |
;+-------+-------------+------------------------------------------------+-------------------+
;|  61	 | 0-ADC0      | VIDEO DAC OUTPUT RESISTOR 22K			| OUTPUT	    |
;+-------+-------------+------------------------------------------------+-------------------+
;|  60	 | 1-ADC1      | VIDEO DAC OUTPUT RESISTOR 10K			| OUTPUT	    |
;+-------+-------------+------------------------------------------------+-------------------+
;|  59	 | 2-ADC2      | VIDEO DAC OUTPUT RESISTOR 4K7			| OUTPUT	    |
;+-------+-------------+------------------------------------------------+-------------------+
;|  58	 | 3-ADC3      | VIDEO DAC OUTPUT RESISTOR 2K2			| OUTPUT	    |
;+-------+-------------+------------------------------------------------+-------------------+
;|  57	 | 4-ADC4/TCK  | VIDEO DAC OUTPUT RESISTOR 1K			| OUTPUT	    |
;+-------+-------------+------------------------------------------------+-------------------+
;|  56	 | 5-ADC5/TMS  | NOT USED					| INPUT HI Z	    |
;+-------+-------------+------------------------------------------------+-------------------+
;|  55	 | 6-ADC6/TD0  | NOT USED					| INPUT HI Z	    |
;+-------+-------------+------------------------------------------------+-------------------+
;|  54	 | 7-ADC7/TDI  | NOT USED					| INPUT HI Z	    |
;+-------+-------------+------------------------------------------------+-------------------+
;|/////////////////////////////////[  P  O  R  T  -  G  ]\\\\\\\\\\\\\\\\\\\\\\\\\\\\\\\\\\\|
;+-------+-------------+------------------------------------------------+-------------------+
;| P I N | B I T       | D E F I N I T I O N 				| D I R E C T I O N |
;+-------+-------------+------------------------------------------------+-------------------+
;|  33	 | 0-WR        | 485 DIRECTION CONTROL  HIGH(TX) LOW(RX)	| OUTPUT	    |
;+-------+-------------+------------------------------------------------+-------------------+
;|  34	 | 1-RD        | MOVEMENT RELE WARNING (HIGH ACTIVATE)		| OUTPUT    	    |
;+-------+-------------+------------------------------------------------+-------------------+
;|  43	 | 2-ALE       | CPU LED (LOW ACTIVATE)				| OUTPUT	    |
;+-------+-------------+------------------------------------------------+-------------------+
;|  18	 | 3-TOSC2     | VIDEO MULTIPLEX (LOW VIDEO BY PASS) 		| OUTPUT	    |
;|	 |	       | 		 (HIGH INTERNAL)		|		    |
;+-------+-------------+------------------------------------------------+-------------------+
;|  19	 | 4-TOSC1     | VIDEO MULTIPLXE ENABLE (LOW ENABLED)		| OUTPUT	    |
;+-------+-------------+------------------------------------------------+-------------------+
;|/////////////////////////[ R  E  M  A  I  N  D  E  R   P  I  N  S ]\\\\\\\\\\\\\\\\\\\\\\\|
;+-------+-------------+------------------------------------------------+-------------------+
;| P I N | -----       | D E F I N I T I O N 				| D I R E C T I O N |
;+-------+-------------+------------------------------------------------+-------------------+
;|  20	 | RESET       | Low state reset microcontroler			| INPUT		    |
;+-------+-------------+------------------------------------------------+-------------------+
;|  23	 | XTAL2       | Output from the inverting oscillator amp.	| OUTPUT	    |
;+-------+-------------+------------------------------------------------+-------------------+
;|  24	 | XTAL1       | Input to the inverting oscillator amp.		| INPUT		    |
;+-------+-------------+------------------------------------------------+-------------------+
;|  22	 |  GND	       | Ground 					| INPUT		    |
;+-------+-------------+------------------------------------------------+-------------------+
;|  53	 |  GND	       | Ground 					| INPUT		    |
;+-------+-------------+------------------------------------------------+-------------------+
;|  63	 |  GND	       | Ground 					| INPUT		    |
;+-------+-------------+------------------------------------------------+-------------------+
;|  21 	 |  VCC        | Power supply					| INPUT	    	    |
;+-------+-------------+------------------------------------------------+-------------------+
;|  52 	 |  VCC        | Power supply					| INPUT	    	    |
;+-------+-------------+------------------------------------------------+-------------------+
;|  64 	 | AVCC        | Analog to Digital Converter Power supply	| INPUT	    	    |
;+-------+-------------+------------------------------------------------+-------------------+
;|  62 	 | AREF        | Analog to Digital Converter Reference		| INPUT	    	    |
;+-------+-------------+------------------------------------------------+-------------------+
;|///////////////////////[ O B S E R V A T I O N S		       ]\\\\\\\\\\\\\\\\\\\\|
;+------------------------------------------------------------------------------------------+
;| peripheral on board chips								    |
;|											    |
;| video multiplex  	- CD4053							    |
;| video syn separator  - LM1881							    |
;| RS485		- SN75176A							    |
;| video output		- R2R resistor DAC with BC548 buffer output			    |
;| video input		- R2R resistor DAC with AVR internal analog comparator		    |
;+------------------------------------------------------------------------------------------+
;+-------------------------------------------------------------------------------+
;| L I B R A R Y  I N C L U D E  						 |
;+-------------------------------------------------------------------------------+-----------------------------------------



	.INCLUDE	"OBJECT_BOOT.INC"			;Boot object
	.INCLUDE	"OBJECT_CPU_LED.INC"			;CPU Status object
	.INCLUDE	"OBJECT_RELAY.INC"			;Relay control object
	.INCLUDE	"OBJECT_KEYBOARD.INC"			;Onboard keyboard object
	.INCLUDE	"OBJECT_VIDEO_GEN.INC"			;Video Generator and Genlock object
	.INCLUDE	"OBJECT_MENU.INC"			;Menu access object
	.INCLUDE	"OBJECT_RTC.INC"			;Real Time Clock object
	
	.EXIT
