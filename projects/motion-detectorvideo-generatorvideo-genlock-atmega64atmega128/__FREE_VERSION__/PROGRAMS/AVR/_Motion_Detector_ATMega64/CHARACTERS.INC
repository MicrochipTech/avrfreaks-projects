;+------------------------------+
;|				|
;|ASCII VIDEO CHARACTERS TABLE	|
;|				|
;+------------------------------+

_VIDEO_OUT_CHARACTERS:
;+--------------------------------------
;|ASC(32)=' ' and ASC(33)='!'
;+--------------------------------------
   .db 0b00000000,0b00000000
   .db 0b00000000,0b00000000
   .db 0b00000000,0b00000000
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   .db 0b00100000,0b00000000
;+--------------------------------------
;|ASC(34)='"' and ASC(35)='#'
;+--------------------------------------
   .db 0b00101000,0b00101000
   .db 0b00101000,0b00000000
   .db 0b00000000,0b00000000
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   .db 0b01010000,0b10100000
;+--------------------------------------
;|ASC(36)='$' and ASC(37)='%'
;+--------------------------------------
   .db 0b00010000,0b00111000
   .db 0b01000000,0b00110000
   .db 0b00001000,0b01110000
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   .db 0b00100000,0b00000000
;+--------------------------------------
;|ASC(38)='&' and ASC(39)='''
;+--------------------------------------
   .db 0b00000000,0b00011000
   .db 0b00100000,0b00100000
   .db 0b01011000,0b01001000
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   .db 0b00000000,0b00000000
;+--------------------------------------
;|ASC(40)='(' and ASC(41)=')'
;+--------------------------------------
   .db 0b00001000,0b00001000
   .db 0b00010000,0b00010000
   .db 0b00010000,0b00010000
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   .db 0b01000000,0b01000000
;+--------------------------------------
;|ASC(42)='*' and ASC(43)='+'
;+--------------------------------------
   .db 0b00010000,0b01111100
   .db 0b00010000,0b00101000
   .db 0b00000000,0b00000000
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   .db 0b00100000,0b00000000
;+--------------------------------------
;|ASC(44)=',' and ASC(45)='-'
;+--------------------------------------
   .db 0b00000000,0b00000000
   .db 0b00000000,0b00000000
   .db 0b00000000,0b00000000
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   .db 0b00000000,0b00000000
;+--------------------------------------
;|ASC(46)='.' and ASC(47)='/'
;+--------------------------------------
   .db 0b00000000,0b00000000
   .db 0b00000000,0b00000000
   .db 0b00000000,0b00000000
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   .db 0b01000000,0b10000000
;+--------------------------------------
;|ASC(48)='0' and ASC(49)='1'
;+--------------------------------------
   .db 0b00111000,0b01000100
   .db 0b01000100,0b01000100
   .db 0b01000100,0b01000100
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   .db 0b11111000,0b00000000
;+--------------------------------------
;|ASC(50)='2' and ASC(51)='3'
;+--------------------------------------
   .db 0b00111000,0b01000100
   .db 0b00001000,0b00010000
   .db 0b00100000,0b01000000
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   .db 0b01110000,0b00000000
;+--------------------------------------
;|ASC(52)='4' and ASC(53)='5'
;+--------------------------------------
   .db 0b00001000,0b00011000
   .db 0b00101000,0b01001000
   .db 0b01111100,0b00001000
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   .db 0b01110000,0b00000000
;+--------------------------------------
;|ASC(54)='6' and ASC(55)='7'
;+--------------------------------------
   .db 0b00011100,0b00100000
   .db 0b01000000,0b01111000
   .db 0b01000100,0b01000100
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   .db 0b00100000,0b00000000
;+--------------------------------------
;|ASC(56)='8' and ASC(57)='9'
;+--------------------------------------
   .db 0b00111000,0b01000100
   .db 0b01000100,0b00111000
   .db 0b01000100,0b01000100
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   .db 0b11100000,0b00000000
;+--------------------------------------
;|ASC(58)=':' and ASC(59)=';'
;+--------------------------------------
   .db 0b00000000,0b00000000
   .db 0b00110000,0b00000000
   .db 0b00000000,0b00000000
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   .db 0b01100000,0b01000000
;+--------------------------------------
;|ASC(60)='<' and ASC(61)='='
;+--------------------------------------
   .db 0b00000000,0b00000100
   .db 0b00011000,0b01100000
   .db 0b00011000,0b00000100
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   .db 0b00000000,0b00000000
;+--------------------------------------
;|ASC(62)='>' and ASC(63)='?'
;+--------------------------------------
   .db 0b00000000,0b01000000
   .db 0b00110000,0b00001100
   .db 0b00110000,0b01000000
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   .db 0b01100000,0b00000000
;+--------------------------------------
;|ASC(64)='@' and ASC(65)='A'
;+--------------------------------------
   .db 0b00111000,0b01000100
   .db 0b01001100,0b01010100
   .db 0b01010100,0b01001100
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   .db 0b11011100,0b00000000
;+--------------------------------------
;|ASC(66)='B' and ASC(67)='C'
;+--------------------------------------
   .db 0b11111000
      ,0b01000100
   .db 0b01000100
       0b01111000
   .db 0b01000100
      ,0b01000100
   .db 0b11111000
      ,0b00000000
   .db 0b01111000
      ,0b10001000
   .db 0b10000000
      ,0b10000000
   .db 0b10000000
      ,0b10001000
   .db 0b01110000
      ,0b00000000
;+--------------------------------------
;|ASC(68)='D' and ASC(69)='E'
;+--------------------------------------
   .db 0b11110000,0b01001000
   .db 0b01000100,0b01000100
   .db 0b01000100,0b01001000
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   .db 0b11111000,0b00000000
;+--------------------------------------
;|ASC(70)='F' and ASC(71)='G'
;+--------------------------------------
   .db 0b01111100,0b00100100
   .db 0b00101000,0b00111000
   .db 0b00101000,0b00100000
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   .db 0b01110000,0b00000000
;+--------------------------------------
;|ASC(72)='H' and ASC(73)='I'
;+--------------------------------------
   .db 0b11101110,0b01000100
   .db 0b01000100,0b01111100
   .db 0b01000100,0b01000100
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   .db 0b11111000,0b00000000
;+--------------------------------------
;|ASC(74)='J' and ASC(75)='K'
;+--------------------------------------
   .db 0b00111100,0b00001000
   .db 0b00001000,0b00001000
   .db 0b01001000,0b01001000
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   .db 0b11001100,0b00000000
;+--------------------------------------
;|ASC(76)='L' and ASC(77)='M'
;+--------------------------------------
   .db 0b01110000,0b00100000
   .db 0b00100000,0b00100000
   .db 0b00100100,0b00100100
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   .db 0b11011100,0b00000000
;+--------------------------------------
;|ASC(78)='N' and ASC(79)='O'
;+--------------------------------------
   .db 0b11101110,0b01100100
   .db 0b01100100,0b01010100
   .db 0b01010100,0b01001100
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   .db 0b01110000,0b00000000
;+--------------------------------------
;|ASC(80)='P' and ASC(81)='Q'
;+--------------------------------------
   .db 0b01111000,0b00100100
   .db 0b00100100,0b00100100
   .db 0b00111000,0b00100000
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   .db 0b01110000,0b00111000
;+--------------------------------------
;|ASC(82)='R' and ASC(83)='S'
;+--------------------------------------
   .db 0b01111000,0b00100100
   .db 0b00100100,0b00100100
   .db 0b00111000,0b00100100
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   .db 0b11110000,0b00000000
;+--------------------------------------
;|ASC(84)='T' and ASC(85)='U'
;+--------------------------------------
   .db 0b01111100,0b01010100
   .db 0b00010000,0b00010000
   .db 0b00010000,0b00010000
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   .db 0b01110000,0b00000000
;+--------------------------------------
;|ASC(86)='V' and ASC(87)='W'
;+--------------------------------------
   .db 0b11101110,0b01000100
   .db 0b01000100,0b01001000
   .db 0b00101000,0b00101000
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   .db 0b01010000,0b00000000
;+--------------------------------------
;|ASC(88)='X' and ASC(89)='Y'
;+--------------------------------------
   .db 0b11000110,0b01000100
   .db 0b00101000,0b00010000
   .db 0b00101000,0b01000100
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   .db 0b01110000,0b00000000
;+--------------------------------------
;|ASC(90)='Z' and ASC(91)='['
;+--------------------------------------
   .db 0b01111100,0b01000100
   .db 0b00001000,0b00010000
   .db 0b00100000,0b01000100
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   .db 0b00100000,0b00110000
;+--------------------------------------
;|ASC(92)='\' and ASC(93)=']'
;+--------------------------------------
   .db 0b01000000,0b00100000
   .db 0b00100000,0b00010000
   .db 0b00010000,0b00010000
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   .db 0b00100000,0b01100000
;+--------------------------------------
;|ASC(94)='^' and ASC(95)='_'
;+--------------------------------------
   .db 0b00010000,0b00101000
   .db 0b01000100,0b00000000
   .db 0b00000000,0b00000000
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   .db 0b00000000,0b00000000
;+--------------------------------------
;|ASC(96)='`' and ASC(97)='a'
;+--------------------------------------
   .db 0b00100000,0b00010000
   .db 0b00000000,0b00000000
   .db 0b00000000,0b00000000
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   .db 0b11111100,0b00000000
;+--------------------------------------
;|ASC(98)='b' and ASC(99)='c'
;+--------------------------------------
   .db 0b11000000,0b01000000
   .db 0b01011000,0b01100100
   .db 0b01000100,0b01000100
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   .db 0b01111000,0b00000000
;+--------------------------------------
;|ASC(100)='d' and ASC(101)='e'
;+--------------------------------------
   .db 0b00001100,0b00000100
   .db 0b00110100,0b01001100
   .db 0b01000100,0b01000100
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   .db 0b01111000,0b00000000
;+--------------------------------------
;|ASC(102)='f' and ASC(103)='g'
;+--------------------------------------
   .db 0b00001100,0b00010000
   .db 0b00111100,0b00010000
   .db 0b00010000,0b00010000
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   .db 0b01111000,0b00001000
;+--------------------------------------
;|ASC(104)='h' and ASC(105)='i'
;+--------------------------------------
   .db 0b11000000,0b01000000
   .db 0b01011000,0b01100100
   .db 0b01000100,0b01000100
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   .db 0b11111000,0b00000000
;+--------------------------------------
;|ASC(106)='j' and ASC(107)='k'
;+--------------------------------------
   .db 0b00010000,0b00000000
   .db 0b01111000,0b00001000
   .db 0b00001000,0b00001000
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   .db 0b10111000,0b00000000
;+--------------------------------------
;|ASC(108)='l' and ASC(109)='m'
;+--------------------------------------
   .db 0b00110000,0b00010000
   .db 0b00010000,0b00010000
   .db 0b00010000,0b00010000
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   .db 0b11111100,0b00000000
;+--------------------------------------
;|ASC(110)='n' and ASC(111)='o'
;+--------------------------------------
   .db 0b00000000,0b00000000
   .db 0b11011000,0b01100100
   .db 0b01000100,0b01000100
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   .db 0b01110000,0b00000000
;+--------------------------------------
;|ASC(112)='p' and ASC(113)='q'
;+--------------------------------------
   .db 0b00000000,0b00000000
   .db 0b11011000,0b01100100
   .db 0b01000100,0b01000100
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   .db 0b01111000,0b00001000
;+--------------------------------------
;|ASC(114)='r' and ASC(115)='s'
;+--------------------------------------
   .db 0b00000000,0b00000000
   .db 0b01101100,0b00110000
   .db 0b00100000,0b00100000
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   .db 0b11110000,0b00000000
;+--------------------------------------
;|ASC(116)='t' and ASC(117)='u'
;+--------------------------------------
   .db 0b00000000,0b01000000
   .db 0b11111000,0b01000000
   .db 0b01000000,0b01000100
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   .db 0b01101100,0b00000000
;+--------------------------------------
;|ASC(118)='v' and ASC(119)='w'
;+--------------------------------------
   .db 0b00000000,0b00000000
   .db 0b11101110,0b01000100
   .db 0b01001000,0b00101000
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   .db 0b01010000,0b00000000
;+--------------------------------------
;|ASC(120)='x' and ASC(121)='y'
;+--------------------------------------
   .db 0b00000000,0b00000000
   .db 0b01101100,0b00101000
   .db 0b00010000,0b00101000
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   .db 0b00100000,0b00100000
;+--------------------------------------
;|ASC(122)='z' and ASC(123)='{'
;+--------------------------------------
   .db 0b00000000,0b00000000
   .db 0b01111100,0b01001000
   .db 0b00010000,0b00100100
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   .db 0b00100000,0b00100000
;+--------------------------------------
;|ASC(124)='|' and ASC(125)='}'
;+--------------------------------------
   .db 0b00010000,0b00010000
   .db 0b00010000,0b00010000
   .db 0b00010000,0b00010000
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   .db 0b00100000,0b00100000
;+--------------------------------------
;|ASC(126)='~' and ASC(127)=''
;+--------------------------------------
   .db 0b00000000,0b00000000
   .db 0b00000000,0b00110100
   .db 0b01011000,0b00000000
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   .db 0b11111000,0b00000000
