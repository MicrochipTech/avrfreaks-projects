.db 158,93,48,47,87,145,202,228,219,195,166,143,141,155,169,182,186,176,159,143,135,145,170,201,221,207,161,97,32,1,25,90,175,238,244,203,141,78,43,55,101,161,212,227,213,188,159,141,144,159,172,184,185,172,155,140,137,152,179,208,220,197,145,79,20,4,41,114,197,245,234,186,124,65,42,65,116,176,219,225,207,180,153,140,148,162,176,185,182,168,151,137,138,157,186,214,217,184,127,60,10,9,58,137,215,247,224,170,106,54,44,78,134,193,226,223,201,173,148,141,153,167,180,187,179,163,146,135,141,164,195,219,212,171,109,41,2,17,77,162,232,247,211,153,88,45,50,93,153,208,229,217,191,162,142,143,157,172,184,186,175,157,140,133,145,172,205,223,205,156,89,24,0,29,100,186,244,241,196,132,70,41,59,110,172,219,228,209,182,154,140,148,164,178,188,185,169,150,135,134,152,183,214,223,194,137,67,10,2,47,125,209,249,231,177,111,56,41,72,128,188,225,224,201,173,147,140,152,168,181,188,180,162,144,133,138,161,193,220,219,180,118,48,3,12,68,152,227,250,217
