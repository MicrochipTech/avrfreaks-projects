.db 75,85,114,141,148,123,75,28,2,11,54,114,172,218,244,248,228,194,158,138,147,179,214,227,206,157,104,76,82,109,138,149,129,84,34,4,7,46,105,164,212,242,249,233,199,162,139,143,174,210,227,212,166,111,78,79,104,133,148,134,91,41,6,3,38,96,156,206,239,250,236,204,167,141,141,168,206,227,217,174,119,81,77,99,130,148,139,100,48,10,1,30,86,147,199,235,249,240,210,173,144,139,163,200,226,221,182,127,84,75,95,126,147,142,107,55,14,0,23,77,138,192,231,249,243,216,178,147,137,157,194,223,223,190,135,88,74,91,121,146,145,114,63,18,0,17,68,129,185,227,248,246,221,185,151,137,153,189,221,226,197,144,94,74,87,116,143,147,120,71,25,1,13,59,119,176,221,246,248,226,191,155,138,149,183,217,227,203,152,99
