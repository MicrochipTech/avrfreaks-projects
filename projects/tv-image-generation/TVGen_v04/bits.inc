.equ ________=$00
.equ o_______=$01
.equ _o______=$02
.equ oo______=$03
.equ __o_____=$04
.equ o_o_____=$05
.equ _oo_____=$06
.equ ooo_____=$07
.equ ___o____=$08
.equ o__o____=$09
.equ _o_o____=$0a
.equ oo_o____=$0b
.equ __oo____=$0c
.equ o_oo____=$0d
.equ _ooo____=$0e
.equ oooo____=$0f

.equ ____o___=$10
.equ o___o___=$11
.equ _o__o___=$12
.equ oo__o___=$13
.equ __o_o___=$14
.equ o_o_o___=$15
.equ _oo_o___=$16
.equ ooo_o___=$17
.equ ___oo___=$18
.equ o__oo___=$19
.equ _o_oo___=$1a
.equ oo_oo___=$1b
.equ __ooo___=$1c
.equ o_ooo___=$1d
.equ _oooo___=$1e
.equ ooooo___=$1f

.equ _____o__=$20
.equ o____o__=$21
.equ _o___o__=$22
.equ oo___o__=$23
.equ __o__o__=$24
.equ o_o__o__=$25
.equ _oo__o__=$26
.equ ooo__o__=$27
.equ ___o_o__=$28
.equ o__o_o__=$29
.equ _o_o_o__=$2a
.equ oo_o_o__=$2b
.equ __oo_o__=$2c
.equ o_oo_o__=$2d
.equ _ooo_o__=$2e
.equ oooo_o__=$2f

.equ ____oo__=$30
.equ o___oo__=$31
.equ _o__oo__=$32
.equ oo__oo__=$33
.equ __o_oo__=$34
.equ o_o_oo__=$35
.equ _oo_oo__=$36
.equ ooo_oo__=$37
.equ ___ooo__=$38
.equ o__ooo__=$39
.equ _o_ooo__=$3a
.equ oo_ooo__=$3b
.equ __oooo__=$3c
.equ o_oooo__=$3d
.equ _ooooo__=$3e
.equ oooooo__=$3f

.equ ______o_=$40
.equ o_____o_=$41
.equ _o____o_=$42
.equ oo____o_=$43
.equ __o___o_=$44
.equ o_o___o_=$45
.equ _oo___o_=$46
.equ ooo___o_=$47
.equ ___o__o_=$48
.equ o__o__o_=$49
.equ _o_o__o_=$4a
.equ oo_o__o_=$4b
.equ __oo__o_=$4c
.equ o_oo__o_=$4d
.equ _ooo__o_=$4e
.equ oooo__o_=$4f

.equ ____o_o_=$50
.equ o___o_o_=$51
.equ _o__o_o_=$52
.equ oo__o_o_=$53
.equ __o_o_o_=$54
.equ o_o_o_o_=$55
.equ _oo_o_o_=$56
.equ ooo_o_o_=$57
.equ ___oo_o_=$58
.equ o__oo_o_=$59
.equ _o_oo_o_=$5a
.equ oo_oo_o_=$5b
.equ __ooo_o_=$5c
.equ o_ooo_o_=$5d
.equ _oooo_o_=$5e
.equ ooooo_o_=$5f

.equ _____oo_=$60
.equ o____oo_=$61
.equ _o___oo_=$62
.equ oo___oo_=$63
.equ __o__oo_=$64
.equ o_o__oo_=$65
.equ _oo__oo_=$66
.equ ooo__oo_=$67
.equ ___o_oo_=$68
.equ o__o_oo_=$69
.equ _o_o_oo_=$6a
.equ oo_o_oo_=$6b
.equ __oo_oo_=$6c
.equ o_oo_oo_=$6d
.equ _ooo_oo_=$6e
.equ oooo_oo_=$6f

.equ ____ooo_=$70
.equ o___ooo_=$71
.equ _o__ooo_=$72
.equ oo__ooo_=$73
.equ __o_ooo_=$74
.equ o_o_ooo_=$75
.equ _oo_ooo_=$76
.equ ooo_ooo_=$77
.equ ___oooo_=$78
.equ o__oooo_=$79
.equ _o_oooo_=$7a
.equ oo_oooo_=$7b
.equ __ooooo_=$7c
.equ o_ooooo_=$7d
.equ _oooooo_=$7e
.equ ooooooo_=$7f



.equ _______o=$80
.equ o______o=$81
.equ _o_____o=$82
.equ oo_____o=$83
.equ __o____o=$84
.equ o_o____o=$85
.equ _oo____o=$86
.equ ooo____o=$87
.equ ___o___o=$88
.equ o__o___o=$89
.equ _o_o___o=$8a
.equ oo_o___o=$8b
.equ __oo___o=$8c
.equ o_oo___o=$80
.equ _ooo___o=$8e
.equ oooo___o=$8f

.equ ____o__o=$90
.equ o___o__o=$91
.equ _o__o__o=$92
.equ oo__o__o=$93
.equ __o_o__o=$94
.equ o_o_o__o=$95
.equ _oo_o__o=$96
.equ ooo_o__o=$97
.equ ___oo__o=$98
.equ o__oo__o=$99
.equ _o_oo__o=$9a
.equ oo_oo__o=$9b
.equ __ooo__o=$9c
.equ o_ooo__o=$9d
.equ _oooo__o=$9e
.equ ooooo__o=$9f

.equ _____o_o=$a0
.equ o____o_o=$a1
.equ _o___o_o=$a2
.equ oo___o_o=$a3
.equ __o__o_o=$a4
.equ o_o__o_o=$a5
.equ _oo__o_o=$a6
.equ ooo__o_o=$a7
.equ ___o_o_o=$a8
.equ o__o_o_o=$a9
.equ _o_o_o_o=$aa
.equ oo_o_o_o=$ab
.equ __oo_o_o=$ac
.equ o_oo_o_o=$ad
.equ _ooo_o_o=$ae
.equ oooo_o_o=$af

.equ ____oo_o=$b0
.equ o___oo_o=$b1
.equ _o__oo_o=$b2
.equ oo__oo_o=$b3
.equ __o_oo_o=$b4
.equ o_o_oo_o=$b5
.equ _oo_oo_o=$b6
.equ ooo_oo_o=$b7
.equ ___ooo_o=$b8
.equ o__ooo_o=$b9
.equ _o_ooo_o=$ba
.equ oo_ooo_o=$bb
.equ __oooo_o=$bc
.equ o_oooo_o=$bd
.equ _ooooo_o=$be
.equ oooooo_o=$bf

.equ ______oo=$c0
.equ o_____oo=$c1
.equ _o____oo=$c2
.equ oo____oo=$c3
.equ __o___oo=$c4
.equ o_o___oo=$c5
.equ _oo___oo=$c6
.equ ooo___oo=$c7
.equ ___o__oo=$c8
.equ o__o__oo=$c9
.equ _o_o__oo=$ca
.equ oo_o__oo=$cb
.equ __oo__oo=$cc
.equ o_oo__oo=$cd
.equ _ooo__oo=$ce
.equ oooo__oo=$cf

.equ ____o_oo=$d0
.equ o___o_oo=$d1
.equ _o__o_oo=$d2
.equ oo__o_oo=$d3
.equ __o_o_oo=$d4
.equ o_o_o_oo=$d5
.equ _oo_o_oo=$d6
.equ ooo_o_oo=$d7
.equ ___oo_oo=$d8
.equ o__oo_oo=$d9
.equ _o_oo_oo=$da
.equ oo_oo_oo=$db
.equ __ooo_oo=$dc
.equ o_ooo_oo=$dd
.equ _oooo_oo=$de
.equ ooooo_oo=$df

.equ _____ooo=$e0
.equ o____ooo=$e1
.equ _o___ooo=$e2
.equ oo___ooo=$e3
.equ __o__ooo=$e4
.equ o_o__ooo=$e5
.equ _oo__ooo=$e6
.equ ooo__ooo=$e7
.equ ___o_ooo=$e8
.equ o__o_ooo=$e9
.equ _o_o_ooo=$ea
.equ oo_o_ooo=$eb
.equ __oo_ooo=$ec
.equ o_oo_ooo=$ed
.equ _ooo_ooo=$ee
.equ oooo_ooo=$ef

.equ ____oooo=$f0
.equ o___oooo=$f1
.equ _o__oooo=$f2
.equ oo__oooo=$f3
.equ __o_oooo=$f4
.equ o_o_oooo=$f5
.equ _oo_oooo=$f6
.equ ooo_oooo=$f7
.equ ___ooooo=$f8
.equ o__ooooo=$f9
.equ _o_ooooo=$fa
.equ oo_ooooo=$fb
.equ __oooooo=$fc
.equ o_oooooo=$fd
.equ _ooooooo=$fe
.equ oooooooo=$ff
