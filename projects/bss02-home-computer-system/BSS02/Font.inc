CHRTAB:
	.db	0x00,0x00,0x00,0x00,0x00,0x00,0x00,0x00 	; 00
	.db	0x00,0x00,0x00,0x00,0x00,0x00,0x00,0x00 	; 01
	.db	0x00,0x00,0x00,0x00,0x00,0x00,0x00,0x00 	; 02
	.db	0x00,0x00,0x00,0x00,0x00,0x00,0x00,0x00 	; 03
	.db	0x00,0x00,0x00,0x00,0x00,0x00,0x00,0x00 	; 04
	.db	0x00,0x00,0x00,0x00,0x00,0x00,0x00,0x00 	; 05
	.db	0x00,0x00,0x00,0x00,0x00,0x00,0x00,0x00 	; 06
	.db	0x00,0x00,0x00,0x00,0x00,0x00,0x00,0x00 	; 07
	.db	0x00,0x00,0x00,0x00,0x00,0x00,0x00,0x00 	; 08
	.db	0x00,0x00,0x00,0x00,0x00,0x00,0x00,0x00 	; 09
	.db	0x00,0x00,0x00,0x00,0x00,0x00,0x00,0x00 	; 0a
	.db	0x00,0x00,0x00,0x00,0x00,0x00,0x00,0x00 	; 0b
	.db	0x00,0x00,0x00,0x00,0x00,0x00,0x00,0x00 	; 0c
	.db	0x00,0x00,0x00,0x00,0x00,0x00,0x00,0x00 	; 0d
	.db	0x00,0x00,0x00,0x00,0x00,0x00,0x00,0x00 	; 0e
	.db	0x00,0x00,0x00,0x00,0x00,0x00,0x00,0x00 	; 0f
	.db	0x00,0xf0,0x0f,0xff,0x00,0xf0,0x0f,0xff 	; 10
	.db	0x00,0xf0,0x0f,0xff,0x00,0xf0,0x0f,0xff 	; 11
	.db	0x00,0xf0,0x0f,0xff,0x00,0xf0,0x0f,0xff 	; 12
	.db	0x00,0xf0,0x0f,0xff,0x00,0xf0,0x0f,0xff 	; 13
	.db	0x00,0xf0,0x0f,0xff,0x00,0xf0,0x0f,0xff 	; 14
	.db	0x00,0xf0,0x0f,0xff,0x00,0xf0,0x0f,0xff 	; 15
	.db	0x00,0xf0,0x0f,0xff,0x00,0xf0,0x0f,0xff 	; 16
	.db	0x00,0xf0,0x0f,0xff,0x00,0xf0,0x0f,0xff 	; 17
	.db	0x00,0x00,0x00,0x00,0x00,0x00,0x00,0x00 	; 18
	.db	0x00,0x00,0x00,0x00,0x00,0x00,0x00,0x00 	; 19
	.db	0x00,0x00,0x00,0x00,0x00,0x00,0x00,0x00 	; 1a
	.db	0x00,0x00,0x00,0x00,0x00,0x00,0x00,0x00 	; 1b
	.db	0x00,0x00,0x00,0x00,0x00,0x00,0x00,0x00 	; 1c
	.db	0x00,0x00,0x00,0x00,0x00,0x00,0x00,0x00 	; 1d
	.db	0x00,0x00,0x00,0x00,0x00,0x00,0x00,0x00 	; 1e
	.db	0x00,0x00,0x00,0x00,0x00,0x00,0x00,0x00 	; 1f
	.db	0x00,0xf8,0x20,0x08,0x40,0xf8,0x00,0x70 	; 20
	.db	0x20,0x00,0xf8,0x00,0x20,0x00,0x70,0x70 	; 21
	.db	0xf8,0x70,0x70,0x70,0x70,0x00,0x70,0x08 	; 22
	.db	0xf8,0x20,0x70,0x70,0xf8,0xf8,0xf8,0xf8 	; 23
	.db	0x00,0x20,0x50,0x50,0x20,0xc0,0x40,0x60 	; 24
	.db	0x10,0x40,0x20,0x00,0x00,0x00,0x00,0x00 	; 25
	.db	0x70,0x20,0x70,0x70,0x10,0xf8,0x30,0xf8 	; 26
	.db	0x70,0x70,0x00,0x60,0x10,0x00,0x40,0x70 	; 27
	.db	0x00,0x20,0xf0,0x70,0xf0,0xf8,0xf8,0x78 	; 28
	.db	0x88,0x70,0x08,0x88,0x80,0x88,0x88,0x70 	; 29
	.db	0xf0,0x70,0xf0,0x70,0xf8,0x88,0x88,0x88 	; 2a
	.db	0x88,0x88,0xf8,0x70,0x00,0x70,0x20,0x00 	; 2b
	.db	0x30,0x70,0x80,0x00,0x08,0x00,0x10,0x68 	; 2c
	.db	0x80,0x20,0x08,0x80,0x60,0x00,0x00,0x00 	; 2d
	.db	0xb0,0x68,0x00,0x00,0x20,0x00,0x00,0x00 	; 2e
	.db	0x00,0x88,0x00,0x10,0x20,0x40,0x40,0x50 	; 2f
	.db	0x00,0xf0,0x0f,0xff,0x00,0xf0,0x0f,0xff 	; 30
	.db	0x00,0xf0,0x0f,0xff,0x00,0xf0,0x0f,0xff 	; 31
	.db	0x00,0xf0,0x0f,0xff,0x00,0xf0,0x0f,0xff 	; 32
	.db	0x00,0xf0,0x0f,0xff,0x00,0xf0,0x0f,0xff 	; 33
	.db	0x00,0xf0,0x0f,0xff,0x00,0xf0,0x0f,0xff 	; 34
	.db	0x00,0xf0,0x0f,0xff,0x00,0xf0,0x0f,0xff 	; 35
	.db	0x00,0xf0,0x0f,0xff,0x00,0xf0,0x0f,0xff 	; 36
	.db	0x00,0xf0,0x0f,0xff,0x00,0xf0,0x0f,0xff 	; 37
	.db	0x00,0x00,0x08,0x1c,0x3c,0x3c,0x04,0x20 	; 38
	.db	0x00,0x3c,0x61,0x0c,0x06,0x16,0x2c,0x08 	; 39
	.db	0x00,0x40,0x20,0x24,0x00,0x08,0x00,0x00 	; 3a
	.db	0x00,0x00,0x00,0x00,0x08,0x00,0x49,0x00 	; 3b
	.db	0x1c,0x1e,0x00,0x7e,0x00,0x00,0x04,0x01 	; 3c
	.db	0x10,0x3f,0x1c,0x00,0x00,0x1e,0x22,0x3c 	; 3d
	.db	0x42,0x3e,0x08,0x3c,0x5f,0xff,0xfc,0x78 	; 3e
	.db	0x61,0x0e,0x1c,0x0e,0xff,0x08,0x08,0x08 	; 3f
	.db	0x00,0x80,0x20,0x08,0x20,0x88,0x08,0x88 	; 40
	.db	0x40,0x20,0x00,0x20,0xa8,0x20,0x88,0x88 	; 41
	.db	0x88,0xa8,0x88,0x88,0xa8,0x28,0x50,0x08 	; 42
	.db	0x88,0x20,0x88,0x88,0xa8,0x88,0x88,0xa8 	; 43
	.db	0x00,0x20,0x50,0x50,0x78,0xc8,0xa0,0x60 	; 44
	.db	0x20,0x20,0xa8,0x20,0x00,0x00,0x00,0x08 	; 45
	.db	0x88,0x60,0x88,0x88,0x30,0x80,0x40,0x08 	; 46
	.db	0x88,0x88,0x60,0x60,0x20,0x00,0x20,0x88 	; 47
	.db	0x88,0x50,0x48,0x88,0x48,0x80,0x80,0x80 	; 48
	.db	0x88,0x20,0x08,0x90,0x80,0xd8,0xc8,0x88 	; 49
	.db	0x88,0x88,0x88,0x88,0x20,0x88,0x88,0x88 	; 4a
	.db	0x88,0x88,0x08,0x40,0x80,0x10,0x50,0x00 	; 4b
	.db	0x30,0x08,0x80,0x00,0x08,0x00,0x28,0x98 	; 4c
	.db	0x80,0x00,0x00,0x80,0x20,0x00,0x00,0x00 	; 4d
	.db	0xc8,0x98,0x00,0x00,0x20,0x00,0x00,0x00 	; 4e
	.db	0x00,0x88,0x00,0x20,0x20,0x20,0xa8,0xa8 	; 4f
	.db	0x00,0xf0,0x0f,0xff,0x00,0xf0,0x0f,0xff 	; 50
	.db	0x00,0xf0,0x0f,0xff,0x00,0xf0,0x0f,0xff 	; 51
	.db	0x00,0xf0,0x0f,0xff,0x00,0xf0,0x0f,0xff 	; 52
	.db	0x00,0xf0,0x0f,0xff,0x00,0xf0,0x0f,0xff 	; 53
	.db	0x00,0xf0,0x0f,0xff,0x00,0xf0,0x0f,0xff 	; 54
	.db	0x00,0xf0,0x0f,0xff,0x00,0xf0,0x0f,0xff 	; 55
	.db	0x00,0xf0,0x0f,0xff,0x00,0xf0,0x0f,0xff 	; 56
	.db	0x00,0xf0,0x0f,0xff,0x00,0xf0,0x0f,0xff 	; 57
	.db	0x1c,0x36,0x1c,0x1c,0x42,0x42,0x08,0x10 	; 58
	.db	0x00,0x22,0x12,0x12,0x08,0x06,0x52,0x14 	; 59
	.db	0x20,0x48,0x10,0x24,0x00,0x1c,0x18,0x00 	; 5a
	.db	0x18,0x00,0x00,0x02,0x1c,0x00,0x2a,0x00 	; 5b
	.db	0x22,0x10,0x08,0x20,0x32,0x00,0x08,0x02 	; 5c
	.db	0x08,0x52,0x22,0x00,0x02,0x20,0x55,0x42 	; 5d
	.db	0x24,0x4a,0x1c,0x7a,0x60,0x04,0x02,0x44 	; 5e
	.db	0x82,0x06,0x22,0x08,0xe3,0x14,0x14,0x14 	; 5f
	.db	0x00,0x80,0x20,0x08,0x10,0xd8,0x10,0x88 	; 60
	.db	0xf0,0x10,0x00,0x20,0x70,0x40,0xd8,0x88 	; 61
	.db	0x88,0xa8,0x88,0x88,0xa8,0x10,0x50,0x08 	; 62
	.db	0x50,0x70,0x80,0x88,0xa8,0x88,0x88,0xa8 	; 63
	.db	0x00,0x20,0x50,0xf8,0xa0,0x10,0xa0,0x40 	; 64
	.db	0x40,0x10,0x70,0x20,0x00,0x00,0x00,0x10 	; 65
	.db	0x98,0x20,0x08,0x08,0x50,0xf0,0x80,0x10 	; 66
	.db	0x88,0x88,0x60,0x00,0x40,0xf8,0x10,0x08 	; 67
	.db	0x08,0x88,0x48,0x80,0x48,0x80,0x80,0x80 	; 68
	.db	0x88,0x20,0x08,0xa0,0x80,0xa8,0xa8,0x88 	; 69
	.db	0x88,0x88,0x88,0x80,0x20,0x88,0x88,0x88 	; 6a
	.db	0x50,0x50,0x10,0x40,0x40,0x10,0x88,0x00 	; 6b
	.db	0x20,0x78,0xb0,0x70,0x68,0x70,0x20,0x98 	; 6c
	.db	0xb0,0x60,0x08,0x90,0x20,0xd0,0xb0,0x70 	; 6d
	.db	0x88,0x88,0xb0,0x78,0xf8,0x88,0x88,0x88 	; 6e
	.db	0x88,0x88,0xf8,0x20,0x20,0x20,0x10,0x50 	; 6f
	.db	0x00,0xf0,0x0f,0xff,0x00,0xf0,0x0f,0xff 	; 70
	.db	0x00,0xf0,0x0f,0xff,0x00,0xf0,0x0f,0xff 	; 71
	.db	0x00,0xf0,0x0f,0xff,0x00,0xf0,0x0f,0xff 	; 72
	.db	0x00,0xf0,0x0f,0xff,0x00,0xf0,0x0f,0xff 	; 73
	.db	0x00,0xf0,0x0f,0xff,0x00,0xf0,0x0f,0xff 	; 74
	.db	0x00,0xf0,0x0f,0xff,0x00,0xf0,0x0f,0xff 	; 75
	.db	0x00,0xf0,0x0f,0xff,0x00,0xf0,0x0f,0xff 	; 76
	.db	0x00,0xf0,0x0f,0xff,0x00,0xf0,0x0f,0xff 	; 77
	.db	0x3e,0x7f,0x3e,0x08,0xa5,0xa5,0x10,0x08 	; 78
	.db	0x39,0x3c,0x14,0x10,0x10,0x08,0x12,0x22 	; 79
	.db	0x20,0x50,0x10,0x24,0x32,0x20,0x24,0x3e 	; 7a
	.db	0x24,0x3e,0x3e,0x64,0x2a,0x62,0x2a,0x22 	; 7b
	.db	0x41,0x10,0x00,0x10,0x4c,0x08,0x10,0x7f 	; 7c
	.db	0x04,0x24,0x41,0x36,0x04,0x1c,0x2a,0x9d 	; 7d
	.db	0x18,0x4a,0x2a,0xa5,0x63,0x03,0xfc,0x44 	; 7e
	.db	0x84,0x0a,0x22,0x08,0xdd,0x08,0x08,0x22 	; 7f
	.db	0x00,0x80,0x20,0x08,0x78,0xa8,0xa0,0xf8 	; 80
	.db	0x48,0xf8,0xf8,0xa8,0x20,0xf8,0xa8,0xa8 	; 81
	.db	0xf8,0xb8,0xb8,0xe8,0xe8,0xa8,0x50,0xf8 	; 82
	.db	0x20,0x70,0x40,0xf8,0xe8,0xe8,0xb8,0xb8 	; 83
	.db	0x00,0x20,0x00,0x50,0x70,0x20,0x40,0x80 	; 84
	.db	0x40,0x10,0xf8,0xf8,0x60,0xf8,0x00,0x20 	; 85
	.db	0xa8,0x20,0x70,0x30,0x90,0x08,0xf0,0x20 	; 86
	.db	0x70,0x78,0x00,0x60,0x80,0x00,0x08,0x10 	; 87
	.db	0x68,0x88,0x70,0x80,0x48,0xe0,0xe0,0x98 	; 88
	.db	0xf8,0x20,0x08,0xc0,0x80,0xa8,0x98,0x88 	; 89
	.db	0xf0,0x88,0xf0,0x70,0x20,0x88,0x50,0x88 	; 8a
	.db	0x20,0x20,0x20,0x40,0x20,0x10,0x00,0x00 	; 8b
	.db	0x10,0x88,0xc8,0x88,0x98,0x88,0x70,0x68 	; 8c
	.db	0xc8,0x20,0x08,0xa0,0x20,0xa8,0xc8,0x88 	; 8d
	.db	0xc8,0x98,0xc8,0x80,0x20,0x88,0x88,0x88 	; 8e
	.db	0x50,0x78,0x10,0x40,0x00,0x10,0x00,0xa8 	; 8f
	.db	0x00,0x00,0x00,0x00,0xf0,0xf0,0xf0,0xf0 	; 90
	.db	0x0f,0x0f,0x0f,0x0f,0xff,0xff,0xff,0xff 	; 91
	.db	0x00,0x00,0x00,0x00,0xf0,0xf0,0xf0,0xf0 	; 92
	.db	0x0f,0x0f,0x0f,0x0f,0xff,0xff,0xff,0xff 	; 93
	.db	0x00,0x00,0x00,0x00,0xf0,0xf0,0xf0,0xf0 	; 94
	.db	0x0f,0x0f,0x0f,0x0f,0xff,0xff,0xff,0xff 	; 95
	.db	0x00,0x00,0x00,0x00,0xf0,0xf0,0xf0,0xf0 	; 96
	.db	0x0f,0x0f,0x0f,0x0f,0xff,0xff,0xff,0xff 	; 97
	.db	0x7f,0x7f,0x7f,0x6b,0x81,0x81,0x20,0x04 	; 98
	.db	0x46,0x22,0x18,0x0c,0x3e,0x10,0x12,0x3e 	; 99
	.db	0x20,0x60,0x10,0x24,0x12,0x18,0x42,0x54 	; 9a
	.db	0x24,0x48,0x48,0x24,0x2a,0x14,0x1c,0x41 	; 9b
	.db	0x41,0x10,0x3e,0x0c,0x00,0x14,0x10,0x08 	; 9c
	.db	0x3e,0x08,0x41,0x49,0x48,0x22,0x14,0xa1 	; 9d
	.db	0x24,0x3a,0x28,0xa5,0x62,0xfc,0x00,0x78 	; 9e
	.db	0x68,0x70,0x22,0x0e,0xf3,0x1c,0x1c,0x22 	; 9f
	.db	0x00,0x80,0x20,0x08,0x20,0xd8,0xc0,0x50 	; a0
	.db	0x28,0x10,0x00,0x70,0xa8,0x40,0xd8,0x88 	; a1
	.db	0x88,0x88,0xa8,0xa8,0x88,0xc0,0x50,0x08 	; a2
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	.db	0x49,0x60,0x1c,0x00,0xf7,0x14,0x3e,0x36 	; ff
