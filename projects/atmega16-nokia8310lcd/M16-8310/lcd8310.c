/*
 _   _    ___    _  __  ___      _           ___    ____   _    ___         _       ____   ____
| \ | |  / _ \  | |/ / |_ _|    / \         / _ \  |__  | / |  / _ \       | |     / ___| |  _ \
|  \| | | | | | | ' /   | |    / _ \       | |_| |  __| | | | | | | |      | |    | |     | | | |
| |\  | | |_| | | . \   | |   / ___ \      | |_| |  __| | | | | |_| |      | |___ | |___  | |_| |
|_| \_|  \___/  |_|\_\ |___| /_/   \_\      \___/  |____| |_|  \___/       |_____| \____| |____/



ATMEGA16 to Nokia 8310 LCD Interface

File: lcd8310.c

*/
#include <avr/pgmspace.h>
#include <util/delay.h>
#include "lcd8310.h"
unsigned char bitaddr;
// lookup table, here you can modify the font
unsigned char FontLookup[96][5] PROGMEM={
{0x00, 0x00, 0x00, 0x00, 0x00},// (space)
{0x00, 0x00, 0x5F, 0x00, 0x00},// !
{0x00, 0x07, 0x00, 0x07, 0x00},// "
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{0x00, 0x41, 0x36, 0x08, 0x00},// }
//{0x08, 0x08, 0x2A, 0x1C, 0x08},// ->
{0x02, 0x01, 0x01, 0x02, 0x01},// ~
{0x08, 0x1C, 0x2A, 0x08, 0x08} // <-
};

unsigned char pic[448] PROGMEM = {
		0x00,0x00,0x00,0x00,0x00,0x00,0x00,0x00,0x00,0x00,0x00,0x00,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0x00,
		0x00,0x00,0x00,0x80,0xC0,0xF0,0xF8,0xFC,0xFE,0xFF,0xFF,0x7F,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0x1F,
		0x3F,0x3F,0x7E,0x7C,0x7C,0x7C,0x7C,0x7E,0x7F,0x3F,0x1F,0x0F,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0xE0,
		0xC0,0x80,0x00,0x00,0x00,0x00,0x00,0x00,0x00,0x00,0x00,0x00,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0xC0,
		0x00,0x00,0x00,0x00,0x00,0x00,0x00,0x00,0x00,0x00,0x00,0x00,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0x00,
		0x00,0x00,0x00,0x00,0x00,0x00,0x00,0x00,0x00,0x00,0x00,0x00,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0x00,
		0x00,0x00,0x00,0x00,0x00,0x00,0x00,0x00,0x10,0x7E,0x7F,0x3F,0x3F,0x1F,0x03,0x00,0x00,0x00,0x00,0x00,0x00,0x00,0x00,0x00,0x00,0x00,0x00,0x00,0x00,0x00,0x00,0x00,0x00,0x00,0x00,0x00,0x00,0x00,0x00,0x00,0x7F,0xFF,0xFF,0xFF,0x30,0x00,0x00,0x00,0x00,0x00,0x00,0x00,0x00,0x00,0x00,0x00,0x00,0x00,0x00,0x00,0x00,0x00,0x00,0x00/*"C:\Documents and Settings\chenrain\桌面\shoot.bmp",0*/
};

void delay_ms(unsigned int ms)
{
	for(;ms > 0;ms--)
	{
		_delay_ms(1);
	}
}

// clear LCD
void Lcd_Clear(void)
{
	unsigned int i;
	Lcd_Write(CMD,0x40); // Y = 0
	Lcd_Write(CMD,0xb0);
	Lcd_Write(CMD,0x10); // X = 0
	Lcd_Write(CMD,0x0);
	Lcd_Write(CMD,0xae); // disable display;
	for(i=0;i<864;i++)
	Lcd_Write(DATA,0x00);
	Lcd_Write(CMD,0xaf); // enable display;
}

void display_pic(void)
{
	unsigned char i,j;
	for(i = 0;i < 8;i++)
	{
		Gotoxy(20,i);
		for(j = 0;j < 56;j++)
		{
			Lcd_Write(DATA,pgm_read_byte(pic + j + i * 56));
		}
	}
}

// init LCD
void Lcd_Init(void)
{
	clr(LCD_PORT,CS);
	
	clr(LCD_PORT,RES);
	delay_ms(5);			// 5mS so says the stop watch(less than 5ms will not work)
	set(LCD_PORT,RES);
	
	Lcd_Write(CMD,0x23); // write VOP register
	Lcd_Write(CMD,0x90);
	Lcd_Write(CMD,0xA4); // all on/normal display
	Lcd_Write(CMD,0x2F); // Power control set(charge pump on/off)
	Lcd_Write(CMD,0x40); // set start row address = 0
	Lcd_Write(CMD,0xb0); // set Y-address = 0
	Lcd_Write(CMD,0x10); // set X-address, upper 3 bits
	Lcd_Write(CMD,0x0);  // set X-address, lower 4 bits
	Lcd_Write(CMD,0xC0); // mirror Y axis (about X axis)
	Lcd_Write(CMD,0xa1); // Invert screen in horizontal axis
	Lcd_Write(CMD,0xac); // set initial row (R0) of the display
	Lcd_Write(CMD,0x07);
	//Lcd_Write(CMD,0xF9); //
	Lcd_Write(CMD,0xaf); // display ON/OFF
	
	
	Lcd_Write(CMD,0xae); // disable display;
	Lcd_Clear(); // clear LCD
	display_pic();
	Lcd_Write(CMD,0xaf); // disable display;
//	Lcd_Write(CMD,0xa7); // invert display
	delay_ms(3000);				// 1/2 Sec delay
	Lcd_Write(CMD,0xa6); // normal display (non inverted)
	Lcd_Clear(); // clear LCD
//	delay_ms(500);				// 1 Sec delay
}


void Lcd_Write(unsigned char cd,unsigned char c)
{
	unsigned char i;
	clr(LCD_PORT,CS);
	
//	发送D/C状态数据
	clr(LCD_PORT,SCLK);
	if(cd == CMD)
	{
		clr(LCD_PORT,SDATA);
	}
	else
	{
		set(LCD_PORT,SDATA);
	}
	set(LCD_PORT,SCLK);

//	SPI发送8位数据
	SPCR = 0x5C;
	SPDR = c;
	while(!(SPSR & 0x80));
	set(LCD_PORT,CS);
	SPCR = 0x00;
}


void SetX(unsigned char x)
{
	Lcd_Write(CMD,0x10 | ((x>>4)&0x7));
	Lcd_Write(CMD,x & 0x0f);
}

void SetY(unsigned char y)
{
	char aux = 0;
	while(y>7)
	{
		y -=8;
		aux ++;
	}

	bitaddr = y-1;
	Lcd_Write(CMD,0xB0 | (aux & 0x0f));
}

void Gotoxy(unsigned char x,unsigned char y)
{
		Lcd_Write(CMD,(0xB0|(y&0x0F)));		 // Y axis initialisation: 0100 yyyy
		Lcd_Write(CMD,(0x00|(x&0x0F)));		 // X axis initialisation: 0000 xxxx ( x3 x2 x1 x0)
		Lcd_Write(CMD,(0x10|((x>>4)&0x07))); // X axis initialisation: 0010 0xxx  ( x6 x5 x4)

}


//x dir >    y dir from last line to ^
void VLine(unsigned char x,unsigned char y,unsigned char on)
{
	unsigned char aux[8];
	unsigned char i;

	for(i=0;i<8;i++)
	{
		aux[i] = 0;
	}
	i = 7;
	while(y > 9)
	{
		aux[i] = 0xff;
		y -= 8;
		i--;
	}

	while(y > 0)
	{
		aux[i] >>= 1;
		aux[i] |= 0x80;
		y --;
	}

	for(y=0;y<8;y++)
	{
		Lcd_Write(CMD,0xB0 | y);
		SetX(x);
		Lcd_Write(DATA,aux[y]);
	}
}

// xdir is >       y is always < than y2  can be used for graphs
void Line(unsigned char x,unsigned char y,unsigned char y2,unsigned char on)
{
	unsigned char aux[8];
	unsigned char i = 0;
	unsigned char o = 0;
	unsigned char c=1;
	unsigned char index;



	for(i=0;i<8;i++)
	{
		aux[i] = 0;
	}


	index = 0;
	for(i=0;i<64;i++)
	{

		if(i >= y && i <= y2)
		{
			aux[index] |= c << o;
		}

		o ++;
		if(o == 8)
		{
			o = 0;
			index ++;
		}
	}


	for(i=0;i<8;i++)
	{
		Lcd_Write(CMD,0xB0 | i);
		SetX(x);
		Lcd_Write(DATA,aux[i]);
	}


}



void print_char(unsigned char c)
{
	unsigned int i;

    for ( i = 0; i < 5; i++ )
    {
		Lcd_Write(DATA,pgm_read_byte(&(FontLookup[c - 32][i])) << 1);
    }
    Lcd_Write(DATA,0x00);

}

void print_string(unsigned char * message)
{	// Write message to LCD (C string type)
//	Lcd_Write(CMD,0xae); // disable display;
	while (*message)
	{			// Look for end of string
		print_char(*message++);
	}
//	Lcd_Write(CMD,0xaf); // enable display;
}