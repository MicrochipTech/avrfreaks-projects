;##########################################################
;##          ##############################################
;## FONT 8x8 ##############################################
;##          ##############################################
;##########################################################

;Organization: Font8x8[ASCII_Code][8]

Font8x8: 

    ;  ..#####.   
    ;  .#.....#   
    ;  .#.###.#   
    ;  .#.###.#   
    ;  .#.##..#   
    ;  .#.#.#.#   
    ;  .#.....#   
    ;  ..#####.   
	.DB  $00, $7E, $81, $BD, $9D, $AD, $81, $7E

    ;  .######.   
    ;  #......#   
    ;  #.#..#.#   
    ;  #......#   
    ;  #.####.#   
    ;  #..##..#   
    ;  #......#   
    ;  .######.   
	.DB  $7E, $81, $95, $B1, $B1, $95, $81, $7E

    ;  .######.   
    ;  ########   
    ;  ##.##.##   
    ;  ########   
    ;  ##....##   
    ;  ###..###   
    ;  ########   
    ;  .######.   
	.DB  $7E, $FF, $EB, $CF, $CF, $EB, $FF, $7E

    ;  .##.##..   
    ;  #######.   
    ;  #######.   
    ;  #######.   
    ;  .#####..   
    ;  ..###...   
    ;  ...#....   
    ;  ........   
	.DB  $0E, $1F, $3F, $7E, $3F, $1F, $0E, $00

    ;  ....#...   
    ;  ...###..   
    ;  ..#####.   
    ;  .#######   
    ;  ..#####.   
    ;  ...###..   
    ;  ....#...   
    ;  ........   
	.DB  $00, $08, $1C, $3E, $7F, $3E, $1C, $08

    ;  ...###..   
    ;  ...###..   
    ;  ...###..   
    ;  .#######   
    ;  .#######   
    ;  .##.#.##   
    ;  ....#...   
    ;  ...###..   
	.DB  $00, $38, $38, $9F, $FF, $9F, $38, $38

    ;  ...#....   
    ;  ...#....   
    ;  ..###...   
    ;  .#####..   
    ;  #######.   
    ;  .#####..   
    ;  ...#....   
    ;  ..###...   
	.DB  $10, $38, $BC, $FF, $BC, $38, $10, $00

    ;  ........   
    ;  ........   
    ;  ...##...   
    ;  ..####..   
    ;  ..####..   
    ;  ...##...   
    ;  ........   
    ;  ........   
	.DB  $00, $00, $18, $3C, $3C, $18, $00, $00

    ;  ########   
    ;  ########   
    ;  ###..###   
    ;  ##....##   
    ;  ##....##   
    ;  ###..###   
    ;  ########   
    ;  ########   
	.DB  $FF, $FF, $E7, $C3, $C3, $E7, $FF, $FF

    ;  ........   
    ;  ..####..   
    ;  .##..##.   
    ;  .#....#.   
    ;  .#....#.   
    ;  .##..##.   
    ;  ..####..   
    ;  ........   
	.DB  $00, $3C, $66, $42, $42, $66, $3C, $00

    ;  ########   
    ;  ##....##   
    ;  #..##..#   
    ;  #.####.#   
    ;  #.####.#   
    ;  #..##..#   
    ;  ##....##   
    ;  ########   
	.DB  $FF, $C3, $99, $BD, $BD, $99, $C3, $FF

    ;  ....####   
    ;  .....###   
    ;  ....####   
    ;  .#####.#   
    ;  ##..##..   
    ;  ##..##..   
    ;  ##..##..   
    ;  .####...   
	.DB  $70, $F8, $88, $88, $FD, $7F, $07, $0F

    ;  ..####..   
    ;  .##..##.   
    ;  .##..##.   
    ;  .##..##.   
    ;  ..####..   
    ;  ...##...   
    ;  .######.   
    ;  ...##...   
	.DB  $00, $4E, $5F, $F1, $F1, $5F, $4E, $00

    ;  ..######   
    ;  ..##..##   
    ;  ..######   
    ;  ..##....   
    ;  ..##....   
    ;  .###....   
    ;  ####....   
    ;  ###.....   
	.DB  $C0, $E0, $FF, $7F, $05, $05, $07, $07

    ;  .#######   
    ;  .##...##   
    ;  .#######   
    ;  .##...##   
    ;  .##...##   
    ;  .##..###   
    ;  ###..##.   
    ;  ##......   
	.DB  $C0, $FF, $7F, $05, $05, $65, $7F, $3F

    ;  ...##...   
    ;  ##.##.##   
    ;  ..####..   
    ;  ###..###   
    ;  ###..###   
    ;  ..####..   
    ;  ##.##.##   
    ;  ...##...   
	.DB  $5A, $5A, $3C, $E7, $E7, $3C, $5A, $5A

    ;  #.......   
    ;  ###.....   
    ;  #####...   
    ;  #######.   
    ;  #####...   
    ;  ###.....   
    ;  #.......   
    ;  ........   
	.DB  $7F, $3E, $3E, $1C, $1C, $08, $08, $00

    ;  ......#.   
    ;  ....###.   
    ;  ..#####.   
    ;  #######.   
    ;  ..#####.   
    ;  ....###.   
    ;  ......#.   
    ;  ........   
	.DB  $08, $08, $1C, $1C, $3E, $3E, $7F, $00

    ;  ...##...   
    ;  ..####..   
    ;  .######.   
    ;  ...##...   
    ;  ...##...   
    ;  .######.   
    ;  ..####..   
    ;  ...##...   
	.DB  $00, $24, $66, $FF, $FF, $66, $24, $00

    ;  .##..##.   
    ;  .##..##.   
    ;  .##..##.   
    ;  .##..##.   
    ;  .##..##.   
    ;  ........   
    ;  .##..##.   
    ;  ........   
	.DB  $00, $5F, $5F, $00, $00, $5F, $5F, $00

    ;  .#######   
    ;  ##.##.##   
    ;  ##.##.##   
    ;  .####.##   
    ;  ...##.##   
    ;  ...##.##   
    ;  ...##.##   
    ;  ........   
	.DB  $06, $0F, $09, $7F, $7F, $01, $7F, $7F

    ;  ..#####.   
    ;  .##...##   
    ;  ..###...   
    ;  .##.##..   
    ;  .##.##..   
    ;  ..###...   
    ;  ##..##..   
    ;  .####...   
	.DB  $40, $DA, $BF, $A5, $FD, $59, $03, $02

    ;  ........   
    ;  ........   
    ;  ........   
    ;  ........   
    ;  .######.   
    ;  .######.   
    ;  .######.   
    ;  ........   
	.DB  $00, $70, $70, $70, $70, $70, $70, $00

    ;  ...##...   
    ;  ..####..   
    ;  .######.   
    ;  ...##...   
    ;  .######.   
    ;  ..####..   
    ;  ...##...   
    ;  ########   
	.DB  $80, $94, $B6, $FF, $FF, $B6, $94, $80

    ;  ...##...   
    ;  ..####..   
    ;  .######.   
    ;  ...##...   
    ;  ...##...   
    ;  ...##...   
    ;  ...##...   
    ;  ........   
	.DB  $00, $04, $06, $7F, $7F, $06, $04, $00

    ;  ...##...   
    ;  ...##...   
    ;  ...##...   
    ;  ...##...   
    ;  .######.   
    ;  ..####..   
    ;  ...##...   
    ;  ........   
	.DB  $00, $10, $30, $7F, $7F, $30, $10, $00

    ;  ........   
    ;  ...##...   
    ;  ....##..   
    ;  #######.   
    ;  ....##..   
    ;  ...##...   
    ;  ........   
    ;  ........   
	.DB  $08, $08, $08, $2A, $3E, $1C, $08, $00

    ;  ........   
    ;  ..##....   
    ;  .##.....   
    ;  #######.   
    ;  .##.....   
    ;  ..##....   
    ;  ........   
    ;  ........   
	.DB  $08, $1C, $3E, $2A, $08, $08, $08, $00

    ;  ........   
    ;  ........   
    ;  ##......   
    ;  ##......   
    ;  ##......   
    ;  #######.   
    ;  ........   
    ;  ........   
	.DB  $3C, $3C, $20, $20, $20, $20, $20, $00

    ;  ........   
    ;  ..#..#..   
    ;  .##..##.   
    ;  ########   
    ;  .##..##.   
    ;  ..#..#..   
    ;  ........   
    ;  ........   
	.DB  $08, $1C, $3E, $08, $08, $3E, $1C, $08

    ;  ........   
    ;  ...##...   
    ;  ..####..   
    ;  .######.   
    ;  ########   
    ;  ########   
    ;  ........   
    ;  ........   
	.DB  $30, $38, $3C, $3E, $3E, $3C, $38, $30

    ;  ........   
    ;  ########   
    ;  ########   
    ;  .######.   
    ;  ..####..   
    ;  ...##...   
    ;  ........   
    ;  ........   
	.DB  $06, $0E, $1E, $3E, $3E, $1E, $0E, $06

    ;  ........   
    ;  ........   
    ;  ........   
    ;  ........   
    ;  ........   
    ;  ........   
    ;  ........   
    ;  ........   
	.DB  $00, $00, $00, $00, $00, $00, $00, $00

    ;  ..##....   
    ;  .####...   
    ;  .####...   
    ;  ..##....   
    ;  ..##....   
    ;  ........   
    ;  ..##....   
    ;  ........   
	.DB  $00, $06, $5F, $5F, $06, $00, $00, $00

    ;  .##.##..   
    ;  .##.##..   
    ;  .##.##..   
    ;  ........   
    ;  ........   
    ;  ........   
    ;  ........   
    ;  ........   
	.DB  $00, $07, $07, $00, $07, $07, $00, $00

    ;  .##.##..   
    ;  .##.##..   
    ;  #######.   
    ;  .##.##..   
    ;  #######.   
    ;  .##.##..   
    ;  .##.##..   
    ;  ........   
	.DB  $14, $7F, $7F, $14, $7F, $7F, $14, $00

    ;  ...##...   
    ;  ..#####.   
    ;  .##.....   
    ;  ..####..   
    ;  .....##.   
    ;  .#####..   
    ;  ...##...   
    ;  ........   
	.DB  $00, $24, $2E, $6B, $6B, $3A, $12, $00

    ;  ........   
    ;  .##...##   
    ;  .##..##.   
    ;  ....##..   
    ;  ...##...   
    ;  ..##..##   
    ;  .##...##   
    ;  ........   
	.DB  $00, $46, $66, $30, $18, $0C, $66, $62

    ;  ...###..   
    ;  ..##.##.   
    ;  ...###..   
    ;  ..###.##   
    ;  .##.###.   
    ;  .##..##.   
    ;  ..###.##   
    ;  ........   
	.DB  $00, $30, $7A, $4F, $5D, $37, $7A, $48

    ;  ..##....   
    ;  ..##....   
    ;  .##.....   
    ;  ........   
    ;  ........   
    ;  ........   
    ;  ........   
    ;  ........   
	.DB  $00, $04, $07, $03, $00, $00, $00, $00

    ;  ....##..   
    ;  ...##...   
    ;  ..##....   
    ;  ..##....   
    ;  ..##....   
    ;  ...##...   
    ;  ....##..   
    ;  ........   
	.DB  $00, $00, $1C, $3E, $63, $41, $00, $00

    ;  ..##....   
    ;  ...##...   
    ;  ....##..   
    ;  ....##..   
    ;  ....##..   
    ;  ...##...   
    ;  ..##....   
    ;  ........   
	.DB  $00, $00, $41, $63, $3E, $1C, $00, $00

    ;  ........   
    ;  .##..##.   
    ;  ..####..   
    ;  ########   
    ;  ..####..   
    ;  .##..##.   
    ;  ........   
    ;  ........   
	.DB  $08, $2A, $3E, $1C, $1C, $3E, $2A, $08

    ;  ........   
    ;  ...##...   
    ;  ...##...   
    ;  .######.   
    ;  ...##...   
    ;  ...##...   
    ;  ........   
    ;  ........   
	.DB  $00, $08, $08, $3E, $3E, $08, $08, $00

    ;  ........   
    ;  ........   
    ;  ........   
    ;  ........   
    ;  ........   
    ;  ...##...   
    ;  ...##...   
    ;  ..##....   
	.DB  $00, $00, $80, $E0, $60, $00, $00, $00

    ;  ........   
    ;  ........   
    ;  ........   
    ;  .######.   
    ;  ........   
    ;  ........   
    ;  ........   
    ;  ........   
	.DB  $00, $08, $08, $08, $08, $08, $08, $00

    ;  ........   
    ;  ........   
    ;  ........   
    ;  ........   
    ;  ........   
    ;  ...##...   
    ;  ...##...   
    ;  ........   
	.DB  $00, $00, $00, $60, $60, $00, $00, $00

    ;  ......##   
    ;  .....##.   
    ;  ....##..   
    ;  ...##...   
    ;  ..##....   
    ;  .##.....   
    ;  .#......   
    ;  ........   
	.DB  $00, $60, $30, $18, $0C, $06, $03, $01

    ;  ..####..   
    ;  .##..##.   
    ;  .##..##.   
    ;  .##..##.   
    ;  .##..##.   
    ;  .##..##.   
    ;  ..####..   
    ;  ........   
	.DB  $00, $3E, $7F, $41, $41, $7F, $3E, $00

    ;  ...##...   
    ;  ..###...   
    ;  .#.##...   
    ;  ...##...   
    ;  ...##...   
    ;  ...##...   
    ;  .######.   
    ;  ........   
	.DB  $00, $44, $42, $7F, $7F, $40, $40, $00

    ;  ..####..   
    ;  .##..##.   
    ;  .....##.   
    ;  ...###..   
    ;  ..##....   
    ;  .##..##.   
    ;  .######.   
    ;  ........   
	.DB  $00, $62, $73, $59, $49, $6F, $66, $00

    ;  ..####..   
    ;  .##..##.   
    ;  .....##.   
    ;  ...###..   
    ;  .....##.   
    ;  .##..##.   
    ;  ..####..   
    ;  ........   
	.DB  $00, $22, $63, $49, $49, $7F, $36, $00

    ;  ....###.   
    ;  ...####.   
    ;  ..##.##.   
    ;  .##..##.   
    ;  .#######   
    ;  .....##.   
    ;  ....####   
    ;  ........   
	.DB  $00, $18, $1C, $16, $53, $7F, $7F, $50

    ;  .######.   
    ;  .##.....   
    ;  .#####..   
    ;  .....##.   
    ;  .....##.   
    ;  .##..##.   
    ;  ..####..   
    ;  ........   
	.DB  $00, $27, $67, $45, $45, $7D, $39, $00

    ;  ...###..   
    ;  ..##....   
    ;  .##.....   
    ;  .#####..   
    ;  .##..##.   
    ;  .##..##.   
    ;  ..####..   
    ;  ........   
	.DB  $00, $3C, $7E, $4B, $49, $79, $30, $00

    ;  .######.   
    ;  .##..##.   
    ;  .....##.   
    ;  ....##..   
    ;  ...##...   
    ;  ...##...   
    ;  ...##...   
    ;  ........   
	.DB  $00, $03, $03, $71, $79, $0F, $07, $00

    ;  ..####..   
    ;  .##..##.   
    ;  .##..##.   
    ;  ..####..   
    ;  .##..##.   
    ;  .##..##.   
    ;  ..####..   
    ;  ........   
	.DB  $00, $36, $7F, $49, $49, $7F, $36, $00

    ;  ..####..   
    ;  .##..##.   
    ;  .##..##.   
    ;  ..#####.   
    ;  .....##.   
    ;  ....##..   
    ;  ..###...   
    ;  ........   
	.DB  $00, $06, $4F, $49, $69, $3F, $1E, $00

    ;  ........   
    ;  ...##...   
    ;  ...##...   
    ;  ........   
    ;  ........   
    ;  ...##...   
    ;  ...##...   
    ;  ........   
	.DB  $00, $00, $00, $66, $66, $00, $00, $00

    ;  ........   
    ;  ...##...   
    ;  ...##...   
    ;  ........   
    ;  ........   
    ;  ...##...   
    ;  ...##...   
    ;  ..##....   
	.DB  $00, $00, $80, $E6, $66, $00, $00, $00

    ;  ....##..   
    ;  ...##...   
    ;  ..##....   
    ;  .##.....   
    ;  ..##....   
    ;  ...##...   
    ;  ....##..   
    ;  ........   
	.DB  $00, $08, $1C, $36, $63, $41, $00, $00

    ;  ........   
    ;  ........   
    ;  .######.   
    ;  ........   
    ;  ........   
    ;  .######.   
    ;  ........   
    ;  ........   
	.DB  $00, $24, $24, $24, $24, $24, $24, $00

    ;  ..##....   
    ;  ...##...   
    ;  ....##..   
    ;  .....##.   
    ;  ....##..   
    ;  ...##...   
    ;  ..##....   
    ;  ........   
	.DB  $00, $00, $41, $63, $36, $1C, $08, $00

    ;  ..####..   
    ;  .##..##.   
    ;  .....##.   
    ;  ....##..   
    ;  ...##...   
    ;  ........   
    ;  ...##...   
    ;  ........   
	.DB  $00, $02, $03, $51, $59, $0F, $06, $00

    ;  ..#####.   
    ;  .##...##   
    ;  .##.####   
    ;  .##.#..#   
    ;  .##.####   
    ;  .##.....   
    ;  ..#####.   
    ;  ........   
	.DB  $00, $3E, $7F, $41, $5D, $55, $57, $1E

    ;  ...##...   
    ;  ..####..   
    ;  .##..##.   
    ;  .##..##.   
    ;  .######.   
    ;  .##..##.   
    ;  .##..##.   
    ;  ........   
	.DB  $00, $7C, $7E, $13, $13, $7E, $7C, $00

    ;  .######.   
    ;  ..##..##   
    ;  ..##..##   
    ;  ..#####.   
    ;  ..##..##   
    ;  ..##..##   
    ;  .######.   
    ;  ........   
	.DB  $00, $41, $7F, $7F, $49, $49, $7F, $36

    ;  ...####.   
    ;  ..##..##   
    ;  .##.....   
    ;  .##.....   
    ;  .##.....   
    ;  ..##..##   
    ;  ...####.   
    ;  ........   
	.DB  $00, $1C, $3E, $63, $41, $41, $63, $22

    ;  .#####..   
    ;  ..##.##.   
    ;  ..##..##   
    ;  ..##..##   
    ;  ..##..##   
    ;  ..##.##.   
    ;  .#####..   
    ;  ........   
	.DB  $00, $41, $7F, $7F, $41, $63, $3E, $1C

    ;  .#######   
    ;  ..##...#   
    ;  ..##.#..   
    ;  ..####..   
    ;  ..##.#..   
    ;  ..##...#   
    ;  .#######   
    ;  ........   
	.DB  $00, $41, $7F, $7F, $49, $5D, $41, $63

    ;  .#######   
    ;  ..##...#   
    ;  ..##.#..   
    ;  ..####..   
    ;  ..##.#..   
    ;  ..##....   
    ;  .####...   
    ;  ........   
	.DB  $00, $41, $7F, $7F, $49, $1D, $01, $03

    ;  ...####.   
    ;  ..##..##   
    ;  .##.....   
    ;  .##.....   
    ;  .##..###   
    ;  ..##..##   
    ;  ...#####   
    ;  ........   
	.DB  $00, $1C, $3E, $63, $41, $51, $73, $72

    ;  .##..##.   
    ;  .##..##.   
    ;  .##..##.   
    ;  .######.   
    ;  .##..##.   
    ;  .##..##.   
    ;  .##..##.   
    ;  ........   
	.DB  $00, $7F, $7F, $08, $08, $7F, $7F, $00

    ;  ..####..   
    ;  ...##...   
    ;  ...##...   
    ;  ...##...   
    ;  ...##...   
    ;  ...##...   
    ;  ..####..   
    ;  ........   
	.DB  $00, $00, $41, $7F, $7F, $41, $00, $00

    ;  ....####   
    ;  .....##.   
    ;  .....##.   
    ;  .....##.   
    ;  .##..##.   
    ;  .##..##.   
    ;  ..####..   
    ;  ........   
	.DB  $00, $30, $70, $40, $41, $7F, $3F, $01

    ;  .###..##   
    ;  ..##..##   
    ;  ..##.##.   
    ;  ..####..   
    ;  ..##.##.   
    ;  ..##..##   
    ;  .###..##   
    ;  ........   
	.DB  $00, $41, $7F, $7F, $08, $1C, $77, $63

    ;  .####...   
    ;  ..##....   
    ;  ..##....   
    ;  ..##....   
    ;  ..##...#   
    ;  ..##..##   
    ;  .#######   
    ;  ........   
	.DB  $00, $41, $7F, $7F, $41, $40, $60, $70

    ;  .##...##   
    ;  .###.###   
    ;  .#######   
    ;  .#######   
    ;  .##.#.##   
    ;  .##...##   
    ;  .##...##   
    ;  ........   
	.DB  $00, $7F, $7F, $0E, $1C, $0E, $7F, $7F

    ;  .##...##   
    ;  .###..##   
    ;  .####.##   
    ;  .##.####   
    ;  .##..###   
    ;  .##...##   
    ;  .##...##   
    ;  ........   
	.DB  $00, $7F, $7F, $06, $0C, $18, $7F, $7F

    ;  ..#####.   
    ;  .##...##   
    ;  .##...##   
    ;  .##...##   
    ;  .##...##   
    ;  .##...##   
    ;  ..#####.   
    ;  ........   
	.DB  $00, $3E, $7F, $41, $41, $41, $7F, $3E

    ;  .######.   
    ;  ..##..##   
    ;  ..##..##   
    ;  ..#####.   
    ;  ..##....   
    ;  ..##....   
    ;  .####...   
    ;  ........   
	.DB  $00, $41, $7F, $7F, $49, $09, $0F, $06

    ;  ..####..   
    ;  .##..##.   
    ;  .##..##.   
    ;  .##..##.   
    ;  .##.###.   
    ;  ..####..   
    ;  ....###.   
    ;  ........   
	.DB  $00, $1E, $3F, $21, $71, $7F, $5E, $00

    ;  .######.   
    ;  ..##..##   
    ;  ..##..##   
    ;  ..#####.   
    ;  ..##.##.   
    ;  ..##..##   
    ;  .###..##   
    ;  ........   
	.DB  $00, $41, $7F, $7F, $09, $19, $7F, $66

    ;  ..####..   
    ;  .##..##.   
    ;  ..##....   
    ;  ...##...   
    ;  ....##..   
    ;  .##..##.   
    ;  ..####..   
    ;  ........   
	.DB  $00, $22, $67, $4D, $59, $73, $22, $00

    ;  .######.   
    ;  .#.##.#.   
    ;  ...##...   
    ;  ...##...   
    ;  ...##...   
    ;  ...##...   
    ;  ..####..   
    ;  ........   
	.DB  $00, $03, $41, $7F, $7F, $41, $03, $00

    ;  .##..##.   
    ;  .##..##.   
    ;  .##..##.   
    ;  .##..##.   
    ;  .##..##.   
    ;  .##..##.   
    ;  .######.   
    ;  ........   
	.DB  $00, $7F, $7F, $40, $40, $7F, $7F, $00

    ;  .##..##.   
    ;  .##..##.   
    ;  .##..##.   
    ;  .##..##.   
    ;  .##..##.   
    ;  ..####..   
    ;  ...##...   
    ;  ........   
	.DB  $00, $1F, $3F, $60, $60, $3F, $1F, $00

    ;  .##...##   
    ;  .##...##   
    ;  .##...##   
    ;  .##.#.##   
    ;  .#######   
    ;  .###.###   
    ;  .##...##   
    ;  ........   
	.DB  $00, $7F, $7F, $30, $18, $30, $7F, $7F

    ;  .##...##   
    ;  .##...##   
    ;  ..##.##.   
    ;  ...###..   
    ;  ...###..   
    ;  ..##.##.   
    ;  .##...##   
    ;  ........   
	.DB  $00, $43, $67, $3C, $18, $3C, $67, $43

    ;  .##..##.   
    ;  .##..##.   
    ;  .##..##.   
    ;  ..####..   
    ;  ...##...   
    ;  ...##...   
    ;  ..####..   
    ;  ........   
	.DB  $00, $07, $4F, $78, $78, $4F, $07, $00

    ;  .#######   
    ;  .##...##   
    ;  .#...##.   
    ;  ....##..   
    ;  ...##..#   
    ;  ..##..##   
    ;  .#######   
    ;  ........   
	.DB  $00, $47, $63, $71, $59, $4D, $67, $73

    ;  ..####..   
    ;  ..##....   
    ;  ..##....   
    ;  ..##....   
    ;  ..##....   
    ;  ..##....   
    ;  ..####..   
    ;  ........   
	.DB  $00, $00, $7F, $7F, $41, $41, $00, $00

    ;  .##.....   
    ;  ..##....   
    ;  ...##...   
    ;  ....##..   
    ;  .....##.   
    ;  ......##   
    ;  .......#   
    ;  ........   
	.DB  $00, $01, $03, $06, $0C, $18, $30, $60

    ;  ..####..   
    ;  ....##..   
    ;  ....##..   
    ;  ....##..   
    ;  ....##..   
    ;  ....##..   
    ;  ..####..   
    ;  ........   

	.DB  $00, $00, $41, $41, $7F, $7F, $00, $00
    ;  ....#...   
    ;  ...###..   
    ;  ..##.##.   
    ;  .##...##   
    ;  ........   
    ;  ........   
    ;  ........   
    ;  ........   

	.DB  $00, $08, $0C, $06, $03, $06, $0C, $08
    ;  ........   
    ;  ........   
    ;  ........   
    ;  ........   
    ;  ........   
    ;  ........   
    ;  ........   
    ;  ########   

	.DB  $80, $80, $80, $80, $80, $80, $80, $80
    ;  ...##...   
    ;  ...##...   
    ;  ....##..   
    ;  ........   
    ;  ........   
    ;  ........   
    ;  ........   
    ;  ........   

	.DB  $00, $00, $00, $03, $07, $04, $00, $00
    ;  ........   
    ;  ........   
    ;  ..####..   
    ;  .....##.   
    ;  ..#####.   
    ;  .##..##.   
    ;  ..###.##   
    ;  ........   

	.DB  $00, $20, $74, $54, $54, $3C, $78, $40
    ;  .###....   
    ;  ..##....   
    ;  ..#####.   
    ;  ..##..##   
    ;  ..##..##   
    ;  ..##..##   
    ;  .##.###.   
    ;  ........   

	.DB  $00, $41, $7F, $3F, $44, $44, $7C, $38
    ;  ........   
    ;  ........   
    ;  ..####..   
    ;  .##..##.   
    ;  .##.....   
    ;  .##..##.   
    ;  ..####..   
    ;  ........   

	.DB  $00, $38, $7C, $44, $44, $6C, $28, $00
    ;  ....###.   
    ;  .....##.   
    ;  ..#####.   
    ;  .##..##.   
    ;  .##..##.   
    ;  .##..##.   
    ;  ..###.##   
    ;  ........   

	.DB  $00, $38, $7C, $44, $45, $3F, $7F, $40
    ;  ........   
    ;  ........   
    ;  ..####..   
    ;  .##..##.   
    ;  .######.   
    ;  .##.....   
    ;  ..####..   
    ;  ........   

	.DB  $00, $38, $7C, $54, $54, $5C, $18, $00
    ;  ...###..   
    ;  ..##.##.   
    ;  ..##....   
    ;  .####...   
    ;  ..##....   
    ;  ..##....   
    ;  .####...   
    ;  ........   

	.DB  $00, $48, $7E, $7F, $49, $03, $02, $00
    ;  ........   
    ;  ........   
    ;  ..###.##   
    ;  .##..##.   
    ;  .##..##.   
    ;  ..#####.   
    ;  .....##.   
    ;  .#####..   

	.DB  $00, $98, $BC, $A4, $A4, $F8, $7C, $04
    ;  .###....   
    ;  ..##....   
    ;  ..##.##.   
    ;  ..###.##   
    ;  ..##..##   
    ;  ..##..##   
    ;  .###..##   
    ;  ........   

	.DB  $00, $41, $7F, $7F, $08, $04, $7C, $78
    ;  ...##...   
    ;  ........   
    ;  ..###...   
    ;  ...##...   
    ;  ...##...   
    ;  ...##...   
    ;  ..####..   
    ;  ........   

	.DB  $00, $00, $44, $7D, $7D, $40, $00, $00
    ;  .....##.   
    ;  ........   
    ;  .....##.   
    ;  .....##.   
    ;  .....##.   
    ;  .##..##.   
    ;  .##..##.   
    ;  ..####..   

	.DB  $00, $60, $E0, $80, $80, $FD, $7D, $00
    ;  .###....   
    ;  ..##....   
    ;  ..##..##   
    ;  ..##.##.   
    ;  ..####..   
    ;  ..##.##.   
    ;  .###..##   
    ;  ........   

	.DB  $00, $41, $7F, $7F, $10, $38, $6C, $44
    ;  ..###...   
    ;  ...##...   
    ;  ...##...   
    ;  ...##...   
    ;  ...##...   
    ;  ...##...   
    ;  ..####..   
    ;  ........   

	.DB  $00, $00, $41, $7F, $7F, $40, $00, $00
    ;  ........   
    ;  ........   
    ;  .##..##.   
    ;  .#######   
    ;  .#######   
    ;  .##.#.##   
    ;  .##...##   
    ;  ........   

	.DB  $00, $7C, $7C, $18, $38, $1C, $7C, $78
    ;  ........   
    ;  ........   
    ;  .#####..   
    ;  .##..##.   
    ;  .##..##.   
    ;  .##..##.   
    ;  .##..##.   
    ;  ........   

	.DB  $00, $7C, $7C, $04, $04, $7C, $78, $00
    ;  ........   
    ;  ........   
    ;  ..####..   
    ;  .##..##.   
    ;  .##..##.   
    ;  .##..##.   
    ;  ..####..   
    ;  ........   

	.DB  $00, $38, $7C, $44, $44, $7C, $38, $00
    ;  ........   
    ;  ........   
    ;  .##.###.   
    ;  ..##..##   
    ;  ..##..##   
    ;  ..#####.   
    ;  ..##....   
    ;  .####...   

	.DB  $00, $84, $FC, $F8, $A4, $24, $3C, $18
    ;  ........   
    ;  ........   
    ;  ..###.##   
    ;  .##..##.   
    ;  .##..##.   
    ;  ..#####.   
    ;  .....##.   
    ;  ....####   

	.DB  $00, $18, $3C, $24, $A4, $F8, $FC, $84
    ;  ........   
    ;  ........   
    ;  .##.###.   
    ;  ..###.##   
    ;  ..##..##   
    ;  ..##....   
    ;  .####...   
    ;  ........   

	.DB  $00, $44, $7C, $78, $4C, $04, $1C, $18
    ;  ........   
    ;  ........   
    ;  ..#####.   
    ;  .##.....   
    ;  ..####..   
    ;  .....##.   
    ;  .#####..   
    ;  ........   

	.DB  $00, $48, $5C, $54, $54, $74, $24, $00
    ;  ....#...   
    ;  ...##...   
    ;  ..#####.   
    ;  ...##...   
    ;  ...##...   
    ;  ...##.#.   
    ;  ....##..   
    ;  ........   

	.DB  $00, $00, $04, $3E, $7F, $44, $24, $00
    ;  ........   
    ;  ........   
    ;  .##..##.   
    ;  .##..##.   
    ;  .##..##.   
    ;  .##..##.   
    ;  ..###.##   
    ;  ........   

	.DB  $00, $3C, $7C, $40, $40, $3C, $7C, $40
    ;  ........   
    ;  ........   
    ;  .##..##.   
    ;  .##..##.   
    ;  .##..##.   
    ;  ..####..   
    ;  ...##...   
    ;  ........   

	.DB  $00, $1C, $3C, $60, $60, $3C, $1C, $00
    ;  ........   
    ;  ........   
    ;  .##...##   
    ;  .##.#.##   
    ;  .#######   
    ;  .#######   
    ;  ..##.##.   
    ;  ........   

	.DB  $00, $3C, $7C, $70, $38, $70, $7C, $3C
    ;  ........   
    ;  ........   
    ;  .##...##   
    ;  ..##.##.   
    ;  ...###..   
    ;  ..##.##.   
    ;  .##...##   
    ;  ........   

	.DB  $00, $44, $6C, $38, $10, $38, $6C, $44
    ;  ........   
    ;  ........   
    ;  .##..##.   
    ;  .##..##.   
    ;  .##..##.   
    ;  ..#####.   
    ;  .....##.   
    ;  .#####..   

	.DB  $00, $9C, $BC, $A0, $A0, $FC, $7C, $00
    ;  ........   
    ;  ........   
    ;  .######.   
    ;  .#..##..   
    ;  ...##...   
    ;  ..##..#.   
    ;  .######.   
    ;  ........   

	.DB  $00, $4C, $64, $74, $5C, $4C, $64, $00
    ;  ....###.   
    ;  ...##...   
    ;  ...##...   
    ;  .###....   
    ;  ...##...   
    ;  ...##...   
    ;  ....###.   
    ;  ........   

	.DB  $00, $08, $08, $3E, $77, $41, $41, $00
    ;  ....##..   
    ;  ....##..   
    ;  ....##..   
    ;  ........   
    ;  ....##..   
    ;  ....##..   
    ;  ....##..   
    ;  ........   

	.DB  $00, $00, $00, $00, $77, $77, $00, $00
    ;  ...##...   
    ;  ...##...   
    ;  ....###.   
    ;  ...##...   
    ;  ...##...   
    ;  .###....   
    ;  ........   

    ;  ..###.##   
	.DB  $00, $41, $41, $77, $3E, $08, $08, $00
    ;  .##.###.   
    ;  ........   
    ;  ........   
    ;  ........   
    ;  ........   
    ;  ........   
    ;  ........   
	.DB  $00, $02, $03, $01, $03, $02, $03, $01

    ;  ........   
    ;  ....#...   
    ;  ...###..   
    ;  ..##.##.   
    ;  .##...##   
    ;  .##...##   
    ;  .#######   
    ;  ........   
	.DB  $00, $70, $78, $4C, $46, $4C, $78, $70

    ;  ..####..   
    ;  .##..##.   
    ;  .##.....   
    ;  .##..##.   
    ;  ..####..   
    ;  ....##..   
    ;  .....##.   
    ;  ..####..   
	.DB  $00, $0E, $9F, $91, $B1, $FB, $4A, $00

    ;  ........   
    ;  .##..##.   
    ;  ........   
    ;  .##..##.   
    ;  .##..##.   
    ;  .##..##.   
    ;  ..######   
    ;  ........   
	.DB  $00, $3A, $7A, $40, $40, $7A, $7A, $40

    ;  ...###..   
    ;  ........   
    ;  .####...   
    ;  ##..##..   
    ;  ######..   
    ;  ##......   
    ;  .####...   
    ;  ........   
	.DB  $38, $7C, $54, $55, $5D, $19, $00, $00

    ;  .######.   
    ;  ##....##   
    ;  ..####..   
    ;  .....##.   
    ;  ..#####.   
    ;  .##..##.   
    ;  ..######   
    ;  ........   
	.DB  $02, $23, $75, $55, $55, $7D, $7B, $42

    ;  .##..##.   
    ;  ........   
    ;  ..####..   
    ;  .....##.   
    ;  ..#####.   
    ;  .##..##.   
    ;  ..######   
    ;  ........   
	.DB  $00, $21, $75, $54, $54, $7D, $79, $40

    ;  .###....   
    ;  ........   
    ;  ..####..   
    ;  .....##.   
    ;  ..#####.   
    ;  .##..##.   
    ;  ..######   
    ;  ........   
	.DB  $00, $21, $75, $55, $54, $7C, $78, $40

    ;  ...##...   
    ;  ...##...   
    ;  ..####..   
    ;  .....##.   
    ;  ..#####.   
    ;  .##..##.   
    ;  ..######   
    ;  ........   
	.DB  $00, $20, $74, $57, $57, $7C, $78, $40

    ;  ........   
    ;  ........   
    ;  ..####..   
    ;  .##.....   
    ;  .##.....   
    ;  ..####..   
    ;  .....##.   
    ;  ...###..   
	.DB  $00, $18, $3C, $A4, $A4, $E4, $40, $00

    ;  .######.   
    ;  ##....##   
    ;  ..####..   
    ;  .##..##.   
    ;  .######.   
    ;  .##.....   
    ;  ..####..   
    ;  ........   
	.DB  $02, $3B, $7D, $55, $55, $5D, $1B, $02

    ;  ##..##..   
    ;  ........   
    ;  .####...   
    ;  ##..##..   
    ;  ######..   
    ;  ##......   
    ;  .####...   
    ;  ........   
	.DB  $39, $7D, $54, $54, $5D, $19, $00, $00

    ;  .###....   
    ;  ........   
    ;  ..####..   
    ;  .##..##.   
    ;  .######.   
    ;  .##.....   
    ;  ..####..   
    ;  ........   
	.DB  $00, $39, $7D, $55, $54, $5C, $18, $00

    ;  .##..##.   
    ;  ........   
    ;  ..###...   
    ;  ...##...   
    ;  ...##...   
    ;  ...##...   
    ;  ..####..   
    ;  ........   
	.DB  $00, $01, $45, $7C, $7C, $41, $01, $00

    ;  ..#####.   
    ;  .##...##   
    ;  ...###..   
    ;  ....##..   
    ;  ....##..   
    ;  ....##..   
    ;  ...####.   
    ;  ........   
	.DB  $00, $02, $03, $45, $7D, $7D, $43, $02

    ;  .###....   
    ;  ........   
    ;  ..###...   
    ;  ...##...   
    ;  ...##...   
    ;  ...##...   
    ;  ..####..   
    ;  ........   
	.DB  $00, $01, $45, $7D, $7C, $40, $00, $00

    ;  .##...##   
    ;  ...###..   
    ;  ..##.##.   
    ;  .##...##   
    ;  .#######   
    ;  .##...##   
    ;  .##...##   
    ;  ........   
	.DB  $00, $79, $7D, $16, $12, $16, $7D, $79

    ;  ...##...   
    ;  ...##...   
    ;  ..####..   
    ;  .##..##.   
    ;  .##..##.   
    ;  .######.   
    ;  .##..##.   
    ;  ........   
	.DB  $00, $78, $7C, $27, $27, $7C, $78, $00

    ;  ...###..   
    ;  ........   
    ;  ######..   
    ;  .##.....   
    ;  .####...   
    ;  .##.....   
    ;  ######..   
    ;  ........   
	.DB  $44, $7C, $7C, $55, $55, $45, $00, $00

    ;  ........   
    ;  ........   
    ;  .#######   
    ;  ....##..   
    ;  .#######   
    ;  ##..##..   
    ;  .#######   
    ;  ........   
	.DB  $20, $74, $54, $54, $7C, $7C, $54, $54

    ;  ...#####   
    ;  ..##.##.   
    ;  .##..##.   
    ;  .#######   
    ;  .##..##.   
    ;  .##..##.   
    ;  .##..###   
    ;  ........   
	.DB  $00, $7C, $7E, $0B, $09, $7F, $7F, $49

    ;  ..####..   
    ;  .##..##.   
    ;  ........   
    ;  ..####..   
    ;  .##..##.   
    ;  .##..##.   
    ;  ..####..   
    ;  ........   
	.DB  $00, $32, $7B, $49, $49, $7B, $32, $00

    ;  ........   
    ;  .##..##.   
    ;  ........   
    ;  ..####..   
    ;  .##..##.   
    ;  .##..##.   
    ;  ..####..   
    ;  ........   
	.DB  $00, $32, $7A, $48, $48, $7A, $32, $00

    ;  ........   
    ;  .###....   
    ;  ........   
    ;  ..####..   
    ;  .##..##.   
    ;  .##..##.   
    ;  ..####..   
    ;  ........   
	.DB  $00, $32, $7A, $4A, $48, $78, $30, $00

    ;  ..####..   
    ;  .##..##.   
    ;  ........   
    ;  .##..##.   
    ;  .##..##.   
    ;  .##..##.   
    ;  ..######   
    ;  ........   
	.DB  $00, $3A, $7B, $41, $41, $7B, $7A, $40

    ;  ........   
    ;  .###....   
    ;  ........   
    ;  .##..##.   
    ;  .##..##.   
    ;  .##..##.   
    ;  ..######   
    ;  ........   
	.DB  $00, $3A, $7A, $42, $40, $78, $78, $40

    ;  ........   
    ;  ##..##..   
    ;  ........   
    ;  ##..##..   
    ;  ##..##..   
    ;  .#####..   
    ;  ....##..   
    ;  #####...   
	.DB  $9A, $BA, $A0, $A0, $FA, $7A, $00, $00

    ;  ##....##   
    ;  ...##...   
    ;  ..####..   
    ;  .##..##.   
    ;  .##..##.   
    ;  ..####..   
    ;  ...##...   
    ;  ........   
	.DB  $01, $19, $3C, $66, $66, $3C, $19, $01

    ;  .##..##.   
    ;  ........   
    ;  .##..##.   
    ;  .##..##.   
    ;  .##..##.   
    ;  .##..##.   
    ;  ..####..   
    ;  ........   
	.DB  $00, $3D, $7D, $40, $40, $7D, $3D, $00

    ;  ........   
    ;  ........   
    ;  ..#####.   
    ;  .##..###   
    ;  .##.#.##   
    ;  .###..##   
    ;  ..#####.   
    ;  ........   
	.DB  $00, $38, $7C, $64, $54, $4C, $7C, $38

    ;  ...###..   
    ;  ..##.##.   
    ;  ..##..#.   
    ;  .####...   
    ;  ..##....   
    ;  .###..##   
    ;  .######.   
    ;  ........   
	.DB  $00, $68, $7E, $7F, $49, $43, $66, $20

    ;  ..#####.   
    ;  .##...##   
    ;  .##..###   
    ;  .##.#.##   
    ;  .###..##   
    ;  .##...##   
    ;  ..#####.   
    ;  ........   
	.DB  $00, $3E, $7F, $51, $49, $45, $7F, $3E

    ;  #####...   
    ;  ##..##..   
    ;  ##..##..   
    ;  #####.#.   
    ;  ##...##.   
    ;  ##..####   
    ;  ##...##.   
    ;  ##...###   
	.DB  $FF, $FF, $09, $09, $2F, $F6, $F8, $A0

    ;  ....###.   
    ;  ...##.##   
    ;  ...##...   
    ;  ..####..   
    ;  ...##...   
    ;  ...##...   
    ;  ##.##...   
    ;  .###....   
	.DB  $40, $C0, $88, $FE, $7F, $09, $03, $02

    ;  ........   
    ;  ........   
    ;  ........   
    ;  ........   
    ;  ........   
    ;  ........   
    ;  ........   
    ;  ........   
	.DB  $00, $00, $00, $00, $00, $00, $00, $00

    ;  ........   
    ;  ..###...   
    ;  ..##....   
    ;  ..##....   
    ;  ........   
    ;  ........   
    ;  ........   
    ;  ........   
	.DB  $00, $00, $0E, $0E, $02, $00, $00, $00

    ;  ........   
    ;  ...###..   
    ;  ....##..   
    ;  ....##..   
    ;  ........   
    ;  ........   
    ;  ........   
    ;  ........   
	.DB  $00, $00, $00, $02, $0E, $0E, $00, $00

    ;  ........   
    ;  ....###.   
    ;  ...##...   
    ;  ...##...   
    ;  .######.   
    ;  ...##...   
    ;  .#######   
    ;  ........   
	.DB  $00, $50, $50, $7C, $7E, $52, $52, $40

    ;  ........   
    ;  ........   
    ;  ........   
    ;  ........   
    ;  ........   
    ;  ........   
    ;  ........   
    ;  ........   
	.DB  $00, $00, $00, $00, $00, $00, $00, $00

    ;  ........   
    ;  ........   
    ;  ........   
    ;  ........   
    ;  ........   
    ;  ........   
    ;  ........   
    ;  ........   
	.DB  $00, $00, $00, $00, $00, $00, $00, $00

    ;  ........   
    ;  ........   
    ;  ...#....   
    ;  ...#....   
    ;  ........   
    ;  ...#....   
    ;  ...#....   
    ;  ........   
	.DB  $00, $00, $00, $6C, $00, $00, $00, $00

    ;  ........   
    ;  ..#####.   
    ;  .##....#   
    ;  .#####..   
    ;  .##..##.   
    ;  ..#####.   
    ;  #....##.   
    ;  .#####..   
	.DB  $40, $9C, $BE, $AA, $AA, $FA, $72, $04

    ;  ..#..#..   
    ;  ........   
    ;  ........   
    ;  ........   
    ;  ........   
    ;  ........   
    ;  ........   
    ;  ........   
	.DB  $00, $00, $01, $00, $00, $01, $00, $00

    ;  ........   
    ;  .######.   
    ;  ##....##   
    ;  #####.##   
    ;  ###...##   
    ;  #####.##   
    ;  ##....##   
    ;  .######.   
	.DB  $7C, $FE, $BA, $AA, $AA, $82, $FE, $7C

    ;  ........   
    ;  ........   
    ;  ........   
    ;  ........   
    ;  ........   
    ;  ........   
    ;  ........   
    ;  ........   
	.DB  $00, $00, $00, $00, $00, $00, $00, $00

    ;  ........   
    ;  ........   
    ;  ..##..##   
    ;  .##..##.   
    ;  ##..##..   
    ;  .##..##.   
    ;  ..##..##   
    ;  ........   
	.DB  $10, $38, $6C, $44, $10, $38, $6C, $44

    ;  ........   
    ;  ........   
    ;  ........   
    ;  ........   
    ;  .######.   
    ;  .######.   
    ;  .....##.   
    ;  ........   
	.DB  $00, $30, $30, $30, $30, $70, $70, $00

    ;  ........   
    ;  ........   
    ;  ........   
    ;  .######.   
    ;  .######.   
    ;  ........   
    ;  ........   
    ;  ........   
	.DB  $00, $18, $18, $18, $18, $18, $18, $00

    ;  ........   
    ;  ........   
    ;  ........   
    ;  ........   
    ;  ........   
    ;  ........   
    ;  ........   
    ;  ........   
	.DB  $00, $00, $00, $00, $00, $00, $00, $00

    ;  ........   
    ;  ........   
    ;  .######.   
    ;  .######.   
    ;  ........   
    ;  ........   
    ;  ........   
    ;  ........   
	.DB  $00, $0C, $0C, $0C, $0C, $0C, $0C, $00

    ;  ..####..   
    ;  .##..##.   
    ;  ..####..   
    ;  ........   
    ;  ........   
    ;  ........   
    ;  ........   
    ;  ........   
	.DB  $00, $02, $07, $05, $05, $07, $02, $00

    ;  ........   
    ;  ...##...   
    ;  ...##...   
    ;  .######.   
    ;  ...##...   
    ;  ...##...   
    ;  .######.   
    ;  ........   
	.DB  $00, $48, $48, $7E, $7E, $48, $48, $00

    ;  ...####.   
    ;  .....##.   
    ;  ...####.   
    ;  ..##....   
    ;  ..#####.   
    ;  ........   
    ;  ........   
    ;  ........   
	.DB  $00, $00, $18, $1D, $15, $17, $17, $00

    ;  ...####.   
    ;  .....##.   
    ;  ....##..   
    ;  .....##.   
    ;  ...####.   
    ;  ........   
    ;  ........   
    ;  ........   
	.DB  $00, $00, $00, $11, $15, $1F, $1B, $00

    ;  ...##...   
    ;  ...##...   
    ;  ........   
    ;  ........   
    ;  ........   
    ;  ........   
    ;  ........   
    ;  ........   
	.DB  $00, $00, $00, $03, $03, $00, $00, $00

    ;  ...#....   
    ;  .#.#.#..   
    ;  .#...#..   
    ;  ........   
    ;  ........   
    ;  ........   
    ;  ........   
    ;  ........   
	.DB  $00, $06, $00, $03, $00, $06, $00, $00

    ;  .#......   
    ;  .#..##..   
    ;  ...####.   
    ;  ..##..##   
    ;  ..######   
    ;  ..##..##   
    ;  ..##..##   
    ;  ........   
	.DB  $00, $03, $78, $7C, $16, $16, $7C, $78

    ;  ........   
    ;  ........   
    ;  ........   
    ;  ...##...   
    ;  ...##...   
    ;  ........   
    ;  ........   
    ;  ........   
	.DB  $00, $00, $00, $18, $18, $00, $00, $00

    ;  .#......   
    ;  .#......   
    ;  ..######   
    ;  ..##....   
    ;  ..#####.   
    ;  ..##....   
    ;  ..######   
    ;  ........   
	.DB  $00, $03, $7C, $7C, $54, $54, $54, $44

    ;  .#......   
    ;  .#......   
    ;  ..##..##   
    ;  ..##..##   
    ;  ..######   
    ;  ..##..##   
    ;  ..##..##   
    ;  ........   
	.DB  $00, $03, $7C, $7C, $10, $10, $7C, $7C

    ;  .#......   
    ;  .#......   
    ;  ..######   
    ;  ....##..   
    ;  ....##..   
    ;  ....##..   
    ;  ..######   
    ;  ........   
	.DB  $00, $03, $44, $44, $7C, $7C, $44, $44

    ;  ........   
    ;  ........   
    ;  ##..##..   
    ;  .##..##.   
    ;  ..##..##   
    ;  .##..##.   
    ;  ##..##..   
    ;  ........   
	.DB  $44, $6C, $38, $10, $44, $6C, $38, $10

    ;  .#......   
    ;  .#......   
    ;  ..####..   
    ;  .##..##.   
    ;  .##..##.   
    ;  .##..##.   
    ;  ..####..   
    ;  ........   
	.DB  $00, $3B, $7C, $44, $44, $7C, $38, $00

    ;  .###....   
    ;  ..##.#..   
    ;  ..###...   
    ;  ..#####.   
    ;  ..#..##.   
    ;  .#..##..   
    ;  ...##...   
    ;  ...####.   
	.DB  $00, $21, $1F, $CF, $EC, $BA, $98, $00

    ;  .#......   
    ;  .#......   
    ;  ..##..##   
    ;  ...####.   
    ;  ....##..   
    ;  ....##..   
    ;  ....##..   
    ;  ........   
	.DB  $00, $03, $04, $0C, $78, $78, $0C, $04

    ;  .#......   
    ;  .#......   
    ;  ..#####.   
    ;  .##...##   
    ;  .##...##   
    ;  ..#...#.   
    ;  ...#.#..   
    ;  .###.###   
	.DB  $00, $9B, $BC, $C4, $04, $C4, $BC, $98

    ;  ...#....   
    ;  .#.#.#..   
    ;  .#...#..   
    ;  ...##...   
    ;  ...##...   
    ;  ...##...   
    ;  ...###..   
    ;  ........   
	.DB  $00, $06, $00, $7B, $78, $46, $00, $00

    ;  ...##...   
    ;  ..####..   
    ;  .##..##.   
    ;  .##..##.   
    ;  .######.   
    ;  .##..##.   
    ;  .##..##.   
    ;  ........   
	.DB  $00, $7C, $7E, $13, $13, $7E, $7C, $00

    ;  .#####..   
    ;  .##..##.   
    ;  .##..##.   
    ;  .#####..   
    ;  .##..##.   
    ;  .##..##.   
    ;  .#####..   
    ;  ........   
	.DB  $00, $7F, $7F, $49, $49, $7F, $36, $00

    ;  .######.   
    ;  .##..##.   
    ;  .##.....   
    ;  .##.....   
    ;  .##.....   
    ;  .##.....   
    ;  .##.....   
    ;  ........   
	.DB  $00, $7F, $7F, $01, $01, $03, $03, $00

    ;  ....#...   
    ;  ...###..   
    ;  ...#.#..   
    ;  ..##.##.   
    ;  ..#...#.   
    ;  .##...##   
    ;  .#######   
    ;  ........   
	.DB  $00, $60, $78, $4E, $43, $4E, $78, $60

    ;  .######.   
    ;  .##..##.   
    ;  .##.....   
    ;  .#####..   
    ;  .##.....   
    ;  .##..##.   
    ;  .######.   
    ;  ........   
	.DB  $00, $7F, $7F, $49, $49, $6B, $63, $00

    ;  .######.   
    ;  .##..##.   
    ;  ....##..   
    ;  ...##...   
    ;  ..##....   
    ;  .##..##.   
    ;  .######.   
    ;  ........   
	.DB  $00, $63, $73, $59, $4D, $67, $63, $00

    ;  .##..##.   
    ;  .##..##.   
    ;  .##..##.   
    ;  .######.   
    ;  .##..##.   
    ;  .##..##.   
    ;  .##..##.   
    ;  ........   
	.DB  $00, $7F, $7F, $08, $08, $7F, $7F, $00

    ;  ..#####.   
    ;  .##...##   
    ;  .##...##   
    ;  .#.###.#   
    ;  .##...##   
    ;  .##...##   
    ;  ..#####.   
    ;  ........   
	.DB  $00, $3E, $77, $49, $49, $49, $77, $3E

    ;  .######.   
    ;  ...##...   
    ;  ...##...   
    ;  ...##...   
    ;  ...##...   
    ;  ...##...   
    ;  .######.   
    ;  ........   
	.DB  $00, $41, $41, $7F, $7F, $41, $41, $00

    ;  .##..##.   
    ;  .##.##..   
    ;  .####...   
    ;  .###....   
    ;  .####...   
    ;  .##.##..   
    ;  .##..##.   
    ;  ........   
	.DB  $00, $7F, $7F, $1C, $36, $63, $41, $00

    ;  ....#...   
    ;  ...###..   
    ;  ...#.#..   
    ;  ..##.##.   
    ;  ..#...#.   
    ;  .##...##   
    ;  .#.....#   
    ;  ........   
	.DB  $00, $60, $38, $0E, $03, $0E, $38, $60

    ;  .##...##   
    ;  .###.###   
    ;  .#######   
    ;  .##.#.##   
    ;  .##...##   
    ;  .##...##   
    ;  .##...##   
    ;  ........   
	.DB  $00, $7F, $7F, $06, $0C, $06, $7F, $7F

    ;  .#...##.   
    ;  .##..##.   
    ;  .###.##.   
    ;  .######.   
    ;  .##.###.   
    ;  .##..##.   
    ;  .##...#.   
    ;  ........   
	.DB  $00, $7F, $7E, $0C, $18, $3F, $7F, $00

    ;  .######.   
    ;  .#....#.   
    ;  ........   
    ;  ..####..   
    ;  ..####..   
    ;  ........   
    ;  .#....#.   
    ;  .######.   
	.DB  $00, $C3, $99, $99, $99, $99, $C3, $00

    ;  ..####..   
    ;  .##..##.   
    ;  .##..##.   
    ;  .##..##.   
    ;  .##..##.   
    ;  .##..##.   
    ;  ..####..   
    ;  ........   
	.DB  $00, $3E, $7F, $41, $41, $7F, $3E, $00

    ;  .#######   
    ;  ..##.##.   
    ;  ..##.##.   
    ;  ..##.##.   
    ;  ..##.##.   
    ;  ..##.##.   
    ;  ..##.##.   
    ;  ........   
	.DB  $00, $01, $7F, $7F, $01, $7F, $7F, $01

    ;  .#####..   
    ;  .##..##.   
    ;  .##..##.   
    ;  .#####..   
    ;  .##.....   
    ;  .##.....   
    ;  .##.....   
    ;  ........   
	.DB  $00, $7F, $7F, $09, $09, $0F, $06, $00

    ;  ........   
    ;  ........   
    ;  ........   
    ;  ........   
    ;  ........   
    ;  ........   
    ;  ........   
    ;  ........   
	.DB  $00, $00, $00, $00, $00, $00, $00, $00

    ;  .######.   
    ;  .##..##.   
    ;  ..##....   
    ;  ...##...   
    ;  ..##....   
    ;  .##..##.   
    ;  .######.   
    ;  ........   
	.DB  $00, $63, $77, $5D, $49, $63, $63, $00

    ;  ..######   
    ;  ..#.##.#   
    ;  ....##..   
    ;  ....##..   
    ;  ....##..   
    ;  ....##..   
    ;  ....##..   
    ;  ........   
	.DB  $00, $00, $03, $01, $7F, $7F, $01, $03

    ;  .#....#.   
    ;  .##..##.   
    ;  .##..##.   
    ;  ..####..   
    ;  ...##...   
    ;  ...##...   
    ;  ...##...   
    ;  ....#...   
	.DB  $00, $07, $0E, $78, $F8, $0E, $07, $00

    ;  ..#####.   
    ;  ....#...   
    ;  ..#####.   
    ;  .##.#.##   
    ;  ..#####.   
    ;  ....#...   
    ;  ..#####.   
    ;  ........   
	.DB  $00, $08, $5D, $55, $7F, $55, $5D, $08

    ;  .#....#.   
    ;  .##..##.   
    ;  ..####..   
    ;  ...##...   
    ;  ..####..   
    ;  .##..##.   
    ;  .#....#.   
    ;  ........   
	.DB  $00, $63, $36, $1C, $1C, $36, $63, $00

    ;  ##....##   
    ;  ##.##.##   
    ;  ##.##.##   
    ;  .######.   
    ;  ...##...   
    ;  ...##...   
    ;  ..####..   
    ;  ........   
	.DB  $07, $0F, $48, $7E, $7E, $48, $0F, $07

    ;  ..#####.   
    ;  .##...##   
    ;  .##...##   
    ;  ..##.##.   
    ;  ...#.#..   
    ;  .#.#.#.#   
    ;  .###.###   
    ;  ........   
	.DB  $00, $66, $4F, $79, $01, $79, $4F, $66

    ;  ..#..#..   
    ;  ........   
    ;  .######.   
    ;  ...##...   
    ;  ...##...   
    ;  ...##...   
    ;  .######.   
    ;  ........   
	.DB  $00, $44, $45, $7C, $7C, $45, $44, $00

    ;  ..#..#..   
    ;  ........   
    ;  .##..##.   
    ;  ..####..   
    ;  ...##...   
    ;  ...##...   
    ;  ...##...   
    ;  ........   
	.DB  $00, $04, $0D, $78, $78, $0D, $04, $00

    ;  ...##...   
    ;  ..##....   
    ;  ........   
    ;  ..###.##   
    ;  .##..##.   
    ;  .##..##.   
    ;  ..###.##   
    ;  ........   
	.DB  $00, $30, $7A, $4B, $49, $30, $78, $48

    ;  ...##...   
    ;  ..##....   
    ;  ..#####.   
    ;  .###....   
    ;  ..####..   
    ;  .###....   
    ;  ..#####.   
    ;  ........   
	.DB  $00, $28, $7E, $7F, $55, $54, $44, $00

    ;  ...##...   
    ;  ..##....   
    ;  ........   
    ;  .#####..   
    ;  .##..##.   
    ;  .##..##.   
    ;  .##..##.   
    ;  .....##.   
	.DB  $00, $78, $7A, $0B, $09, $F8, $F0, $00

    ;  ...##...   
    ;  ..##....   
    ;  ........   
    ;  ...##...   
    ;  ...##...   
    ;  ...##...   
    ;  ....##..   
    ;  ........   
	.DB  $00, $00, $02, $3B, $79, $40, $00, $00

    ;  ...#....   
    ;  .#.#.#..   
    ;  ........   
    ;  .##..##.   
    ;  .##..##.   
    ;  .##..##.   
    ;  ..####..   
    ;  ........   
	.DB  $00, $3A, $78, $43, $40, $7A, $38, $00

    ;  ........   
    ;  ........   
    ;  ..###.##   
    ;  .##..##.   
    ;  .##..##.   
    ;  .##..##.   
    ;  ..###.##   
    ;  ........   
	.DB  $00, $38, $7C, $44, $44, $38, $7C, $44

    ;  ........   
    ;  .#####..   
    ;  .##..##.   
    ;  .#####..   
    ;  .##..##.   
    ;  .##..##.   
    ;  .#####..   
    ;  .##.....   
	.DB  $00, $FE, $FE, $4A, $4A, $7E, $34, $00

    ;  ........   
    ;  ...#....   
    ;  ..###...   
    ;  .##.#.##   
    ;  ....###.   
    ;  ....##..   
    ;  ...##...   
    ;  ........   
	.DB  $00, $08, $0C, $46, $7C, $30, $18, $08

    ;  ........   
    ;  ..####..   
    ;  .##.....   
    ;  ..####..   
    ;  .##..##.   
    ;  .##..##.   
    ;  ..####..   
    ;  ........   
	.DB  $00, $34, $7E, $4A, $4A, $7A, $30, $00

    ;  ........   
    ;  ........   
    ;  ..#####.   
    ;  .###....   
    ;  ..####..   
    ;  .###....   
    ;  ..#####.   
    ;  ........   
	.DB  $00, $28, $7C, $7C, $54, $54, $44, $00

    ;  ..#.....   
    ;  ..#####.   
    ;  ....##..   
    ;  ..##....   
    ;  .##.....   
    ;  ..####..   
    ;  .....##.   
    ;  ..####..   
	.DB  $00, $10, $BB, $AA, $A6, $E6, $42, $00

    ;  ........   
    ;  ........   
    ;  .#####..   
    ;  .##..##.   
    ;  .##..##.   
    ;  .##..##.   
    ;  .##..##.   
    ;  .....##.   
	.DB  $00, $7C, $7C, $04, $04, $FC, $F8, $00

    ;  ........   
    ;  ........   
    ;  ..####..   
    ;  .##..##.   
    ;  .######.   
    ;  .##..##.   
    ;  ..####..   
    ;  ........   
	.DB  $00, $38, $7C, $54, $54, $7C, $38, $00

    ;  ........   
    ;  ........   
    ;  ...##...   
    ;  ...##...   
    ;  ...##...   
    ;  ...##...   
    ;  ....##..   
    ;  ........   
	.DB  $00, $00, $00, $3C, $7C, $40, $00, $00

    ;  ........   
    ;  ........   
    ;  .##..##.   
    ;  .##.##..   
    ;  .####...   
    ;  .##.##..   
    ;  .##..##.   
    ;  ........   
	.DB  $00, $7C, $7C, $10, $38, $6C, $44, $00

    ;  ........   
    ;  .##.....   
    ;  ..##....   
    ;  ...##...   
    ;  ..####..   
    ;  .##..##.   
    ;  .#....#.   
    ;  ........   
	.DB  $00, $62, $36, $1C, $18, $30, $60, $00

    ;  ........   
    ;  ........   
    ;  .##..##.   
    ;  .##..##.   
    ;  .##..##.   
    ;  .##..##.   
    ;  .#.##.##   
    ;  ##......   
	.DB  $80, $FC, $3C, $40, $40, $3C, $7C, $40

    ;  ........   
    ;  ........   
    ;  .##....#   
    ;  .##...##   
    ;  .##..##.   
    ;  .##.##..   
    ;  .####...   
    ;  ........   
	.DB  $00, $7C, $7C, $40, $60, $30, $18, $0C

    ;  .##.....   
    ;  ..####..   
    ;  .##.....   
    ;  ..####..   
    ;  .###....   
    ;  ..####..   
    ;  .....##.   
    ;  ..####..   
	.DB  $00, $15, $BF, $BA, $AA, $EA, $40, $00

    ;  ........   
    ;  ........   
    ;  ..####..   
    ;  .##..##.   
    ;  .##..##.   
    ;  .##..##.   
    ;  ..####..   
    ;  ........   
	.DB  $00, $38, $7C, $44, $44, $7C, $38, $00

    ;  ........   
    ;  ........   
    ;  .#######   
    ;  ..##.##.   
    ;  ..##.##.   
    ;  ..##.##.   
    ;  ..##.##.   
    ;  ........   
	.DB  $00, $04, $7C, $7C, $04, $7C, $7C, $04

    ;  ........   
    ;  ........   
    ;  .#####..   
    ;  .##..##.   
    ;  .##..##.   
    ;  .##..##.   
    ;  .#####..   
    ;  .##.....   
	.DB  $00, $FC, $FC, $44, $44, $7C, $38, $00

    ;  ........   
    ;  ........   
    ;  ..#####.   
    ;  .##.....   
    ;  .##.....   
    ;  ..####..   
    ;  .....##.   
    ;  ...###..   
	.DB  $00, $18, $3C, $A4, $A4, $E4, $44, $00

    ;  ........   
    ;  ........   
    ;  ..######   
    ;  .##..##.   
    ;  .##..##.   
    ;  .##..##.   
    ;  ..####..   
    ;  ........   
	.DB  $00, $38, $7C, $44, $44, $7C, $3C, $04

    ;  ........   
    ;  ........   
    ;  .######.   
    ;  .#.##...   
    ;  ...##...   
    ;  ...##...   
    ;  ....##..   
    ;  ........   
	.DB  $00, $0C, $04, $3C, $7C, $44, $04, $00

    ;  ........   
    ;  ........   
    ;  .##..##.   
    ;  .##..##.   
    ;  .##..##.   
    ;  .##..##.   
    ;  ..####..   
    ;  ........   
	.DB  $00, $3C, $7C, $40, $40, $7C, $3C, $00

    ;  ........   
    ;  ........   
    ;  ..#####.   
    ;  .##.#.##   
    ;  .##.#.##   
    ;  .##.#.##   
    ;  ..#####.   
    ;  ....#...   
	.DB  $00, $38, $7C, $44, $FC, $44, $7C, $38

    ;  ........   
    ;  ........   
    ;  .#....#.   
    ;  .##..##.   
    ;  ..####..   
    ;  ..####..   
    ;  .##..##.   
    ;  .#....#.   
	.DB  $00, $CC, $78, $30, $30, $78, $CC, $00

    ;  ........   
    ;  ........   
    ;  .#.....#   
    ;  .##.#.##   
    ;  .##.#.##   
    ;  .##.#.##   
    ;  ..#####.   
    ;  ....#...   
	.DB  $00, $3C, $78, $40, $F8, $40, $78, $3C

    ;  ........   
    ;  ........   
    ;  ..##.##.   
    ;  .##...##   
    ;  .##.#.##   
    ;  .##.#.##   
    ;  ..#####.   
    ;  ........   
	.DB  $00, $38, $7C, $44, $70, $44, $7C, $38

    ;  ........   
    ;  ..#..#..   
    ;  ........   
    ;  ...##...   
    ;  ...##...   
    ;  ...##...   
    ;  ....##..   
    ;  ........   
	.DB  $00, $00, $02, $38, $78, $42, $00, $00

    ;  ........   
    ;  ..#..#..   
    ;  ........   
    ;  .##..##.   
    ;  .##..##.   
    ;  .##..##.   
    ;  ..####..   
    ;  ........   
	.DB  $00, $38, $7A, $40, $40, $7A, $38, $00

    ;  ...##...   
    ;  ..##....   
    ;  ........   
    ;  ..####..   
    ;  .##..##.   
    ;  .##..##.   
    ;  ..####..   
    ;  ........   
	.DB  $00, $30, $7A, $4B, $49, $78, $30, $00

    ;  ...##...   
    ;  ..##....   
    ;  ........   
    ;  .##..##.   
    ;  .##..##.   
    ;  .##..##.   
    ;  ..####..   
    ;  ........   
	.DB  $00, $38, $7A, $43, $41, $78, $38, $00

    ;  ....##..   
    ;  ...##...   
    ;  ........   
    ;  ..#...#.   
    ;  .##.#.##   
    ;  .##.#.##   
    ;  ..#####.   
    ;  ........   
	.DB  $00, $30, $78, $42, $73, $41, $78, $30

    ;  ........   
    ;  ........   
    ;  ........   
    ;  ........   
    ;  ........   
    ;  ........   
    ;  ........   
    ;  ........   
	.DB  $00, $00, $00, $00, $00, $00, $00, $00
Font8x8End: 
