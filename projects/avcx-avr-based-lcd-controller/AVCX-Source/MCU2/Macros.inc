;##########################################################
;##                   #####################################
;## MACRO DEFINITIONS #####################################
;##                   #####################################
;##########################################################

;------------------------------------------------------------------------------- 
;The MACRO directive tells the Assembler that this is the start of a Macro. The
;MACRO directive takes the Macro name as parameter. When the name of the Macro is
;written later in the program, the Macro definition is expanded at the place it
;was used. A Macro can take up to 10 parameters. These parameters are referred to
;as @0-@9 within the Macro definition. When issuing a Macro call, the parameters
;are given as a comma separated list. The Macro definition is terminated by an
;ENDMACRO directive.
;
;By default, only the call to the Macro is shown on the listfile generated by the
;Assembler. In order to include the macro expansion in the listfile, a LISTMAC
;directive must be used. A macro is marked with a + in the opcode field of the
;listfile.
; 
;Syntax:
;.MACRO macroname
;
;Example:
;.MACRO SUBI16                   ; Start macro definition
;        subi @1,low(@0)         ; Subtract low byte
;        sbci @2,high(@0)        ; Subtract high byte
;.ENDMACRO                       ; End macro definition
;
;.CSEG                           ; Start code segment
;        SUBI16 0x1234,r16,r17   ; Sub.0x1234 from r17:r16
;------------------------------------------------------------------------------- 

; VRAM_WR
; =======
; Write to Video RAM data PORTE.2:PORTB at address PORTC:PORTA
;
.MACRO VRAM_WR
  cli
  cbi PORTE, 3
  sbi PORTE, 3
  sei
.ENDMACRO

; SET_COLOR Red, Green, Blue
; ==========================
; Red, Green and Blue are constants
;
.MACRO SET_COLOR
  cbi PORTE, 2
  ldi r16, @2 ;Blue
  lsl r16
  lsl r16
  lsl r16
  ori r16, @1 ;Green
  lsl r16
  lsl r16
  lsl r16
  brcc PC+2
  sbi PORTE, 2
  ori r16, @0 ;Red
  out PORTB, r16
.ENDMACRO

; CLR_SCREEN
; ==========
; Fill screen with current color (PORTE.2:PORTB)
;
.MACRO CLR_SCREEN
  ldi Vy, 159   ;
  out PORTC, Vy ;<-----+
  ldi Vx, 239   ;      |
  out PORTA, Vx ;<--+  |
  cli           ;   |  |
  cbi PORTE, 3  ;   |  |
  sbi PORTE, 3  ;   |  |
  sei           ;   |  |
  subi Vx, 1    ;   |  |
  brcc PC-6     ;---+  |
  subi Vy, 1    ;      |
  brcc PC-10    ;------+
  ldi Vx, 0     ;
  ldi Vy, 0     ;
.ENDMACRO


; CLR_SCREEN
; ==========
; Fill screen with current color (PORTE.2:PORTB)
;
.MACRO CLR_SCREEN_1
  ldi Vy, 159   ;
  out PORTC, Vy ;<-----+
  ldi Vx, 239   ;      |
  out PORTA, Vx ;<--+  |
  cbi PORTE, 3  ;   |  |
  nop
  nop
  sbi PORTE, 3  ;   |  |
  subi Vx, 1    ;   |  |
  brcc PC-6     ;---+  |
  subi Vy, 1    ;      |
  brcc PC-10    ;------+
  ldi Vx, 0     ;
  ldi Vy, 0     ;
.ENDMACRO


; VRAM_CONNECT
; ============
; Connect to VRAM
;
.MACRO VRAM_CONNECT
  sbi PORTE, 5 
  sbi PORTE, 3
  sbi DDRE,  2
	out	DDRA,_min1
	out	DDRC,_min1 
	out	DDRB,_min1
.ENDMACRO


; VRAM_RELEASE
; ============
; Disconnect from VRAM
;
.MACRO VRAM_RELEASE
  out DDRA, _0
  out DDRC, _0
  out DDRB, _0
  cbi DDRE,  2
  sbi PORTE, 3
  cbi PORTE, 5 
.ENDMACRO
