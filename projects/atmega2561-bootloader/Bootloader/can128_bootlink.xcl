//////////////////////////////////////////////////////////////////////////////
//
// Contains resource definitions at Atmel AT90CAN128
//
// File version: $Name: $
//
// The '_..X_' prefix is used by C-SPY as an indication that the label should
// not be displayed in the dissassembly window.
//
//////////////////////////////////////////////////////////////////////////////
//-----------------------------------------------------------------------
// SIZE CONSTANTES DEFINITION
//------------------------------------------------------------------------
// Code (flash) segments
//----------------------
-D_..X_INTVEC_SIZE=94   // 4 bytes * 37 vectors
-D_..X_FLASH_TEND=FF    // End of tiny flash memory
-D_..X_FLASH_NEND=FFFF  // End of near flash memory
-D_..X_FLASH_END=1FFFF  // End of flash memory
-D_..X_FLASH_BOOT=1E000 /* Beginning of Boot section (max size)*/
//-D_..X_FLASH_BOOT_CONF=1FF00   // last page



// Data (SRAM, external ROM or external NV RAM) memory
//-----------------------------------------------------
-D_..X_SRAM_BASE=100    // Start of ram memory
-D_..X_SRAM_TEND=100    // End of tiny ram memory
-D_..X_SRAM_END=10FF    // End of ram memory

// Internal EEPROM
//------------------
-D_..X_EEPROM_END=FFF   // End of eeprom memory

// Stack Size
//-----------
-D_..X_CSTACK_SIZE=200  // 512 bytes for auto variables and saved registers. 
-D_..X_RSTACK_SIZE=50   // 64 bytes for return addresses, equivalent to 32 
                        // levels of calls, including interrupts. 
-D_..X_HEAP_SIZE=100    // 256 bytes of heap. 


//-----------------------------------------------------------------------
// DEFINE CPU
//------------------------------------------------------------------------
-ca90


// RESET VECTOR SEGMENT :INTVEC + (size) = (start address)
//---------------------------------------------------------
-Z(CODE)INTVEC+_..X_INTVEC_SIZE=_..X_FLASH_BOOT

// COMPILER SEGMENTS :SWITCH, INITTAB, DIFUNCT
//---------------------------------------------------------

-Z(CODE)SWITCH,INITTAB,DIFUNCT=_..X_FLASH_BOOT-_..X_FLASH_END

// TINY OBJECT : for object declared with __tinyflash keyword
//----------------------------------------------------------
-Z(CODE)TINY_F=_..X_FLASH_BOOT-_..X_FLASH_END

// NEAR OBJECT : for object declared with __flash keyword 
//----------------------------------------------------------
-Z(CODE)NEAR_F=_..X_FLASH_BOOT-_..X_FLASH_END

// FAR OBJECT : for object declared with __farflash keyword 
//----------------------------------------------------------
-Z(CODE)FAR_F=_..X_FLASH_BOOT-_..X_FLASH_END

// NEAR FUNCTION OBJECT : for all functions in __nearfunc 
//----------------------------------------------------------
-Z(CODE)CODE=_..X_FLASH_BOOT-_..X_FLASH_END

//-Z(CODE)BOOT_CONF=_..X_FLASH_BOOT_CONF-_..X_FLASH_END
// INIT SEGMENTS
//----------------------------------------------------------
-Z(CODE)TINY_ID,NEAR_ID=_..X_FLASH_BOOT-_..X_FLASH_END


// DATA SEGMENTS DEFINITION
//----------------------------------------------------------
-Z(DATA)TINY_I,TINY_Z,TINY_N=_..X_SRAM_BASE-_..X_SRAM_TEND
-Z(DATA)NEAR_I,NEAR_Z=_..X_SRAM_BASE-_..X_SRAM_END

// STACK SEGMENTS DEFINITION
//----------------------------------------------------------
-Z(DATA)CSTACK+_..X_CSTACK_SIZE=_..X_SRAM_BASE
-Z(DATA)HEAP+_..X_HEAP_SIZE=_..X_SRAM_BASE
-Z(DATA)RSTACK+_..X_RSTACK_SIZE=_..X_SRAM_BASE

// INTERNAL EEPROM 
-Z(XDATA)EEPROM_I,EEPROM_N=0-_..X_EEPROM_END


/* Select reduced "printf" support to reduce library size.
   See configuration section in manual concerning printf/sprintf. */

/*Dlib*/
-e_Printf_1=_Printf

/*Clib*/
-e_small_write=_formatted_write
-e_small_write_P=_formatted_write_P

/* Disable floating-point support in "scanf" to reduce library size.
   See configuration section in manual concerning scanf/sscanf */

/*Dlib*/
-e_Scanf_1=_Scanf

/*Clib*/
-e_medium_read=_formatted_read
-e_medium_read_P=_formatted_read_P


// Suppress one warning which is not relevant for this processor 
-w29
