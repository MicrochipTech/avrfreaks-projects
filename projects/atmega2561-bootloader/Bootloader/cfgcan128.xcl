//////////////////////////////////////////////////////////////////////////////
//
// Contains resource definitions at Atmel AT90CAN128
//
// File version: $Revision: 1.8 $
//
// The '_..X_' prefix is used by C-SPY as an indication that the label should
// not be displayed in the dissassembly window.
//

//////////////////////////////////////////////////////////////////////////////
// Code (flash) segments
-D_..X_INTVEC_SIZE=94   // 4 bytes * 37 vectors
-D_..X_FLASH_NEND=FFFF  // End of near flash memory
-D_..X_FLASH_END=1FFFF  // End of flash memory

//////////////////////////////////////////////////////////////////////////////
// Data (SRAM, external ROM or external NV RAM) memory
-D_..X_SRAM_BASE=100    // Start of ram memory
-D_..X_SRAM_TBASE=0     // Start of tiny ram memory
-D_..X_SRAM_TSIZE=0     //Size of the tiny ram memory
-D_..X_SRAM_END=10FF    // End of ram memory

//////////////////////////////////////////////////////////////////////////////
// Internal EEPROM
-D_..X_EEPROM_END=FFF   // End of eeprom memory
-D_..X_EEPROM_START=0

//////////////////////////////////////////////////////////////////////////////
// BOOT SEGMENT
-D_..X_BOOTSEC_SIZE=400
-Z(FARCODE)BOOT_SEGMENT=(_..X_FLASH_END-_..X_BOOTSEC_SIZE+1)-_..X_FLASH_END