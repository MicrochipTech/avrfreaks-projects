
.ORG    $00
    RJMP    INIT
.ORG    $09
    RJMP    ISR_TOV0


INIT:
    _INIT_STACK     ;SETS THE STACK POINTER AT TOP OF SRAM (.:MACRO.H)                     
    
;** CLEAR R0-R25
    CLR     R0
    CLR     R29
    LDI     R28,1
    LDI     R25,24
CLEAR_REGISTERS:
    ST      Y+,R0
    DEC     R25
    BRNE    CLEAR_REGISTERS
    CLR     R28

;** SETS CURRENT VALUE OF STIMERS 
    LDI     YH,HIGH(RAM_STIMER1_CVL)
    LDI     YL,LOW(RAM_STIMER1_CVL)
CLR_STIMER_CV:
    ST      Y+,TEMP
    CPI     YL,LOW(RAM_STIMER8_CVH)
    BRNE    CLR_STIMER_CV

;** SETTINGS OF TIMER0
	LDI		TEMP,0B00000011     ;LOADS TIMER0 CLK/64 PRESCALER                                                           
	OUT		TCCR0,TEMP
	LDI		TEMP,130			;FOR 1 mS INTERRUPT (1/8000000*64*125=1mS)
	OUT		TCNT0,TEMP 	
    
	LDI		TEMP,(1<<TOIE0)		;ENABLES TIMER0 OV INT.
	OUT		TIMSK,TEMP

;** SETTINGS OF SOFT TIMERS
    CLR     STIMER_OV_FLAGS     ;CLEARS ALL SOFT-TIMER OV FLAGS 
    
;** LOAD SOFT-TIMER1 PRESET VALUE FOR 4SECONDS OVERFLOW
    LDI     R16,LOW(4000-1)    ;BECAUSE COUNTING STARTS FROM 0
    LDI     R17,HIGH(4000-1)   ;SUBTRACT 1 FROM YOUR NUMBER

;   _STORE_16BIT_RAM    (16BIT RAM DESTINATION , HBYTE , LBYTE)
    _STORE_16BIT_RAM    RAM_STIMER1_PV,R17,R16

;** ENABLES SOFT-TIMER1
    CLR     TEMP
    SBR     TEMP,(1<<_STIMER1_EN)   ;ENABLES SOFT TIMER1   
    _STORE_8BIT_RAM     RAM_STIMER_ENABLE_FLAGS,TEMP


	SEI	                        ;ENABLES GLOBAL INTERRUPT FLAG

    RJMP    MAIN


;****************************************************************************
;   INTERRUPT SERVICE ROUTINE FOR TIMER#0 OVERFLOW EACH 1mS 
;**************************************************************************** 
ISR_TOV0:
    PUSH    TEMP
    LDI     TEMP,130
    OUT     TCNT0,TEMP
    PUSH    R1
    IN      R1,SREG     ;STORES SREG
    PUSH    YH
    PUSH    YL
	PUSH	STIMER_CVH
	PUSH	STIMER_CVL

;   _LOAD_8BIT_RAM      (8BIT RAM VALUE , DESTINATION REGISTER)
 	_LOAD_8BIT_RAM		RAM_STIMER_ENABLE_FLAGS,TEMP


;***** 16BIT SOFT TIMER#1 *******
CHECK_STIMER1:
    SBRS    TEMP,_STIMER1_EN    ;IS SOFT-TIMER#1 ENABLE?   
    RJMP    CHECK_STIMER2       ;IF NOT CHECK SOFT-TIMER#2
	_LOAD_16BIT_RAM		RAM_STIMER1_CV,STIMER_CVH,STIMER_CVL
	_LOAD_16BIT_RAM		RAM_STIMER1_PV,STIMER_PVH,STIMER_PVL
	CP		STIMER_CVL,STIMER_PVL   ;COMPARES CURRENT VALUE AND PRESET VALUE OF
	CPC		STIMER_CVH,STIMER_PVH   ;16BIT STIMER1.IF STIMER1 REACHES TO PRESET
    BRLO	INCREASE_STIMER1	    ;VALUE SETS THE OV FLAG IF NOT INCRESES THE
	EOR		STIMER_CVL,STIMER_CVL   ;STIMER1
	EOR		STIMER_CVH,STIMER_CVH
    SBR     STIMER_OV_FLAGS,(1<<_STIMER1_OV)
    RJMP	SAVE_STIMER1

INCREASE_STIMER1:
;================
	ADIW	STIMER_CVH:STIMER_CVL,1
SAVE_STIMER1:
;================
	_STORE_16BIT_RAM	RAM_STIMER1_CV,STIMER_CVH,STIMER_CVL



;***** 16BIT SOFT TIMER#2 *******    
CHECK_STIMER2:

    
    OUT     SREG,R1     ;LOADS SREG
 	POP		STIMER_CVL
	POP		STIMER_CVH
	POP		YL
	POP		YH
    POP     R1
    POP     TEMP
    RETI




