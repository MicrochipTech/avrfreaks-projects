
;**************************************************************************
;*  THIS TINY PROGRAM DEMONSTRATES HOW YOU CAN USE SOFT-TIMERS IN YOUR   
;*  PROGRAMS TO PRODUCE LONG INTERVAL EVENTS WITH LOWEST OVERHEAD.       
;*
;*  DEVICE:ATMEGA8
;*  ASSEMBLER&IDE:AVR STODIO4.12 AVR ASM2
;*  CPU FREQUENCY:8 MHz
;*  SOFT-TIMER'S TIME-BASE: 1mS  WITH THIS TIME-BASE AND A 16BIT STIMER
;*  YOU CAN MAKE STIMER OVERFLOW FOR MAXIMUM 65 SECONDS.
;*  *
;*  AUTHOR:OMID KOMPANI
;*  IRAN-TEHRAN
;*  2006   -   1384
;*
;*  PDF FORMAT OF THIS DOCUMENT IS EDITED IN NOTEPAD++ IDE.A VERY QUICK AND 
;*  USEFULL TEXT EDITOR! YOU CAN DOWNLOAD IT FROM
;*               http://notepad-plus.sourceforge.net/
;*  
;***************************************************************************

.NOLIST
.INCLUDE    "M8DEF.INC"	;ORIGINAL DEFINITIONS FOR ATMEGA8
.LIST

.INCLUDE    "DEF.H"     ;VARIABLES & CONSTANTS ARE DEFINED HERE
.INCLUDE    "SRAM.H"    ;RAM DEFINITIONS(STIMERS)
.INCLUDE    "MACRO.H"           

.CSEG
.INCLUDE    "ISR.ASM"   ;INTERRUPT SERVICE ROUTINES
.INCLUDE    "STIMER.ASM"


;************************************************************************
;*  MAIN CONTROL LOOP OF PROGRAM
;************************************************************************


MAIN:

    SBRC    STIMER_OV_FLAGS,_STIMER1_OV
    RCALL   ON_STIMER1

    SBRC    STIMER_OV_FLAGS,_STIMER2_OV
    RCALL   ON_STIMER2

    SBRC    STIMER_OV_FLAGS,_STIMER3_OV
    RCALL   ON_STIMER3

    SBRC    STIMER_OV_FLAGS,_STIMER4_OV
    RCALL   ON_STIMER4

    SBRC    STIMER_OV_FLAGS,_STIMER5_OV
    RCALL   ON_STIMER5

    SBRC    STIMER_OV_FLAGS,_STIMER6_OV
    RCALL   ON_STIMER6

    SBRC    STIMER_OV_FLAGS,_STIMER7_OV
    RCALL   ON_STIMER7

    SBRC    STIMER_OV_FLAGS,_STIMER8_OV
    RCALL   ON_STIMER8

    RJMP    MAIN
