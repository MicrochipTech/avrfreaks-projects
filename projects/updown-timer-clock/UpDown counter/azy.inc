	.DEF _end=R4
_3:
	.DW  0x63
	.DEF _pause=R6
_4:
	.DW  0x1
	.DEF _up=R8
_5:
	.DW  0x1
	.DEF _i=R10
	.DEF _countid=R12
_36:
	.DB  0x80,0xC0
	.DEF __lcd_x=R14
_tbl10_G3:
	.DW  0x2710,0x3E8,0x64,0xA,0x1
_tbl16_G3:
	.DW  0x1000,0x100,0x10,0x1
_0:
	.DB  0x50,0x0,0x20,0x0,0x20,0x20,0x20,0x20
	.DB  0x20,0x20,0x20,0x20,0x0,0x20,0x20,0x30
	.DB  0x0,0x53,0x0,0x44,0x6F,0x77,0x6E,0x0
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	.DB  0x64,0x3A,0x0

__GLOBAL_INI_TBL:
	.DW  0x02
	.DW  0x04
	.DW  _3*2

	.DW  0x02
	.DW  0x06
	.DW  _4*2

	.DW  0x02
	.DW  0x08
	.DW  _5*2

	.DW  0x02
	.DW  __base_y_G2
	.DW  _36*2

	.DW  0
