;
; Data for QVGA Oscilloscope Clock	
;

DialData:       .byte 0x78,0xef,0x78,0xe5,0x00,0x84,0xef,0x83,0xea,0x00,0x90,0xed,0x8f,0xe8,0x00,0x9c,0xea,0x9b,0xe5,0x00
                .byte 0xa8,0xe5,0xa6,0xe1,0x00,0xb3,0xe0,0xaf,0xd9,0x00,0xbd,0xd9,0xbb,0xd5,0x00,0xc7,0xd1,0xc4,0xcd,0x00
                .byte 0xd0,0xc8,0xcc,0xc5,0x00,0xd8,0xbe,0xd4,0xbc,0x00,0xdf,0xb4,0xd8,0xb0,0x00,0xe4,0xa9,0xe0,0xa7,0x00
                .byte 0xe9,0x9d,0xe4,0x9c,0x00,0xec,0x91,0xe7,0x90,0x00,0xee,0x85,0xe9,0x84,0x00,0xee,0x78,0xe4,0x78,0x00
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                .byte 0x47,0xe5,0x49,0xe1,0x00,0x53,0xea,0x54,0xe5,0x00,0x5f,0xed,0x60,0xe8,0x00,0x6b,0xef,0x6c,0xea,0xff


DialDigits:     .byte 0x71,0xe0,0x73,0xe1,0x76,0xe4,0x76,0xcf,0x00,0x79,0xdf,0x79,0xe0,0x7a,0xe2,0x7b,0xe3,0x7d,0xe4,0x81,0xe4,0x83,0xe3,0x84,0xe2,0x85,0xe0,0x85,0xde,0x84,0xdc,0x82,0xd9,0x78,0xcf,0x86,0xcf,0x00
                .byte 0xab,0xd2,0xad,0xd3,0xb0,0xd6,0xb0,0xc1,0x00,0x00
                .byte 0xca,0xb2,0xca,0xb3,0xcb,0xb5,0xcc,0xb6,0xce,0xb7,0xd2,0xb7,0xd4,0xb6,0xd5,0xb5,0xd6,0xb3,0xd6,0xb1,0xd5,0xaf,0xd3,0xac,0xc9,0xa2,0xd7,0xa2,0x00,0x00
                .byte 0xd9,0x82,0xe4,0x82,0xde,0x7a,0xe1,0x7a,0xe3,0x79,0xe4,0x78,0xe5,0x75,0xe5,0x73,0xe4,0x70,0xe2,0x6e,0xdf,0x6d,0xdc,0x6d,0xd9,0x6e,0xd8,0x6f,0xd7,0x71,0x00,0xd7,0x52,0xcd,0x44,0xdc,0x44,0x00,0xd7,0x52,0xd7,0x3d,0x00,0x00
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                .byte 0x49,0xd2,0x4b,0xd3,0x4e,0xd6,0x4e,0xc1,0xff,0x00

SecPtrData:     .byte 0x78,0xe4,0x78,0x78,0xff,0x83,0xe4,0x78,0x78,0xff,0x8e,0xe2,0x78,0x78,0xff,0x99,0xdf,0x78,0x78,0xff
                .byte 0xa3,0xdb,0x78,0x78,0xff,0xae,0xd6,0x78,0x78,0xff,0xb7,0xd0,0x78,0x78,0xff,0xc0,0xc9,0x78,0x78,0xff
                .byte 0xc8,0xc1,0x78,0x78,0xff,0xcf,0xb8,0x78,0x78,0xff,0xd5,0xae,0x78,0x78,0xff,0xda,0xa4,0x78,0x78,0xff
                .byte 0xde,0x9a,0x78,0x78,0xff,0xe1,0x8f,0x78,0x78,0xff,0xe3,0x84,0x78,0x78,0xff,0xe3,0x78,0x78,0x78,0xff
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                .byte 0x4c,0xdb,0x78,0x78,0xff,0x56,0xdf,0x78,0x78,0xff,0x61,0xe2,0x78,0x78,0xff,0x6c,0xe4,0x78,0x78,0xff

MinPtrData:     .byte 0x7a,0x78,0x78,0xde,0x76,0x78,0x7a,0x78,0xff,0x79,0x78,0x82,0xde,0x76,0x79,0x79,0x78,0xff
                .byte 0x79,0x78,0x8d,0xdc,0x76,0x79,0x79,0x78,0xff,0x79,0x78,0x97,0xda,0x76,0x79,0x79,0x78,0xff
                .byte 0x79,0x78,0xa1,0xd6,0x76,0x79,0x79,0x78,0xff,0x79,0x77,0xab,0xd1,0x76,0x7a,0x79,0x77,0xff
                .byte 0x79,0x77,0xb3,0xcb,0x76,0x7a,0x79,0x77,0xff,0x79,0x77,0xbc,0xc4,0x76,0x7a,0x79,0x77,0xff
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                .byte 0x79,0x79,0x62,0xdc,0x76,0x78,0x79,0x79,0xff,0x79,0x79,0x6d,0xde,0x76,0x78,0x79,0x79,0xff

HrPtrData:      .byte 0x7a,0x78,0x78,0xb4,0x76,0x78,0x7a,0x78,0xff,0x79,0x78,0x7e,0xb4,0x76,0x79,0x79,0x78,0xff
                .byte 0x79,0x78,0x84,0xb3,0x76,0x79,0x79,0x78,0xff,0x79,0x78,0x8a,0xb2,0x76,0x79,0x79,0x78,0xff
                .byte 0x79,0x78,0x90,0xaf,0x76,0x79,0x79,0x78,0xff,0x79,0x77,0x96,0xac,0x76,0x7a,0x79,0x77,0xff
                .byte 0x79,0x77,0x9b,0xa9,0x76,0x7a,0x79,0x77,0xff,0x79,0x77,0xa0,0xa5,0x76,0x7a,0x79,0x77,0xff
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                .byte 0x79,0x79,0x6b,0xb3,0x76,0x78,0x79,0x79,0xff,0x79,0x79,0x71,0xb4,0x76,0x78,0x79,0x79,0xff

