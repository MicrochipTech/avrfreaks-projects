#include <stdio.h>
#include <math.h>

/*
	Adjust electronic compass readings from magnetic north to true north using a subset of data generated by the NOAA WMM70.exe software.
	Approximate magnetic declination for latitudes -60..60 and all longitudes for July 15, 2012 (the midpoint of the the period covered by
	the model.) Points at 10 degree intervals of a (latitude, longitude) grid are plotted for declination	with the WMM2010 software.
	Declinations are stored in the source program in a literal string. Bilinear interpolation is then used to approximate the declinations
	within these 10 degree grids. This method allows microcontrollers with minimal memory resources to correct readings from a compass sensor
	for true north. Test readings should be within a few degrees of the WMM2010 model for most inhabited locations.
	
	If you just need to use the existing lookup table here for use in your program, you will need only the declination()
   function to retrieve values from the lookup table dec_tbl[]
	
	Call declination() with your latitude and longitude. approximation for declination is returned.

*/

float declination(float lat, float lon)
{
	/*
		lookup declination values from 10 x 10 degree grid and return approximate declination for (lat,lon) 
		data; 482 declination values (rounded to nearest degree) stored in 482 bytes
	*/

// -60..0..60 step 10 => 2(6) + 1 = 13 dimensions for lat; -180..0..180 step 10 => 2(18) + 1 = 37 dimensions for lon 	
	char dec_tbl[13][37] = \
{46,45,44,42,41,40,38,36,33,28,23,16,10,4,-1,-5,-9,-14,-19,-26,-33,-40,-48,-55,-61, \
-66,-71,-74,-75,-72,-61,-25,22,40,45,47,46,30,30,30,30,29,29,29,29,27,24,18,11,3, \
-3,-9,-12,-15,-17,-21,-26,-32,-39,-45,-51,-55,-57,-56,-53,-44,-31,-14,0,13,21,26, \
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13,7,0,-7,-12,-15,-14,-11,-6,-1,3};

	float decSW, decSE, decNW, decNE, decmin, decmax;
	float lonmin,latmin;
	short latmin_index,lonmin_index;
	/* set base point (latmin, lonmin) of grid */
	
	/* no limits test on lon */
	if (lon == 180) lonmin = 170;
	else lonmin = floor(lon/10)*10;
		
	/* supported lat's -60..60, so range check... */
	if (lat >= 60) latmin = 50;
	else if (lat < -60) latmin = -60;
	else latmin = floor(lat/10)*10;
	
	/* array index = (degrees+[60|180])/10 */
	latmin_index= (60+latmin)/10;
	lonmin_index= (180+lonmin)/10;
		
	decSW = dec_tbl[latmin_index][lonmin_index];
	decSE = dec_tbl[latmin_index][lonmin_index+1];
	decNE = dec_tbl[latmin_index+1][lonmin_index+1];
	decNW = dec_tbl[latmin_index+1][lonmin_index];
	
	/* approximate declination within the grid using bilinear interpolation */

	decmin = (lon - lonmin) / 10 * (decSE - decSW) + decSW;
	decmax = (lon - lonmin) / 10 * (decNE - decNW) + decNW;
	return   (lat - latmin) / 10 * (decmax - decmin) + decmin;
}
