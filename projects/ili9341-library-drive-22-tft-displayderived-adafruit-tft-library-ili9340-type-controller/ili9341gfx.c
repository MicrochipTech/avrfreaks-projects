#include "ili9341.h"
#include "ili9341gfx.h"

volatile uint16_t cursor_x;
volatile uint16_t cursor_y;
volatile uint16_t textcolour;
volatile uint16_t textbgcolour;
volatile uint8_t textsize;
uint16_t vsetx,vsety,vactualx,vactualy,isetx,isety,iactualx,iactualy;

static FILE mydata = FDEV_SETUP_STREAM(ili9341_putchar_printf, NULL, _FDEV_SETUP_WRITE);//mydata declaration and converting it into stream
 
int16_t ili9341_putchar_printf(char var, FILE *stream)//this function will be called whenever printf is used
{
ili9341_write(var);
}




void backuplocationvset(void)//backing up vset data start location to print next vset data in exact location
{
vsetx=cursor_x;
vsety=cursor_y;
}


void backuplocationvactual(void)//backing up vactual data start location to print next vactual data in exact location
{
vactualx=cursor_x;
vactualy=cursor_y;
}

void backuplocationiset(void)//backing up iset data start location to print next iset data in exact location
{
isetx=cursor_x;
isety=cursor_y;
}


void backuplocationiactual(void)//backing up iactual data start location to print next iactual data in exact location
{
iactualx=cursor_x;
iactualy=cursor_y;
}

 
//array for font
static const unsigned char font[] PROGMEM = {
        0x00, 0x00, 0x00, 0x00, 0x00,   
	0x3E, 0x5B, 0x4F, 0x5B, 0x3E, 	
	0x3E, 0x6B, 0x4F, 0x6B, 0x3E, 	
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	0x00, 0x00, 0x00, 0x00, 0x00
};

extern uint16_t LCD_W,LCD_H;

void ili9341_drawchar(int16_t x, int16_t y, unsigned char c,uint16_t color, uint16_t bg, uint8_t size) //draw a char like a,b or 1,2
{

if((x >=LCD_W)            || // Clip right
(y >=LCD_H)           || // Clip bottom
((x + 6 * size - 1) < 0) || // Clip left
((y + 8 * size - 1) < 0))   // Clip top
return;
for (int8_t i=0; i<6; i++ ) {
uint8_t line;
if (i == 5) 
line = 0x0;
else 
line = pgm_read_byte(font+(c*5)+i);
for (int8_t j = 0; j<8; j++) {
if (line & 0x1) {
if (size == 1) // default size
ili9341_drawpixel(x+i, y+j, color);
else {  // big size
ili9341_fillrect(x+(i*size), y+(j*size), size, size, color);
} 
} else if (bg != color) {
if (size == 1) // default size
ili9341_drawpixel(x+i, y+j, bg);
else 
{  // big size
ili9341_fillrect(x+i*size, y+j*size, size, size, bg);
}
}
line >>= 1;
}
}
}


void ili9341_setcursor(uint16_t x,uint16_t y)//set cursor at desired location to print data
{
cursor_x=x;
cursor_y=y;
}

void ili9341_settextcolour(uint16_t x,uint16_t y)//set text colour and text background colour
{
textcolour=x;
textbgcolour=y;
}

void ili9341_settextsize(uint8_t s)
{
if(s>8) return;
textsize=(s>0) ? s: 1;//this operation means if s0 greater than 0,then s=s,else s=1
}

void ili9341_write(uint8_t c)//write a character at setted coordinates after setting location and colour
{
if (c == '\n') {
cursor_y += textsize*8;
cursor_x  = 0;
} else if (c == '\r') {
 // skip em
}
else
{
ili9341_drawchar(cursor_x, cursor_y, c, textcolour, textbgcolour, textsize);
cursor_x += textsize*6;
}
}


void display_init(void)//display initial data regarding my power supply
{
stdout = & mydata;//it is used for printf function and must be declared locally
ili9341_setcursor(4,4);
_delay_ms(2);
ili9341_settextcolour(GREEN,BLACK);
_delay_ms(2);
ili9341_settextsize(2);
_delay_ms(2);
printf("mode - ");
_delay_ms(2);
ili9341_settextcolour(RED,BLACK);
_delay_ms(2);
ili9341_settextsize(2);
_delay_ms(2);
printf("constant voltage");
_delay_ms(2);
ili9341_setcursor(4,40);
_delay_ms(2);
ili9341_settextcolour(CYAN,BLACK);
_delay_ms(2);
ili9341_settextsize(4);
_delay_ms(2);
ili9341_write('V');
_delay_ms(2);
cursor_y=cursor_y+6;
ili9341_settextsize(3);
_delay_ms(2);
printf("set\n");
_delay_ms(2);
cursor_y=cursor_y+12;
backuplocationvset();
printf("00.00v");
_delay_ms(2);
ili9341_setcursor(4,120);
_delay_ms(2);
ili9341_settextsize(4);
_delay_ms(2);
ili9341_write('V');
_delay_ms(2);
cursor_y=cursor_y+6;
ili9341_settextsize(3);
_delay_ms(2);
printf("actual\n\n");
_delay_ms(2);
backuplocationvactual();
ili9341_settextsize(5);
printf("00.00");
_delay_ms(2);



ili9341_setcursor(164,40);
_delay_ms(2);
ili9341_settextcolour(YELLOW,BLACK);
_delay_ms(2);
ili9341_settextsize(4);
_delay_ms(2);
ili9341_write('I');
_delay_ms(2);
cursor_y=cursor_y+6;
ili9341_settextsize(3);
_delay_ms(2);
printf("set");
_delay_ms(2);
cursor_x=164;
cursor_y=(cursor_y+36);
backuplocationiset();
ili9341_settextsize(3);
printf("00.00a");
_delay_ms(2);
ili9341_setcursor(164,120);
_delay_ms(2);
ili9341_settextsize(4);
_delay_ms(2);
ili9341_write('I');
_delay_ms(2);
cursor_y=cursor_y+6;
ili9341_settextsize(3);
_delay_ms(2);
printf("actual");
_delay_ms(2);
cursor_x=164;
backuplocationiactual();
cursor_y=cursor_y+48;
ili9341_settextsize(5);
printf("00.00");
_delay_ms(2000);

}


