;
;  Copyright (C) 2000 Jesper Hansen <jesperh@telia.com>.
;
;  This program is free software; you can redistribute it and/or
;  modify it under the terms of the GNU General Public License
;  as published by the Free Software Foundation; either version 2
;  of the License, or (at your option) any later version.
;
;  This program is distributed in the hope that it will be useful,
;  but WITHOUT ANY WARRANTY; without even the implied warranty of
;  MERCHANTABILITY or FITNESS FOR A PARTICULAR PURPOSE.  See the
;  GNU General Public License for more details.
;
;  You should have received a copy of the GNU General Public License
;  along with this program; if not, write to the Free Software Foundation, 
;  Inc., 59 Temple Place - Suite 330, Boston, MA  02111-1307, USA.
;
;
;*******************************************************************
;*******************************************************************
;
;Description
;
; Poor-mans DDS Synthesizer: http://www.myplace.nu/avr/minidds/index.htm
; 
; Author = Jesper Hansen
; Date   = 2001-02-15
;
; Ported to Dutchtronix AVR Oscilloscope Clock:
;	 http://www.dutchtronix.com/ScopeClock.htm
; Target = ATmega168
; Date   = September 4,2007
; Update = October 15, 2008
;
;
; see below for DAC pins
;
; PD0		RXD
; PD1		TXD
; PD2..6	not used
;

;*******************************************************************
;*******************************************************************
;
;
;DDS Control:
;	set preferences by right clicking the title bar
;	set DDS Resolution to 24 bit
;	set proper Comport
;	set "Synthesizer Frequency" to fClock value below			
;
; Output frequency (using 24 bit accumulator) :
;
;	f = deltaPhase * fClock/2^24
;
; DACLATCH = 0:
;
;   fClock is in this case the CPU clock divided by the
;	number of cycles to output the data ( 11 cycles )
;
;	fClock = 20000000/11 = 1818181. Use this number in DDS Control
;
;	f = r24/r25/r26 * (20000000/11)/16777216
;
;	f = r24/r25/r26 * 0.108372
;
;	fMax (theoretical) = 0.5 * fClock
;
; DACLATCH = 1:
;
;   fClock is in this case the CPU clock divided by the
;	number of cycles to output the data ( 13 cycles )
;
;	fClock = 20000000/13 = 1538461. Use this number in DDS Control
;
;	f = r24/r25/r26 * (20000000/13)/16777216
;
;	f = r24/r25/r26 * 0.0916994
;
;	fMax (theoretical) = 0.5 * fClock

#define ASCIILINK 0
#define	DACLATCH 0

.def	_0			= r15	;Zero register

;******************************************************************************
; start of code
;******************************************************************************


#include <m168def.inc>

;
; 8 bit parallel data (7..0) is mapped to PB3..PB0 PC3..PC0
; DACA/DACB select is mapped to PD3 (low is A)
; WR (active low) is mapped to PD4
;
#define DACHIDATA PORTB
#define DACLODATA PORTC
#define DACSELECT	PORTD,3
#define DACWR PORTD,4
#define	DACHIDDR  DDRB
#define	DACLODDR  DDRC
#define DACCTLDDR DDRD


	.cseg

	.org 0
		jmp	RESET

	.org	URXCaddr			;18 Serial In Received
		jmp	RX_COMPLETE_INT

;******************************************************************************
; code
;******************************************************************************


RESET:
	clr		_0

#if ASCIILINK
	ldi		r17,64		;baud 19200 at 20MHz Xtal 
#else
	ldi		r17,10		;baud 115.2k at 20MHz Xtal 
#endif
	sts		UBRR0L,r17
	sts		UBRR0H,_0
	sts		UCSR0A,_0
; set rx interrupt
	ldi		r17,((1<<RXCIE0)|(1<<TXEN0) | (1<<RXEN0))
	sts		UCSR0B,r17
; set default 8 bits, no parity, 1 stop
	ldi		r17,((1<<UCSZ01)|(1<<UCSZ00))
	sts		UCSR0C,r17

	sei						; global enable interrupts

	rcall	DAC_init
	
; set sinewave output as default
		
	ldi		zl,low(sine*2)	; setup Z pointer
	ldi		zh,high(sine*2)

; clear accumulator 

	ldi 	r29,0x00		; clear accumulator 
	ldi 	r28,0x00		; clear accumulator 

; setup adder registers		
	
	ldi 	r24,0x72		; setup adder value
	ldi 	r25,0x68		; to 10 kHz
	ldi 	r26,0x01		; 

;
; initialize DAC to always use DACA
;
	cbi		DACSELECT			;select DACA (active low)
#if DACLATCH
	sbi		DACWR				;ready for latching
#else
	cbi		DACWR				;always on
#endif

; main loop
;
;	r28,r29,r30 is the phase accumulator
;  	r24,r25,r26 is the adder value determining frequency
;
; 	add value to accumulator
;	load byte from current table in ROM
;	output byte to port
;	repeat 
;
LOOP1:
	add		r28,r24			; 1
	adc		r29,r25			; 1
	adc		r30,r26			; 1
	lpm						; 3
	out		DACLODATA,r0	; 1
	swap	r0				; 1
	out		DACHIDATA,r0	; 1
#if DACLATCH
	cbi		DACWR			;latch data
	sbi		DACWR
#endif
	rjmp	LOOP1			; 2 => 11 cycles


;**********************************************************************
; communication functionality
;**********************************************************************

;
; get char in r16
;
get_char:
		lds		r16,UCSR0A		; wait for a byte to be ready
		sbrs	r16,7			; ready ?
		rjmp	get_char		; no, wait some more
		lds		r16,UDR0			; get the byte
		ret						; and return
		
;
; send char in r16
;
UART_SendByte:
		push	r16				; save r16
send_c2:
		lds		r16,UCSR0A		; wait for the transmitter to be ready
		sbrs	r16,5			; ready ? 
		rjmp	send_c2			; no, wait some more
		pop		r16				; restore r16
		sts		UDR0,r16			; send char
		ret						; ans return

;
; send the current frequency to the PC
; as a 5 byte sequence :
; 'F' folowed by a 32 bit phase accumulator value
;
;
send_data:
		push	r16				; save r16
		ldi		r16,'F'			; flag
		rcall	UART_SendByte
#if ASCIILINK
		clr		r16				; zero byte for 32-bit compatibility
		rcall	UART_Printfu08		; MSB

		mov		r16,r26
		rcall	UART_Printfu08		; high add

		mov		r16,r25
		rcall	UART_Printfu08		; mid add

		mov		r16,r24
		rcall	UART_Printfu08		; low add

		ldi		r16,0x0d
		rcall	UART_SendByte		; terminator
		ldi		r16,0x0a
		rcall	UART_SendByte		; terminator
#else
		clr		r16				; zero byte for 32-bit compatibility
		rcall	UART_SendByte		; MSB

		mov		r16,r26
		rcall	UART_SendByte		; high add

		mov		r16,r25
		rcall	UART_SendByte		; mid add

		mov		r16,r24
		rcall	UART_SendByte		; low add

		ldi		r16,0x0a
		rcall	UART_SendByte		; terminator
#endif
		pop		r16
		ret

#if DACLATCH
;
; Semantics reinterpretation: change FREQUENCY, not ACCUMULATOR
;
; 13 cycles => Resolution is 0.0916994 => multiplier is 10.905
;
; add 1 to the frequency => add 10.905 to the accumulator
; too much: 0.095
up_one:
		ldi		r17,11
		add		r24,r17
		adc		r25,_0
		adc		r26,_0
		ret
;
; add 10 to the frequency => add 109.05 to the accumulator
; missing: 0.05
;
up_ten:
		ldi		r17,109
		add		r24,r17
		adc		r25,_0
		adc		r26,_0
		ret
;
; add 100 to the frequency =>  add 1090.5 to the accumulator
; call up_ten 10 times
; missing: 0.5
;
up_hundred:
		ldi		r18, 10
up_hundred_1:
		rcall	up_ten
		dec		r18
		brne	up_hundred_1
		ret
;
; add 10000 to the frequency => add 109050 to the accumulator
; call up_hundred 100 times, add 50
;
up_tenthousand:
		ldi		r16,100
up_h10:
		rcall	up_hundred
		dec		r16
		brne	up_h10
;
; now add another 50 for the fraction
;
		ldi		r17,50
		add		r24,r17
		adc		r25,_0
		adc		r26,_0
		ret
;
; subtract 1 from the frequency => sub 10.905 from the accumulator
; too much: 0.095
;
down_one:
		subi	r24,11
		sbc		r25,_0
		sbc		r26,_0
;
; TODO: now add 0.1 to the accumulator
		ret
;
; subtract 10 from the frequency => sub 109.05 from the accumulator
; missing: 0.05
;
down_ten:
		subi	r24,109
		sbc		r25,_0
		sbc		r26,_0
		ret
;
; subtract 100 from the frequency => sub 1090.5 to the accumulator
; call down_ten 10 times
; missing: 0.5
;
down_hundred:
		ldi		r18, 10
down_hundred_1:
		rcall	down_ten
		dec		r18
		brne	down_hundred_1
		ret

; subtract 10000 from the frequency =>sub 109050 to the accumulator
; call down_hundred ten 100 times, sub 50 more
;
down_tenthousand:
		ldi		r16,100
down_h10:
		rcall	down_hundred
		dec		r16
		brne	down_h10
;
; now subtract another 50 for the fraction
;
		subi	r24,50
		sbc		r25,_0
		sbc		r26,_0
		ret

#else
;
; Semantics reinterpretation: change FREQUENCY, not ACCUMULATOR
;
; 11 cycles => Resolution is 0.108372 => multiplier is 9.2274757
;
; add 1 to the frequency => add 9.227 to the accumulator
; missing: 0.227
up_one:
		ldi		r17,9
		add		r24,r17
		adc		r25,_0
		adc		r26,_0
		ret
;
; add 10 to the frequency => add 92.27 to the accumulator
; missing: 0.27
;
up_ten:
		ldi		r17,92
		add		r24,r17
		adc		r25,_0
		adc		r26,_0
		ret
;
; add 100 to the frequency => add 922.7 to the accumulator
; call up_ten 10 times. Add 2 more
; missing: 0.7
;
up_hundred:
		ldi		r18, 10
up_hundred_1:
		rcall	up_ten
		dec		r18
		brne	up_hundred_1
;
; now add another 2 for the fraction
;
		ldi		r17,2
		add		r24,r17
		adc		r25,_0
		adc		r26,_0
		ret
;
; add 10000 to the frequency => add 92270 to the accumulator
; call up_hundred 100 times. Add 70 more
;
up_tenthousand:
		ldi		r16,100
up_h10:
		rcall	up_hundred
		dec		r16
		brne	up_h10
;
; now add another 70 for the fraction
;
		ldi		r17,70
		add		r24,r17
		adc		r25,_0
		adc		r26,_0
		ret
;
; subtract 1 from the frequency => sub 9.227 from the accumulator
; missing: 0.227
;
down_one:
		subi	r24,9
		sbc		r25,_0
		sbc		r26,_0
		ret
;
; subtract 10 from the frequency => sub 92.27 from the accumulator
; missing: 0.27
;
down_ten:
		subi	r24,92
		sbc		r25,_0
		sbc		r26,_0
		ret
;
; subtract 100 from the frequency => sub 922.7 from the accumulator
; call down_ten 10 times, subtract 2 more
;
down_hundred:
		ldi		r18, 10
down_hundred_1:
		rcall	down_ten
		dec		r18
		brne	down_hundred_1
;
; now subtract another 2 for the fraction
;
		subi	r24,2
		sbc		r25,_0
		sbc		r26,_0
		ret
;
;
; subtract 10000 from the frequency => sub 92270 from the accumulator
; call down_hundred 100 times, subtract 70 more
;
down_tenthousand:
		ldi		r16,100
down_h10:
		rcall	down_hundred
		dec		r16
		brne	down_h10
;
; now subtract another 70 for the fraction
;
		subi	r24,70
		sbc		r25,_0
		sbc		r26,_0
		ret
#endif


#if ASCIILINK
;
; read 6 hex characters (24-bit value) from the serial link
; no error checking
;
readAdderValue:
	rcall	getnibble		;bits 20..23
	mov		r17,r16			;save
	swap	r17
	rcall	getnibble		;bits 16..19
	or		r17,r16			;merge
	mov		r26,r17			;MSB
	rcall	getnibble		;bits 12..15
	mov		r17,r16			;save
	swap	r17
	rcall	getnibble		;bits 8..11
	or		r17,r16			;merge
	mov		r25,r17			;MIDDLE SB
	rcall	getnibble		;bits 4..7
	mov		r17,r16			;save
	swap	r17
	rcall	getnibble		;bits 0..3
	or		r17,r16			;merge
	mov		r24,r17			;LSB
	ret
	
getnibble:
	rcall	get_char
	subi	r16,'0'			;map to binary
	brcs	error			;too small
	cpi		r16,9			;lower range?
	brcs	done
	subi	r16,7			;upper range
done:
	ret
error:
	clr		r16
	ret

#else
; 
; read in 4 bytes from the serial link
;
readAdderValue:
		rcall	get_char		; read and ignore bits 32..24
		mov		r17,r16			;test
		rcall	get_char		; read bits 23..16
		mov		r26,r16
		rcall	get_char		; read bits 15..8
		mov		r25,r16
		rcall	get_char		; read bits 7..0
		mov		r24,r16
		ret
#endif
;
; Interrupt routine for incoming bytes on the RS232 link
;
	
RX_COMPLETE_INT:
		push	r16
		in		r16,SREG
		push	r16
		push	r17
		push	r18
		lds		r16,UDR0
		cpi		r16,'-'				; up one
		brne	tx_2
		rcall	up_one
		rjmp	tx_exit		
;
; Direction commands reversed to match the DDSControl.exe application
;
tx_2:
		cpi		r16,'d'				; up Hundred
		brne	tx_3
		rcall	up_hundred
		rjmp	tx_exit		
tx_3:
		cpi		r16,'D'				; up TenThousand
		brne	tx_4
		rcall	up_tenthousand
		rjmp	tx_exit		
tx_4:
		cpi		r16,'+'				; down one
		brne	tx_5
		rcall	down_one
		rjmp	tx_exit		
tx_5:
		cpi		r16,'u'				; down Hundred
		brne	tx_6
		rcall	down_hundred
		rjmp	tx_exit		
tx_6:
		cpi		r16,'U'				; down TenThousand
		brne	tx_7
		rcall	down_tenthousand		
		rjmp	tx_exit		
tx_7:
		cpi		r16,'s'				; frequency setting
		brne	tx_8
		rcall	readAdderValue		
		rjmp	tx_exit		
tx_8:
		cpi		r16,'?'				; just force a reply
		brne	tx_9
		rjmp	tx_exit		
tx_9:	
		cpi		r16,'1'				; request sinewave output
		brne	tx_10
		ldi		zl,low(sine*2)		; setup Z pointer to sine
		ldi		zh,high(sine*2)
		rjmp	tx_exit
tx_10:
		cpi		r16,'2'				; request sawtooth output
		brne	tx_11
		ldi		zl,low(sawtooth*2)	; setup Z pointer to sawtooth
		ldi		zh,high(sawtooth*2)
		rjmp	tx_exit
tx_11:
		cpi		r16,'3'				; request triangle output
		brne	tx_12
		ldi		zl,low(triangle*2)	; setup Z pointer to triangle
		ldi		zh,high(triangle*2)
		rjmp	tx_exit
tx_12:
		cpi		r16,'4'				; request squarewave output
		brne	tx_13
		ldi		zl,low(square*2)	; setup Z pointer to square
		ldi		zh,high(square*2)
		rjmp	tx_exit

; unknown command, just ignore it
tx_13:


; always reply with the current frequency
tx_exit:
		rcall	send_data
		pop		r18
		pop		r17
		pop		r16
		out		SREG,r16
		pop		r16
		reti




DAC_init:
	sbi		DACHIDDR,0		;high nibble
	sbi		DACHIDDR,1
	sbi		DACHIDDR,2
	sbi		DACHIDDR,3
	sbi		DACLODDR,0		;low nibble
	sbi		DACLODDR,1
	sbi		DACLODDR,2
	sbi		DACLODDR,3
	sbi		DACCTLDDR,3		;DAC Select
	sbi		DACCTLDDR,4		;WR 
	sbi		DACWR			;hold
	ret

#if ASCIILINK
;
; print value in r16 as 2 hex chars
; r16 used
;
UART_Printfu08:
	push	r0
	push    r16
    swap    r16
    andi    r16,0X0F
    rcall   Hex2Asc
	rcall	UART_SendByte
    pop     r16
    andi    r16,0X0F
    rcall   Hex2Asc
	rcall	UART_SendByte
	pop		r0
	ret
;
; print value in r16 and r17 as 4 hex chars
; r24 used
;
UART_Printfu16:
	push	r16
	mov		r16,r17
	rcall	UART_Printfu08
	pop		r16
	rcall	UART_Printfu08
	ret
;
; print value in r16, r17, r18, r19 as 4 hex chars
; r16 used
;
UART_Printfu32:
	push	r16
	push	r17
	mov		r16,r18
	mov		r17,r19
	rcall	UART_Printfu16
	pop		r17
	pop		r16
	rcall	UART_Printfu16
	ret
#endif

;
; convert nibble value in r16 into Hex Char in r16
;
Hex2Asc:
	push	zl
	push	zh
	ldi		zl,low(ASC_TAB*2)
	ldi		zh,high(ASC_TAB*2)
    add     ZL,r16
    adc     ZH,_0
    lpm		r16,Z
	pop		zh
	pop		zl
    ret

	ASC_TAB:
	.db		"0123456789ABCDEF"

;******************************************************************************
; data tables
;******************************************************************************

	; force table to begin at 256 byte boundary

	.org 0x1c00

sine:		; 256 step sinewave table
	.db	0x80,0x83,0x86,0x89,0x8c,0x8f,0x92,0x95,0x98,0x9c,0x9f,0xa2,0xa5,0xa8,0xab,0xae
	.db	0xb0,0xb3,0xb6,0xb9,0xbc,0xbf,0xc1,0xc4,0xc7,0xc9,0xcc,0xce,0xd1,0xd3,0xd5,0xd8
	.db	0xda,0xdc,0xde,0xe0,0xe2,0xe4,0xe6,0xe8,0xea,0xec,0xed,0xef,0xf0,0xf2,0xf3,0xf5
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	.db	0x4f,0x51,0x54,0x57,0x5a,0x5d,0x60,0x63,0x67,0x6a,0x6d,0x70,0x73,0x76,0x79,0x7c

sawtooth:	; 256 step sawtoothwave table
	.db	0x00,0x01,0x02,0x03,0x04,0x05,0x06,0x07,0x08,0x09,0x0a,0x0b,0x0c,0x0d,0x0e,0x0f
	.db	0x10,0x11,0x12,0x13,0x14,0x15,0x16,0x17,0x18,0x19,0x1a,0x1b,0x1c,0x1d,0x1e,0x1f
	.db	0x20,0x21,0x22,0x23,0x24,0x25,0x26,0x27,0x28,0x29,0x2a,0x2b,0x2c,0x2d,0x2e,0x2f
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	.db	0xf0,0xf1,0xf2,0xf3,0xf4,0xf5,0xf6,0xf7,0xf8,0xf9,0xfa,0xfb,0xfc,0xfd,0xfe,0xff

triangle:	; 256 step trianglewave table
	.db	0x00,0x02,0x04,0x06,0x08,0x0a,0x0c,0x0e,0x10,0x12,0x14,0x16,0x18,0x1a,0x1c,0x1e
	.db	0x20,0x22,0x24,0x26,0x28,0x2a,0x2c,0x2e,0x30,0x32,0x34,0x36,0x38,0x3a,0x3c,0x3e
	.db	0x40,0x42,0x44,0x46,0x48,0x4a,0x4c,0x4e,0x50,0x52,0x54,0x56,0x58,0x5a,0x5c,0x5e
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	.db	0x1f,0x1d,0x1b,0x19,0x17,0x15,0x13,0x11,0x0f,0x0f,0x0b,0x09,0x07,0x05,0x03,0x01



square:		; 256 step squarewave table
	.db	0x00,0x00,0x00,0x00,0x00,0x00,0x00,0x00,0x00,0x00,0x00,0x00,0x00,0x00,0x00,0x00
	.db	0x00,0x00,0x00,0x00,0x00,0x00,0x00,0x00,0x00,0x00,0x00,0x00,0x00,0x00,0x00,0x00
	.db	0x00,0x00,0x00,0x00,0x00,0x00,0x00,0x00,0x00,0x00,0x00,0x00,0x00,0x00,0x00,0x00
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	.db	0xff,0xff,0xff,0xff,0xff,0xff,0xff,0xff,0xff,0xff,0xff,0xff,0xff,0xff,0xff,0xff
