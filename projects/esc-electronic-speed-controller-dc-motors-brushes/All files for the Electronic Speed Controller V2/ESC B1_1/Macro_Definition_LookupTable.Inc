/*************************************************************************************************************************
Electronic Speed Controller Program Version Beta 1.0                                                           LookupTable 
*************************************************************************************************************************/

.MACRO LookupTable

//           0   1   2   3   4   5   6   7   8   9					0	1	2	3	4	5	6	7	8	9
	
       .DB   0,  0,  0,  0,  0,  2,  3,  5,  7,  8 			// 0X	0	0	0	0	0	2	3	5	7	8
       .DB  10, 11, 13, 15, 16, 18, 20, 21, 23, 25 			// 1X	10	11	13	15	16	18	20	21	23	25
       .DB  26, 28, 29, 31, 33, 34, 36, 38, 39, 41 			// 2X	26	28	29	31	33	34	36	38	39	41
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	   .DB 255,255,255,255,255,255,255,255,255,255 			//22X	255	255	255	255	255	255	255	255	255	255

.ENDMACRO
